/* generated by ASAP2 Studio 2.2.5.8070 */
/* @@@@ File written by CANAPE_VERSION 18 0 30 @@@@ */ ASAP2_VERSION 1 71
/begin PROJECT XCPpi "RaspberryPi XCP demo"
/begin HEADER "" VERSION "1.0" /end HEADER
/begin MODULE RaspberryPi4 ""
/begin MOD_PAR ""
 /begin MEMORY_SEGMENT CALRAM "" VARIABLES RAM INTERN 0x25014 0xDF -1 -1 -1 -1 -1
  /begin IF_DATA XCP
   /begin SEGMENT 0xFF 0x01 0x00 0x00 0x00
    /begin PAGE 0x00 ECU_ACCESS_DONT_CARE XCP_READ_ACCESS_DONT_CARE XCP_WRITE_ACCESS_DONT_CARE INIT_SEGMENT 0x00 /end PAGE
    /begin ADDRESS_MAPPING 0x025014 0x025014 0xDF /end ADDRESS_MAPPING
    /begin ADDRESS_MAPPING 0x025014 0x00 0xDF /end ADDRESS_MAPPING
   /end SEGMENT
  /end IF_DATA
 /end MEMORY_SEGMENT
/end MOD_PAR
/begin MOD_COMMON "" BYTE_ORDER MSB_LAST ALIGNMENT_BYTE 1 ALIGNMENT_WORD 1 ALIGNMENT_LONG 1 ALIGNMENT_FLOAT16_IEEE 1 ALIGNMENT_FLOAT32_IEEE 1 ALIGNMENT_FLOAT64_IEEE 1 ALIGNMENT_INT64 1 /end MOD_COMMON
/begin IF_DATA XCP
 /begin PROTOCOL_LAYER 0x0101 0x012C 0x2710 0x00 0x00 0x00 0x00 0x00 0xFA 0x05B8 BYTE_ORDER_MSB_LAST ADDRESS_GRANULARITY_BYTE OPTIONAL_CMD ALLOC_ODT_ENTRY OPTIONAL_CMD ALLOC_ODT OPTIONAL_CMD ALLOC_DAQ OPTIONAL_CMD FREE_DAQ OPTIONAL_CMD GET_DAQ_RESOLUTION_INFO OPTIONAL_CMD GET_DAQ_PROCESSOR_INFO OPTIONAL_CMD GET_DAQ_CLOCK OPTIONAL_CMD START_STOP_SYNCH OPTIONAL_CMD START_STOP_DAQ_LIST OPTIONAL_CMD GET_DAQ_LIST_MODE OPTIONAL_CMD SET_DAQ_LIST_MODE OPTIONAL_CMD WRITE_DAQ OPTIONAL_CMD SET_DAQ_PTR OPTIONAL_CMD CLEAR_DAQ_LIST OPTIONAL_CMD DOWNLOAD OPTIONAL_CMD UPLOAD OPTIONAL_CMD SET_MTA OPTIONAL_CMD GET_COMM_MODE_INFO /end PROTOCOL_LAYER
 /begin DAQ DYNAMIC 0x00 0x02 0x00 OPTIMISATION_TYPE_DEFAULT ADDRESS_EXTENSION_FREE IDENTIFICATION_FIELD_TYPE_RELATIVE_BYTE GRANULARITY_ODT_ENTRY_SIZE_DAQ_BYTE 0xB2 OVERLOAD_INDICATION_PID /begin TIMESTAMP_SUPPORTED 0x01 SIZE_DWORD UNIT_1US TIMESTAMP_FIXED /end TIMESTAMP_SUPPORTED /begin EVENT "Event1" "Event1" 0x01 DAQ 0xFF 0x01 0x06 0x00 /end EVENT /begin EVENT "Event2" "Event2" 0x02 DAQ 0xFF 0x01 0x06 0x00 /end EVENT /end DAQ
 /begin PAG 0x01 /end PAG
 /begin PGM PGM_MODE_ABSOLUTE 0x00 0x00 /end PGM
 /begin XCP_ON_TCP_IP 0x0100 0x15B3 ADDRESS "127.0.0.1" /end XCP_ON_TCP_IP
 /begin XCP_ON_UDP_IP 0x0100 0x15B3 ADDRESS "172.31.31.194" /end XCP_ON_UDP_IP
/end IF_DATA
/begin TYPEDEF_MEASUREMENT LongPointer_Measurement_UByte "" UBYTE NO_COMPU_METHOD 0 0 0 255 ADDRESS_TYPE PLONG /end TYPEDEF_MEASUREMENT
/begin TYPEDEF_MEASUREMENT Measurement_UByte_Copy1 "" UBYTE NO_COMPU_METHOD 0 0 0 255 /end TYPEDEF_MEASUREMENT
/begin TYPEDEF_MEASUREMENT Measurement_ULong "" ULONG NO_COMPU_METHOD 0 0 0 4294967295 /end TYPEDEF_MEASUREMENT
/begin TYPEDEF_MEASUREMENT Measurement_UWord "" UWORD NO_COMPU_METHOD 0 0 0 65535 /end TYPEDEF_MEASUREMENT
/begin TYPEDEF_CHARACTERISTIC Parameter_UByte "" VALUE __UByte_Value 0 NO_COMPU_METHOD 0 255 /end TYPEDEF_CHARACTERISTIC
/begin TYPEDEF_CHARACTERISTIC Parameter_ULong "" VALUE __ULong_Value 0 NO_COMPU_METHOD 0 4294967295 /end TYPEDEF_CHARACTERISTIC
/begin TYPEDEF_CHARACTERISTIC Parameter_UWord "" VALUE __UWord_Value 0 NO_COMPU_METHOD 0 65535 /end TYPEDEF_CHARACTERISTIC
/begin TYPEDEF_MEASUREMENT _uint64 "" A_UINT64 NO_COMPU_METHOD 0 0 0 1.84467440737E+19 /end TYPEDEF_MEASUREMENT
/begin TYPEDEF_STRUCTURE _unnamed_struct_ "" 0xEB7C SYMBOL_TYPE_LINK "<unnamed-struct>{CompileUnit:xcpLite_c}{Namespace:Global}" /begin STRUCTURE_COMPONENT Crm tXcpCto 0 SYMBOL_TYPE_LINK "Crm" /end STRUCTURE_COMPONENT
 /begin STRUCTURE_COMPONENT CrmLen Measurement_UByte_Copy1 252 SYMBOL_TYPE_LINK "CrmLen" /end STRUCTURE_COMPONENT
 /begin STRUCTURE_COMPONENT SessionStatus Measurement_UByte_Copy1 253 SYMBOL_TYPE_LINK "SessionStatus" /end STRUCTURE_COMPONENT
 /begin STRUCTURE_COMPONENT Mta Measurement_UByte_Copy1 256 ADDRESS_TYPE PLONG SYMBOL_TYPE_LINK "Mta" /end STRUCTURE_COMPONENT
 /begin STRUCTURE_COMPONENT Daq tXcpDaq 260 SYMBOL_TYPE_LINK "Daq" /end STRUCTURE_COMPONENT
 /begin STRUCTURE_COMPONENT pOdt tXcpOdt 60268 ADDRESS_TYPE PLONG SYMBOL_TYPE_LINK "pOdt" /end STRUCTURE_COMPONENT
 /begin STRUCTURE_COMPONENT pOdtEntryAddr LongPointer_Measurement_UByte 60272 ADDRESS_TYPE PLONG SYMBOL_TYPE_LINK "pOdtEntryAddr" /end STRUCTURE_COMPONENT
 /begin STRUCTURE_COMPONENT pOdtEntrySize Measurement_UByte_Copy1 60276 ADDRESS_TYPE PLONG SYMBOL_TYPE_LINK "pOdtEntrySize" /end STRUCTURE_COMPONENT
 /begin STRUCTURE_COMPONENT DaqListPtr Measurement_UWord 60280 SYMBOL_TYPE_LINK "DaqListPtr" /end STRUCTURE_COMPONENT
 /begin STRUCTURE_COMPONENT OdtPtr Measurement_UWord 60282 SYMBOL_TYPE_LINK "OdtPtr" /end STRUCTURE_COMPONENT
/end TYPEDEF_STRUCTURE
/begin TYPEDEF_STRUCTURE _unnamed_union_ "" 0xFC SYMBOL_TYPE_LINK "<unnamed-union>{CompileUnit:xcpLite_c}{Namespace:Global}"
 /begin STRUCTURE_COMPONENT b Measurement_UByte_Copy1 0 SYMBOL_TYPE_LINK "b" MATRIX_DIM 252 /end STRUCTURE_COMPONENT
 /begin STRUCTURE_COMPONENT dw Measurement_ULong 0 SYMBOL_TYPE_LINK "dw" MATRIX_DIM 63 /end STRUCTURE_COMPONENT
 /begin STRUCTURE_COMPONENT w Measurement_UWord 0 SYMBOL_TYPE_LINK "w" MATRIX_DIM 126 /end STRUCTURE_COMPONENT
/end TYPEDEF_STRUCTURE
/begin TYPEDEF_STRUCTURE ecu "" 0x10 SYMBOL_TYPE_LINK "ecu" /begin STRUCTURE_COMPONENT counter Measurement_ULong 0 SYMBOL_TYPE_LINK "counter" /end STRUCTURE_COMPONENT
 /begin STRUCTURE_COMPONENT pCounter Measurement_ULong 4 ADDRESS_TYPE PLONG SYMBOL_TYPE_LINK "pCounter" /end STRUCTURE_COMPONENT
 /begin STRUCTURE_COMPONENT byte Measurement_UByte_Copy1 8 SYMBOL_TYPE_LINK "byte" /end STRUCTURE_COMPONENT
 /begin STRUCTURE_COMPONENT word Measurement_UWord 10 SYMBOL_TYPE_LINK "word" /end STRUCTURE_COMPONENT
 /begin STRUCTURE_COMPONENT dword Measurement_ULong 12 SYMBOL_TYPE_LINK "dword" /end STRUCTURE_COMPONENT
/end TYPEDEF_STRUCTURE
/begin TYPEDEF_STRUCTURE in_addr "" 0x4 SYMBOL_TYPE_LINK "in_addr" /begin STRUCTURE_COMPONENT s_addr Parameter_ULong 0 SYMBOL_TYPE_LINK "s_addr" /end STRUCTURE_COMPONENT /end TYPEDEF_STRUCTURE
/begin TYPEDEF_STRUCTURE sockaddr_in "" 0x10 SYMBOL_TYPE_LINK "sockaddr_in" /begin STRUCTURE_COMPONENT sin_family Parameter_UWord 0 SYMBOL_TYPE_LINK "sin_family" /end STRUCTURE_COMPONENT /begin STRUCTURE_COMPONENT sin_port Parameter_UWord 2 SYMBOL_TYPE_LINK "sin_port" /end STRUCTURE_COMPONENT /begin STRUCTURE_COMPONENT sin_addr in_addr 4 SYMBOL_TYPE_LINK "sin_addr" /end STRUCTURE_COMPONENT
 /begin STRUCTURE_COMPONENT sin_zero Parameter_UByte 8 SYMBOL_TYPE_LINK "sin_zero" MATRIX_DIM 8 /end STRUCTURE_COMPONENT
/end TYPEDEF_STRUCTURE
/begin TYPEDEF_STRUCTURE tXcpCto "" 0xFC SYMBOL_TYPE_LINK "tXcpCto"
 /begin STRUCTURE_COMPONENT b Measurement_UByte_Copy1 0 SYMBOL_TYPE_LINK "b" MATRIX_DIM 252 /end STRUCTURE_COMPONENT
 /begin STRUCTURE_COMPONENT dw Measurement_ULong 0 SYMBOL_TYPE_LINK "dw" MATRIX_DIM 63 /end STRUCTURE_COMPONENT
 /begin STRUCTURE_COMPONENT w Measurement_UWord 0 SYMBOL_TYPE_LINK "w" MATRIX_DIM 126 /end STRUCTURE_COMPONENT
/end TYPEDEF_STRUCTURE
/begin TYPEDEF_STRUCTURE tXcpDaq "" 0xEA66 SYMBOL_TYPE_LINK "tXcpDaq"
 /begin STRUCTURE_COMPONENT DaqCount Measurement_UByte_Copy1 0 SYMBOL_TYPE_LINK "DaqCount" /end STRUCTURE_COMPONENT
 /begin STRUCTURE_COMPONENT OdtCount Measurement_UWord 2 SYMBOL_TYPE_LINK "OdtCount" /end STRUCTURE_COMPONENT
 /begin STRUCTURE_COMPONENT OdtEntryCount Measurement_UWord 4 SYMBOL_TYPE_LINK "OdtEntryCount" /end STRUCTURE_COMPONENT
 /begin STRUCTURE_COMPONENT u _unnamed_union_ 6 SYMBOL_TYPE_LINK "u" /end STRUCTURE_COMPONENT
/end TYPEDEF_STRUCTURE
/begin TYPEDEF_STRUCTURE tXcpDaqList "" 0x6 SYMBOL_TYPE_LINK "tXcpDaqList" /begin STRUCTURE_COMPONENT lastOdt Measurement_UWord 0 SYMBOL_TYPE_LINK "lastOdt" /end STRUCTURE_COMPONENT /begin STRUCTURE_COMPONENT firstOdt Measurement_UWord 2 SYMBOL_TYPE_LINK "firstOdt" /end STRUCTURE_COMPONENT /begin STRUCTURE_COMPONENT flags Measurement_UByte_Copy1 4 SYMBOL_TYPE_LINK "flags" /end STRUCTURE_COMPONENT
 /begin STRUCTURE_COMPONENT eventChannel Measurement_UByte_Copy1 5 SYMBOL_TYPE_LINK "eventChannel" /end STRUCTURE_COMPONENT
/end TYPEDEF_STRUCTURE
/begin TYPEDEF_STRUCTURE tXcpOdt "" 0x6 SYMBOL_TYPE_LINK "tXcpOdt"
 /begin STRUCTURE_COMPONENT firstOdtEntry Measurement_UWord 0 SYMBOL_TYPE_LINK "firstOdtEntry" /end STRUCTURE_COMPONENT
 /begin STRUCTURE_COMPONENT lastOdtEntry Measurement_UWord 2 SYMBOL_TYPE_LINK "lastOdtEntry" /end STRUCTURE_COMPONENT
 /begin STRUCTURE_COMPONENT size Measurement_UWord 4 SYMBOL_TYPE_LINK "size" /end STRUCTURE_COMPONENT
/end TYPEDEF_STRUCTURE
/begin MEASUREMENT BitSlice "Testsignal: 4 Bit on a byte boundary" UWORD BitSlice.CONVERSION 0 0 0 15 ECU_ADDRESS 0x2D41C FORMAT "%.3" SYMBOL_LINK "wordCounter" 0 /end MEASUREMENT
/begin MEASUREMENT BitSlice0 "Testsignal: 5 Bit" UWORD BitSlice.CONVERSION 0 0 0 31 ECU_ADDRESS 0x2D41C FORMAT "%.3" SYMBOL_LINK "wordCounter" 0 /end MEASUREMENT
/begin MEASUREMENT BitSlice1 "Testsignal: 5 Bit " UWORD BitSlice.CONVERSION 0 0 0 31 ECU_ADDRESS 0x2D41C FORMAT "%.3" SYMBOL_LINK "wordCounter" 0 /end MEASUREMENT
/begin MEASUREMENT BitSlice2 "Testsignal: 5 Bit " UWORD BitSlice.CONVERSION 0 0 0 63 ECU_ADDRESS 0x2D41D FORMAT "%.3" SYMBOL_LINK "wordCounter" 1 /end MEASUREMENT
/begin CHARACTERISTIC CALRAM_LAST "" VALUE 0x25070 __UWord_Value 0 NO_COMPU_METHOD 0 65535 FORMAT "%.15" /end CHARACTERISTIC
/begin CHARACTERISTIC CALRAM_SIGN "" VALUE 0x25074 __ULong_Value 0 NO_COMPU_METHOD 0 4294967295 FORMAT "%.15" /end CHARACTERISTIC
/begin CHARACTERISTIC CALRAM_START "" VALUE 0x251C4 __UWord_Value 0 NO_COMPU_METHOD 0 65535 FORMAT "%.15" /end CHARACTERISTIC
/begin MEASUREMENT Counter_B4 "Single bit demo signal (bit from a byte shifting)" UBYTE HighLow 0 0 0 1 ECU_ADDRESS 0x25238 FORMAT "%.3" READ_WRITE SYMBOL_LINK "byteCounter" 0 /end MEASUREMENT
/begin MEASUREMENT Counter_B5 "Single bit demo signal (bit from a byte shifting)" UBYTE HighLow 0 0 0 1 ECU_ADDRESS 0x25238 FORMAT "%.3" READ_WRITE SYMBOL_LINK "byteCounter" 0 /end MEASUREMENT
/begin MEASUREMENT Counter_B6 "Single bit demo signal (bit from a byte shifting)" UBYTE HighLow 0 0 0 1 ECU_ADDRESS 0x25238 FORMAT "%.3" READ_WRITE SYMBOL_LINK "byteCounter" 0 /end MEASUREMENT
/begin MEASUREMENT Counter_B7 "Single bit demo signal (bit from a byte shifting)" UBYTE HighLow 0 0 0 1 ECU_ADDRESS 0x25238 FORMAT "%.3" READ_WRITE SYMBOL_LINK "byteCounter" 0 /end MEASUREMENT
/begin AXIS_PTS Curve1 "Curve used as axis" 0x2509C NO_INPUT_QUANTITY __UByte_Value 0 BitSlice.CONVERSION 8 0 255 DEPOSIT ABSOLUTE FORMAT "%.3" SYMBOL_LINK "curve1_8_uc" 0 /end AXIS_PTS
/begin MEASUREMENT DtChannel1 "Time jitter of channel1" FLOAT32_IEEE DtChannel1.CONVERSIONV 0 0 0 100 FORMAT "%.3" /begin VIRTUAL channel1 /end VIRTUAL /end MEASUREMENT
/begin MEASUREMENT FW1 "Testparameter" UBYTE BitSlice.CONVERSION 0 0 0 255 ECU_ADDRESS 0x251A0 FORMAT "%.3" READ_WRITE SYMBOL_LINK "byte4" 0 /end MEASUREMENT
/begin CHARACTERISTIC KF2 "8*8 BYTE shared axis Curve1/Curve1" MAP 0x25018 MapX8Y8V88ub 0 BitSlice.CONVERSION 0 255
 /begin AXIS_DESCR COM_AXIS NO_INPUT_QUANTITY BitSlice.CONVERSION 8 0 255 AXIS_PTS_REF Curve1 FORMAT "%.3" /end AXIS_DESCR
 /begin AXIS_DESCR FIX_AXIS NO_INPUT_QUANTITY sbytePWMLevel.CONVERSION 8 0 7 FIX_AXIS_PAR_DIST 0 1 8 FORMAT "%.2" /end AXIS_DESCR
 FORMAT "%.3" SYMBOL_LINK "map1_8_8_uc" 0 /end CHARACTERISTIC
/begin CHARACTERISTIC KF3 "8*6 BYTE no axis" MAP 0x25018 MapX8Y8V88ub 0 BitSlice.CONVERSION 0 255
 /begin AXIS_DESCR FIX_AXIS NO_INPUT_QUANTITY BitSlice.CONVERSION 8 0 7 FIX_AXIS_PAR_DIST 0 1 8 FORMAT "%.0" /end AXIS_DESCR
 /begin AXIS_DESCR FIX_AXIS NO_INPUT_QUANTITY BitSlice.CONVERSION 6 0 5 FIX_AXIS_PAR_DIST 0 1 6 FORMAT "%.0" /end AXIS_DESCR
 FORMAT "%.3" SYMBOL_LINK "map1_8_8_uc" 0 /end CHARACTERISTIC
/begin CHARACTERISTIC KF4 "8*6 BYTE shared axis Curve1" MAP 0x25018 MapX8Y8V88ub 0 BitSlice.CONVERSION 0 255
 /begin AXIS_DESCR COM_AXIS NO_INPUT_QUANTITY BitSlice.CONVERSION 8 0 255 AXIS_PTS_REF Curve1 FORMAT "%.3" /end AXIS_DESCR
 /begin AXIS_DESCR FIX_AXIS NO_INPUT_QUANTITY BitSlice.CONVERSION 6 0 5 FIX_AXIS_PAR_DIST 0 1 6 FORMAT "%.0" /end AXIS_DESCR
 FORMAT "%.3" SYMBOL_LINK "map1_8_8_uc" 0 /end CHARACTERISTIC
/begin CHARACTERISTIC KF5 "8*6 BYTE memory layout MapX8Y6V86ub" MAP 0x250F8 MapX8Y6V86ub 0 BitSlice.CONVERSION 0 255
 /begin AXIS_DESCR STD_AXIS NO_INPUT_QUANTITY BitSlice.CONVERSION 8 0 255 DEPOSIT ABSOLUTE FORMAT "%.3" /end AXIS_DESCR
 /begin AXIS_DESCR STD_AXIS NO_INPUT_QUANTITY BitSlice.CONVERSION 6 0 255 DEPOSIT ABSOLUTE FORMAT "%.3" /end AXIS_DESCR
 FORMAT "%.3" SYMBOL_LINK "map4_80_uc" 0 /end CHARACTERISTIC
/begin CHARACTERISTIC KF6 "8*8 BYTE no axis" MAP 0x25018 MapV88ub 0 BitSlice.CONVERSION 0 255
 /begin AXIS_DESCR FIX_AXIS NO_INPUT_QUANTITY BitSlice.CONVERSION 8 0 7 FIX_AXIS_PAR_DIST 0 1 8 FORMAT "%.0" /end AXIS_DESCR
 /begin AXIS_DESCR FIX_AXIS NO_INPUT_QUANTITY BitSlice.CONVERSION 8 0 7 FIX_AXIS_PAR_DIST 0 1 8 FORMAT "%.0" /end AXIS_DESCR
 FORMAT "%.3" SYMBOL_LINK "map1_8_8_uc" 0 /end CHARACTERISTIC
/begin CHARACTERISTIC KF7 "8*8 BYTE memory layout MapV86ub, shared axis Curve1/Curve1" MAP 0x25148 MapV86ub 0 BitSlice.CONVERSION 0 255
 /begin AXIS_DESCR COM_AXIS NO_INPUT_QUANTITY BitSlice.CONVERSION 8 0 255 AXIS_PTS_REF Curve1 FORMAT "%.3" /end AXIS_DESCR
 /begin AXIS_DESCR FIX_AXIS NO_INPUT_QUANTITY sbytePWMLevel.CONVERSION 6 0 5 FIX_AXIS_PAR_DIST 0 1 6 FORMAT "%.2" /end AXIS_DESCR
 FORMAT "%.3" SYMBOL_LINK "map2_8_8_uc" 0 /end CHARACTERISTIC
/begin CHARACTERISTIC KL1 "16 BYTE curve" VAL_BLK 0x25058 __UByte_Value 0 BitSlice.CONVERSION 0 255 FORMAT "%.3" MATRIX_DIM 16 SYMBOL_LINK "curve5_16_uc" 0 /end CHARACTERISTIC
/begin MEASUREMENT KL1Output "Value generated from curve KL1" UBYTE BitSlice.CONVERSION 0 0 0 255 ECU_ADDRESS 0x2AE2C FORMAT "%.3" SYMBOL_LINK "curveOutput" 0 /end MEASUREMENT
/begin CHARACTERISTIC KL2 "8 BYTE shared axis Curve2" VAL_BLK 0x2509C __UByte_Value 0 BitSlice.CONVERSION 0 255 FORMAT "%.3" MATRIX_DIM 8 SYMBOL_LINK "curve1_8_uc" 0 /end CHARACTERISTIC
/begin CHARACTERISTIC KL5 "8 BYTE CurveV8ub shared axis Curve2" VAL_BLK 0x2509C CurveV8ub 0 BitSlice.CONVERSION 0 255 FORMAT "%.3" MATRIX_DIM 8 SYMBOL_LINK "curve1_8_uc" 0 /end CHARACTERISTIC
/begin MEASUREMENT MaxChannel1 "Maximum value of channel1" FLOAT32_IEEE MaxChannel1.CONVERSIONV 0 0 -100 100 FORMAT "%.3" /begin VIRTUAL channel1 /end VIRTUAL /end MEASUREMENT
/begin MEASUREMENT MinChannel1 "Minimum value of channel1" FLOAT32_IEEE MinChannel1.CONVERSIONV 0 0 -100 100 FORMAT "%.3" /begin VIRTUAL channel1 /end VIRTUAL /end MEASUREMENT
/begin MEASUREMENT PWM "Pulse width signal from PWM_level and Triangle" UBYTE HighLow 0 0 0 255 ECU_ADDRESS 0x27DA7 FORMAT "%.0" SYMBOL_LINK "bytePWM" 0 /end MEASUREMENT
/begin MEASUREMENT PWMFiltered "Low pass filtered PWM signal" UBYTE BitSlice.CONVERSION 0 0 0 255 ECU_ADDRESS 0x29337 FORMAT "%.3" SYMBOL_LINK "bytePWMFiltered" 0 /end MEASUREMENT
/begin MEASUREMENT PWM_Level "" SBYTE BitSlice.CONVERSION 0 0 -50 50 ECU_ADDRESS 0x251F4 FORMAT "%.0" READ_WRITE SYMBOL_LINK "sbytePWMLevel" 0 /end MEASUREMENT
/begin MEASUREMENT ShiftByte "" UBYTE BitSlice.CONVERSION 0 0 0 255 ECU_ADDRESS 0x2D424 FORMAT "%.3" SYMBOL_LINK "byteShift" 0 /end MEASUREMENT
/begin MEASUREMENT Shifter_B0 "Single bit demo signal (bit from a byte shifting)" UBYTE HighLow 0 0 0 1 ECU_ADDRESS 0x2D424 FORMAT "%.3" READ_WRITE SYMBOL_LINK "byteShift" 0 /end MEASUREMENT
/begin MEASUREMENT Shifter_B1 "Single bit demo signal (bit from a byte shifting)" UBYTE HighLow 0 0 0 1 ECU_ADDRESS 0x2D424 FORMAT "%.3" READ_WRITE SYMBOL_LINK "byteShift" 0 /end MEASUREMENT
/begin MEASUREMENT Shifter_B2 "Single bit demo signal (bit from a byte shifting)" UBYTE HighLow 0 0 0 1 ECU_ADDRESS 0x2D424 FORMAT "%.3" READ_WRITE SYMBOL_LINK "byteShift" 0 /end MEASUREMENT
/begin MEASUREMENT Shifter_B3 "Single bit demo signal (bit from a byte shifting)" UBYTE HighLow 0 0 0 1 ECU_ADDRESS 0x2D424 FORMAT "%.3" READ_WRITE SYMBOL_LINK "byteShift" 0 /end MEASUREMENT
/begin MEASUREMENT TestStatus "2 bit demo signal with symbolic conversion formula" UBYTE TestStatus.CONVERSION 0 0 0 3 ECU_ADDRESS 0x25238 FORMAT "%.0" READ_WRITE SYMBOL_LINK "byteCounter" 0 /end MEASUREMENT
/begin MEASUREMENT Triangle "Triangle test signal used for PWM output PWM" SBYTE BitSlice.CONVERSION 0 0 -50 50 ECU_ADDRESS 0x25D32 FORMAT "%.3" SYMBOL_LINK "sbyteTriangle" 0 /end MEASUREMENT
/begin CHARACTERISTIC a0 "Digital Filter v=(vin*a0+v*b0)/c0" VALUE 0x2506C __UWord_Value 0 DigitalFilterConversion 0 1 FORMAT "%.3" SYMBOL_LINK "a" 0 /end CHARACTERISTIC
/begin MEASUREMENT ampl "Amplitude of channel 1-3 " FLOAT32_IEEE BitSlice.CONVERSION 0 0 0 200 ECU_ADDRESS 0x2500C FORMAT "%.3" READ_WRITE /end MEASUREMENT
/begin CHARACTERISTIC b0 "Digital Filter v=(vin*a0+v*b0)/c0" VALUE 0x2506E __UWord_Value 0 DigitalFilterConversion 0 1 FORMAT "%.3" SYMBOL_LINK "b" 0 /end CHARACTERISTIC
/begin MEASUREMENT bit12Counter "Demo signal (12 bit, incrementing)" UWORD BitSlice.CONVERSION 0 0 0 4095 ECU_ADDRESS 0x2D41C FORMAT "%.3" SYMBOL_LINK "wordCounter" 0 /end MEASUREMENT
/begin MEASUREMENT byte1 "Demo, read and write possible" UBYTE BitSlice.CONVERSION 0 0 0 255 ECU_ADDRESS 0x251A3 FORMAT "%.3" READ_WRITE /end MEASUREMENT
/begin MEASUREMENT byte2 "Demo, read and write possible" UBYTE BitSlice.CONVERSION 0 0 0 255 ECU_ADDRESS 0x251A2 FORMAT "%.3" READ_WRITE /end MEASUREMENT
/begin MEASUREMENT byte3 "Demo, read and write possible" SBYTE BitSlice.CONVERSION 0 0 0 255 ECU_ADDRESS 0x251A1 FORMAT "%.3" READ_WRITE /end MEASUREMENT
/begin MEASUREMENT byte4 "Demo, read and write possible" UBYTE BitSlice.CONVERSION 0 0 0 255 ECU_ADDRESS 0x251A0 FORMAT "%.3" READ_WRITE /end MEASUREMENT
/begin CHARACTERISTIC byteArray1 "" VAL_BLK 0x272B4 __UByte_Value 0 NO_COMPU_METHOD 0 255 FORMAT "%.15" MATRIX_DIM 1400 SYMBOL_LINK "byteArray1[0]" 0 /end CHARACTERISTIC
/begin CHARACTERISTIC byteArray10 "" VAL_BLK 0x2A33C __UByte_Value 0 NO_COMPU_METHOD 0 255 FORMAT "%.15" MATRIX_DIM 1400 SYMBOL_LINK "byteArray10[0]" 0 /end CHARACTERISTIC
/begin CHARACTERISTIC byteArray11 "" VAL_BLK 0x25240 __UByte_Value 0 NO_COMPU_METHOD 0 255 FORMAT "%.15" MATRIX_DIM 1400 SYMBOL_LINK "byteArray11[0]" 0 /end CHARACTERISTIC
/begin CHARACTERISTIC byteArray12 "" VAL_BLK 0x26D3C __UByte_Value 0 NO_COMPU_METHOD 0 255 FORMAT "%.15" MATRIX_DIM 1400 SYMBOL_LINK "byteArray12[0]" 0 /end CHARACTERISTIC
/begin CHARACTERISTIC byteArray13 "" VAL_BLK 0x2D9A0 __UByte_Value 0 NO_COMPU_METHOD 0 255 FORMAT "%.15" MATRIX_DIM 1400 SYMBOL_LINK "byteArray13[0]" 0 /end CHARACTERISTIC
/begin CHARACTERISTIC byteArray14 "" VAL_BLK 0x2DF28 __UByte_Value 0 NO_COMPU_METHOD 0 255 FORMAT "%.15" MATRIX_DIM 1400 SYMBOL_LINK "byteArray14[0]" 0 /end CHARACTERISTIC
/begin CHARACTERISTIC byteArray15 "" VAL_BLK 0x2BE38 __UByte_Value 0 NO_COMPU_METHOD 0 255 FORMAT "%.15" MATRIX_DIM 1400 SYMBOL_LINK "byteArray15[0]" 0 /end CHARACTERISTIC
/begin CHARACTERISTIC byteArray16 "" VAL_BLK 0x2C92C __UByte_Value 0 NO_COMPU_METHOD 0 255 FORMAT "%.15" MATRIX_DIM 1400 SYMBOL_LINK "byteArray16[0]" 0 /end CHARACTERISTIC
/begin CHARACTERISTIC byteArray2 "" VAL_BLK 0x2C3B0 __UByte_Value 0 NO_COMPU_METHOD 0 255 FORMAT "%.15" MATRIX_DIM 1400 SYMBOL_LINK "byteArray2[0]" 0 /end CHARACTERISTIC
/begin CHARACTERISTIC byteArray3 "" VAL_BLK 0x2A8B4 __UByte_Value 0 NO_COMPU_METHOD 0 255 FORMAT "%.15" MATRIX_DIM 1400 SYMBOL_LINK "byteArray3[0]" 0 /end CHARACTERISTIC
/begin CHARACTERISTIC byteArray4 "" VAL_BLK 0x2D428 __UByte_Value 0 NO_COMPU_METHOD 0 255 FORMAT "%.15" MATRIX_DIM 1400 SYMBOL_LINK "byteArray4[0]" 0 /end CHARACTERISTIC
/begin CHARACTERISTIC byteArray5 "" VAL_BLK 0x2CEA4 __UByte_Value 0 NO_COMPU_METHOD 0 255 FORMAT "%.15" MATRIX_DIM 1400 SYMBOL_LINK "byteArray5[0]" 0 /end CHARACTERISTIC
/begin CHARACTERISTIC byteArray6 "" VAL_BLK 0x257B8 __UByte_Value 0 NO_COMPU_METHOD 0 255 FORMAT "%.15" MATRIX_DIM 1400 SYMBOL_LINK "byteArray6[0]" 0 /end CHARACTERISTIC
/begin CHARACTERISTIC byteArray7 "" VAL_BLK 0x2E4A0 __UByte_Value 0 NO_COMPU_METHOD 0 255 FORMAT "%.15" MATRIX_DIM 1400 SYMBOL_LINK "byteArray7[0]" 0 /end CHARACTERISTIC
/begin CHARACTERISTIC byteArray8 "" VAL_BLK 0x28DBC __UByte_Value 0 NO_COMPU_METHOD 0 255 FORMAT "%.15" MATRIX_DIM 1400 SYMBOL_LINK "byteArray8[0]" 0 /end CHARACTERISTIC
/begin CHARACTERISTIC byteArray9 "" VAL_BLK 0x2782C __UByte_Value 0 NO_COMPU_METHOD 0 255 FORMAT "%.15" MATRIX_DIM 1400 SYMBOL_LINK "byteArray9[0]" 0 /end CHARACTERISTIC
/begin MEASUREMENT byteCounter "Demo signal (byte, incrementing)" UBYTE BitSlice.CONVERSION 0 0 0 255 ECU_ADDRESS 0x25238 FORMAT "%.3" /end MEASUREMENT
/begin MEASUREMENT bytePWMFilter "Filter constant for PWM filter" UBYTE BitSlice.CONVERSION 0 0 0 100 ECU_ADDRESS 0x25068 FORMAT "%.3" READ_WRITE /end MEASUREMENT
/begin CHARACTERISTIC c0 "Digital Filter v=(vin*a0+v*b0)/c0" VALUE 0x2506A __UWord_Value 0 DigitalFilterConversion 0 1 FORMAT "%.3" SYMBOL_LINK "c" 0 /end CHARACTERISTIC
/begin MEASUREMENT channel1 "FLOAT demo signal (sine wave)" FLOAT32_IEEE NO_COMPU_METHOD 0 0 -1E+12 1E+12 ECU_ADDRESS 0x2AE30 FORMAT "%.3" /end MEASUREMENT
/begin MEASUREMENT channel2 "FLOAT demo signal (sine wave)" FLOAT32_IEEE NO_COMPU_METHOD 0 0 -1E+12 1E+12 ECU_ADDRESS 0x2DF1C FORMAT "%.3" /end MEASUREMENT
/begin MEASUREMENT channel3 "FLOAT demo signal (sine wave)" FLOAT32_IEEE NO_COMPU_METHOD 0 0 -100 100 ECU_ADDRESS 0x2D420 FORMAT "%.3" /end MEASUREMENT
/begin MEASUREMENT channel4 "" FLOAT32_IEEE NO_COMPU_METHOD 0 0 -3.40282346639E+38 3.40282346639E+38 ECU_ADDRESS 0x25D38 FORMAT "%.15" /end MEASUREMENT
/begin MEASUREMENT dwordCounter "Demo signal (dword, incrementing)" ULONG BitSlice.CONVERSION 0 0 0 255 ECU_ADDRESS 0x27DAC FORMAT "%.3" /end MEASUREMENT
/begin INSTANCE ecu "" ecu 0x251FC SYMBOL_LINK "gEcu" 0 /end INSTANCE
/begin INSTANCE gClientAddr "" sockaddr_in 0x2EA18 SYMBOL_LINK "gClientAddr" 0 /end INSTANCE
/begin INSTANCE gServerAddr "" sockaddr_in 0x2EA28 SYMBOL_LINK "gServerAddr" 0 /end INSTANCE
/begin CHARACTERISTIC gSocketTimeout "" VALUE 0x25200 __ULong_Value 0 NO_COMPU_METHOD 0 4294967295 /end CHARACTERISTIC
/begin CHARACTERISTIC gTaskCycleTimerECU "" VALUE 0x251D4 __ULong_Value 0 NO_COMPU_METHOD 0 4294967295 /end CHARACTERISTIC
/begin CHARACTERISTIC gTaskCycleTimerECUpp "" VALUE 0x251D8 __ULong_Value 0 NO_COMPU_METHOD 0 4294967295 /end CHARACTERISTIC
/begin INSTANCE gXcp "" _unnamed_struct_ 0x2EFF4 SYMBOL_LINK "gXcp" 0 /end INSTANCE
/begin CHARACTERISTIC gXcpDebugLevel "" VALUE 0x251E4 __UByte_Value 0 NO_COMPU_METHOD 0 255 /end CHARACTERISTIC
/begin MEASUREMENT limit "Limit for channel1" FLOAT32_IEEE BitSlice.CONVERSION 0 0 -1E+12 1E+12 ECU_ADDRESS 0x25010 FORMAT "%.3" READ_WRITE /end MEASUREMENT
/begin CHARACTERISTIC longArray1 "" VAL_BLK 0x2AE38 __ULong_Value 0 NO_COMPU_METHOD 0 255 FORMAT "%.15" MATRIX_DIM 1024 /end CHARACTERISTIC
/begin CHARACTERISTIC longArray2 "" VAL_BLK 0x29338 __ULong_Value 0 NO_COMPU_METHOD 0 255 FORMAT "%.15" MATRIX_DIM 1024 /end CHARACTERISTIC
/begin CHARACTERISTIC longArray3 "" VAL_BLK 0x27DB4 __ULong_Value 0 NO_COMPU_METHOD 0 255 FORMAT "%.15" MATRIX_DIM 1024 /end CHARACTERISTIC
/begin CHARACTERISTIC longArray4 "" VAL_BLK 0x25D3C __ULong_Value 0 NO_COMPU_METHOD 0 255 FORMAT "%.15" MATRIX_DIM 1024 /end CHARACTERISTIC
/begin CHARACTERISTIC map1 "8*8 BYTE shared axis Curve1/Curve1" MAP 0x25018 MapV88ub 0 map1Conversion 0 2550
 /begin AXIS_DESCR FIX_AXIS map1InputX map1Input_Conversion 8 -12.8 12.7 FIX_AXIS_PAR_DIST 0 1 8 FORMAT "%.3" /end AXIS_DESCR
 /begin AXIS_DESCR FIX_AXIS map1InputY map1Input_Conversion 8 -12.8 12.7 FIX_AXIS_PAR_DIST 0 1 8 FORMAT "%.3" /end AXIS_DESCR
 FORMAT "%.3" SYMBOL_LINK "map1_8_8_uc" 0 /end CHARACTERISTIC
/begin CHARACTERISTIC map1Counter "" VALUE 0x25014 __UByte_Value 0 BitSlice.CONVERSION 0 255 FORMAT "%.3" /end CHARACTERISTIC
/begin MEASUREMENT map1InputX "" UBYTE map1Input_Conversion 0 0 0 25.5 ECU_ADDRESS 0x29334 FORMAT "%.3" /end MEASUREMENT
/begin MEASUREMENT map1InputY "" UBYTE map1Input_Conversion 0 0 0 25.5 ECU_ADDRESS 0x27DA6 FORMAT "%.3" /end MEASUREMENT
/begin MEASUREMENT map1Output "" UBYTE map1Conversion 0 0 0 2550 ECU_ADDRESS 0x2DF18 FORMAT "%.3" /end MEASUREMENT
/begin CHARACTERISTIC map2 "8*8 BYTE shared axis Curve1/Curve1" MAP 0x25018 MapV88ub 0 map1Conversion 0 2550
 /begin AXIS_DESCR FIX_AXIS map1InputX map1Input_Conversion 8 -12.8 12.7 FIX_AXIS_PAR_DIST 0 1 8 FORMAT "%.3" /end AXIS_DESCR
 /begin AXIS_DESCR FIX_AXIS map1InputY map1Input_Conversion 8 -12.8 12.7 FIX_AXIS_PAR_DIST 0 1 8 FORMAT "%.3" /end AXIS_DESCR
 FORMAT "%.3" SYMBOL_LINK "map2_8_8_uc" 0 /end CHARACTERISTIC
/begin CHARACTERISTIC map4_80_uc "8*8 BYTE memory layout map4_80_uc" MAP 0x250F8 MapX8Y8V88ub 0 BitSlice.CONVERSION 0 255
 /begin AXIS_DESCR STD_AXIS NO_INPUT_QUANTITY BitSlice.CONVERSION 8 0 255 DEPOSIT ABSOLUTE FORMAT "%.3" /end AXIS_DESCR
 /begin AXIS_DESCR STD_AXIS NO_INPUT_QUANTITY BitSlice.CONVERSION 8 0 255 DEPOSIT ABSOLUTE FORMAT "%.3" /end AXIS_DESCR
 FORMAT "%.3" /end CHARACTERISTIC
/begin MEASUREMENT offset "Offset for channel1" FLOAT32_IEEE BitSlice.CONVERSION 0 0 -1E+12 1E+12 ECU_ADDRESS 0x251F0 FORMAT "%.3" READ_WRITE /end MEASUREMENT
/begin MEASUREMENT period "Period of channel 1-3" FLOAT32_IEEE BitSlice.CONVERSION 0 0 0 100 ECU_ADDRESS 0x25008 FORMAT "%.3" READ_WRITE /end MEASUREMENT
/begin MEASUREMENT sbytePWMLevel "" SBYTE sbytePWMLevel.CONVERSION 0 0 0 255 ECU_ADDRESS 0x251F4 FORMAT "%.15" /end MEASUREMENT
/begin CHARACTERISTIC testString "vcv" ASCII 0x251C8 __UByte_Value 0 NO_COMPU_METHOD 0 255 NUMBER 10 /end CHARACTERISTIC
/begin MEASUREMENT v "Digital Filter Outputvalue" UWORD DigitalFilterConversion 0 0 0 1 ECU_ADDRESS 0x27DB0 FORMAT "%.3" READ_WRITE /end MEASUREMENT
/begin MEASUREMENT vin "Digital Filter Inputvalue" UWORD DigitalFilterConversion 0 0 0 1 ECU_ADDRESS 0x28DB6 FORMAT "%.3" READ_WRITE /end MEASUREMENT
/begin MEASUREMENT wordCounter "Demo signal (word, incrementing)" UWORD BitSlice.CONVERSION 0 0 0 65535 ECU_ADDRESS 0x2D41C FORMAT "%.3" /end MEASUREMENT
/begin COMPU_METHOD BitSlice.CONVERSION "" IDENTICAL "%6.2f" "" /end COMPU_METHOD
/begin COMPU_METHOD Current "Convert Voltage into Current" FORM "%7.3" "" /begin FORMULA "X*X*2" /end FORMULA /end COMPU_METHOD
/begin COMPU_METHOD DigitalFilterConversion "" LINEAR "%3.1" "Volt" COEFFS_LINEAR 0.001 0 /end COMPU_METHOD
/begin COMPU_METHOD DtChannel1.CONVERSIONV "@@@@RuleName created by CANape" FORM "%3.1" "" /begin FORMULA "time(X1)-time(X1[-1])" /end FORMULA /end COMPU_METHOD
/begin COMPU_METHOD Factor100 "" LINEAR "%3.1" "" COEFFS_LINEAR 0.01 0 /end COMPU_METHOD
/begin COMPU_METHOD HighLow "High/Low for bits" TAB_VERB "%7.3" "" COMPU_TAB_REF HighLow /end COMPU_METHOD
/begin COMPU_METHOD KF8_Conversion "" LINEAR "%3.1" "1/min" COEFFS_LINEAR 0.1 0 /end COMPU_METHOD
/begin COMPU_METHOD MaxChannel1.CONVERSIONV "@@@@RuleName created by CANape" FORM "%3.1" "" /begin FORMULA "max(phy(X1))" /end FORMULA /end COMPU_METHOD
/begin COMPU_METHOD MinChannel1.CONVERSIONV "@@@@RuleName created by CANape" FORM "%3.1" "" /begin FORMULA "min(phy(X1))" /end FORMULA /end COMPU_METHOD
/begin COMPU_METHOD Pressure "Convert Voltage into Pressure" LINEAR "%7.3" "" COEFFS_LINEAR 0.123457 0 /end COMPU_METHOD
/begin COMPU_METHOD TestStatus.CONVERSION "" TAB_VERB "%3.1" "" COMPU_TAB_REF TestStatus.CONVERSION /end COMPU_METHOD
/begin COMPU_METHOD map1Conversion "" LINEAR "%3.1" "cm" COEFFS_LINEAR 10 0 /end COMPU_METHOD
/begin COMPU_METHOD map1Input_Conversion "" LINEAR "%3.1" "m" COEFFS_LINEAR 0.1 0 /end COMPU_METHOD
/begin COMPU_METHOD sbytePWMLevel.CONVERSION "" IDENTICAL "%6.2" "" /end COMPU_METHOD
/begin COMPU_VTAB HighLow "High/Low for bits" TAB_VERB 2 0 "Low" 1 "High" DEFAULT_VALUE "" /end COMPU_VTAB
/begin COMPU_VTAB TestStatus.CONVERSION "" TAB_VERB 4 0 "Off" 1 "Silent" 2 "Pending" 3 "Running" DEFAULT_VALUE "" /end COMPU_VTAB
/begin RECORD_LAYOUT CurveNxVub AXIS_PTS_X 1 UBYTE INDEX_INCR DIRECT FNC_VALUES 2 UBYTE ROW_DIR DIRECT /end RECORD_LAYOUT
/begin RECORD_LAYOUT CurveNxXVub NO_AXIS_PTS_X 1 UBYTE AXIS_PTS_X 2 UBYTE INDEX_INCR DIRECT FNC_VALUES 3 UBYTE ROW_DIR DIRECT /end RECORD_LAYOUT
/begin RECORD_LAYOUT CurveV8ub FNC_VALUES 1 UBYTE ROW_DIR DIRECT FIX_NO_AXIS_PTS_X 8 /end RECORD_LAYOUT
/begin RECORD_LAYOUT CurveX8V8ub AXIS_PTS_X 1 UBYTE INDEX_INCR DIRECT FNC_VALUES 2 UBYTE ROW_DIR DIRECT FIX_NO_AXIS_PTS_X 8 /end RECORD_LAYOUT
/begin RECORD_LAYOUT CurveX8V8ubAlternate AXIS_PTS_X 1 UWORD INDEX_INCR DIRECT FNC_VALUES 2 UWORD ALTERNATE_WITH_X DIRECT FIX_NO_AXIS_PTS_X 8 /end RECORD_LAYOUT
/begin RECORD_LAYOUT CurveX8ub AXIS_PTS_X 1 UBYTE INDEX_INCR DIRECT FIX_NO_AXIS_PTS_X 8 /end RECORD_LAYOUT
/begin RECORD_LAYOUT MapNxNyVub NO_AXIS_PTS_X 1 UBYTE NO_AXIS_PTS_Y 2 UBYTE FNC_VALUES 3 UBYTE ROW_DIR DIRECT /end RECORD_LAYOUT
/begin RECORD_LAYOUT MapNxNyXYVsb NO_AXIS_PTS_X 1 SBYTE NO_AXIS_PTS_Y 2 SBYTE AXIS_PTS_X 3 SBYTE INDEX_INCR DIRECT AXIS_PTS_Y 4 SBYTE INDEX_INCR DIRECT FNC_VALUES 5 SBYTE ROW_DIR DIRECT ALIGNMENT_BYTE 1 /end RECORD_LAYOUT
/begin RECORD_LAYOUT MapNxNyXYVub NO_AXIS_PTS_X 1 UBYTE NO_AXIS_PTS_Y 2 UBYTE AXIS_PTS_X 3 UBYTE INDEX_INCR DIRECT AXIS_PTS_Y 4 UBYTE INDEX_INCR DIRECT FNC_VALUES 5 UBYTE ROW_DIR DIRECT /end RECORD_LAYOUT
/begin RECORD_LAYOUT MapNxXNyYVuc NO_AXIS_PTS_X 1 UBYTE AXIS_PTS_X 2 UBYTE INDEX_INCR DIRECT NO_AXIS_PTS_Y 3 UBYTE AXIS_PTS_Y 4 UBYTE INDEX_INCR DIRECT FNC_VALUES 5 UBYTE ROW_DIR DIRECT /end RECORD_LAYOUT
/begin RECORD_LAYOUT MapV86ub FNC_VALUES 1 UBYTE ROW_DIR DIRECT FIX_NO_AXIS_PTS_X 8 FIX_NO_AXIS_PTS_Y 6 /end RECORD_LAYOUT
/begin RECORD_LAYOUT MapV88ub FNC_VALUES 1 UBYTE ROW_DIR DIRECT FIX_NO_AXIS_PTS_X 8 FIX_NO_AXIS_PTS_Y 8 /end RECORD_LAYOUT
/begin RECORD_LAYOUT MapX8Y6V86ub AXIS_PTS_X 1 UBYTE INDEX_INCR DIRECT AXIS_PTS_Y 2 UBYTE INDEX_INCR DIRECT FNC_VALUES 3 UBYTE ROW_DIR DIRECT FIX_NO_AXIS_PTS_X 8 FIX_NO_AXIS_PTS_Y 6 /end RECORD_LAYOUT
/begin RECORD_LAYOUT MapX8Y8V88ub AXIS_PTS_X 1 UBYTE INDEX_INCR DIRECT AXIS_PTS_Y 2 UBYTE INDEX_INCR DIRECT FNC_VALUES 3 UBYTE ROW_DIR DIRECT FIX_NO_AXIS_PTS_X 8 FIX_NO_AXIS_PTS_Y 8 /end RECORD_LAYOUT
/begin RECORD_LAYOUT MapXYVub AXIS_PTS_X 1 UBYTE INDEX_INCR DIRECT AXIS_PTS_Y 2 UBYTE INDEX_INCR DIRECT FNC_VALUES 3 UBYTE ROW_DIR DIRECT /end RECORD_LAYOUT
/begin RECORD_LAYOUT __UByte_Value FNC_VALUES 1 UBYTE ROW_DIR DIRECT /end RECORD_LAYOUT
/begin RECORD_LAYOUT __ULong_Value FNC_VALUES 1 ULONG ROW_DIR DIRECT /end RECORD_LAYOUT
/begin RECORD_LAYOUT __UWord_Value FNC_VALUES 1 UWORD ROW_DIR DIRECT /end RECORD_LAYOUT
/begin GROUP Axis "Shared Axis for Calibration Maps" ROOT /begin REF_CHARACTERISTIC Curve1 /end REF_CHARACTERISTIC /end GROUP
/begin GROUP Bits "Single Bit Values"
 /begin REF_MEASUREMENT Counter_B4 Counter_B5 Counter_B6 Counter_B7 ShiftByte Shifter_B0 Shifter_B1 Shifter_B2 Shifter_B3 /end REF_MEASUREMENT
/end GROUP
/begin GROUP Bitslices "Multibit Values"
 /begin REF_MEASUREMENT BitSlice BitSlice0 BitSlice1 BitSlice2 TestStatus bit12Counter /end REF_MEASUREMENT
/end GROUP
/begin GROUP Curves "Calibration Curves" ROOT /begin REF_CHARACTERISTIC KL1 KL2 KL5 /end REF_CHARACTERISTIC /end GROUP
/begin GROUP Example_Double "Kommentar" ROOT /end GROUP
/begin GROUP Example_Filter "Digital Filter v=(vin*a0+v*b0)/c0" ROOT /begin REF_CHARACTERISTIC a0 b0 c0 /end REF_CHARACTERISTIC /begin REF_MEASUREMENT v vin /end REF_MEASUREMENT /end GROUP
/begin GROUP Example_PWM "Generator for a PWM Signal" ROOT /begin SUB_GROUP PWM_Parameters PWM_Signals /end SUB_GROUP /end GROUP
/begin GROUP Maps "Calibration Maps" ROOT /begin REF_CHARACTERISTIC KF2 KF3 KF4 KF5 KF6 KF7 map4_80_uc /end REF_CHARACTERISTIC /begin SUB_GROUP WorkingPoint /end SUB_GROUP /end GROUP
/begin GROUP Measure "Measurement Values" ROOT /begin REF_MEASUREMENT KL1Output channel1 channel2 channel3 channel4 /end REF_MEASUREMENT /begin SUB_GROUP Bits Bitslices Test_Signals /end SUB_GROUP /end GROUP
/begin GROUP PWM_Parameters "Parametes for PWM Example" /begin REF_MEASUREMENT FW1 PWM_Level bytePWMFilter sbytePWMLevel /end REF_MEASUREMENT /end GROUP
/begin GROUP PWM_Signals "Measurement Signals from PWM" /begin REF_MEASUREMENT PWM PWMFiltered Triangle /end REF_MEASUREMENT /end GROUP
/begin GROUP Parameters "Calibration Parameters" ROOT /begin REF_CHARACTERISTIC testString /end REF_CHARACTERISTIC /begin REF_MEASUREMENT ampl limit offset period /end REF_MEASUREMENT /begin SUB_GROUP Test_Parameters /end SUB_GROUP /end GROUP
/begin GROUP Test_Parameters "Test Parameters, BYTE"
 /begin REF_CHARACTERISTIC CALRAM_LAST CALRAM_SIGN CALRAM_START gDebugLevel gTaskCycleTimerCMD gTaskCycleTimerDAQ gTaskCycleTimerECU gTaskCycleTimerECUpp /end REF_CHARACTERISTIC
/end GROUP
/begin GROUP Test_Signals "Test Signals" /begin REF_CHARACTERISTIC longArray1 longArray2 longArray3 longArray4 /end REF_CHARACTERISTIC
 /begin REF_MEASUREMENT byte1 byte2 byte3 byte4 byteCounter dwordCounter wordCounter /end REF_MEASUREMENT
/end GROUP
/begin GROUP Virtual "Virtual Signal" ROOT /begin REF_MEASUREMENT DtChannel1 MaxChannel1 MinChannel1 /end REF_MEASUREMENT /end GROUP
/begin GROUP WorkingPoint "Example for working point" /begin REF_CHARACTERISTIC map1 map1Counter /end REF_CHARACTERISTIC /begin REF_MEASUREMENT map1InputX map1InputY map1Output /end REF_MEASUREMENT /end GROUP
/begin GROUP cplusplus "" /begin REF_MEASUREMENT ecu /end REF_MEASUREMENT /end GROUP
/end MODULE
/end PROJECT
