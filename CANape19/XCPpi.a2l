/* generated by ASAP2 Studio 2.2.5.8070 */
/* @@@@ File written by CANAPE_VERSION 18 0 30 @@@@ */ ASAP2_VERSION 1 71
/begin PROJECT XCPpi "RaspberryPi XCP demo"
/begin HEADER "" VERSION "1.0" /end HEADER
/begin MODULE RaspberryPi4 ""
/begin MOD_PAR ""
 /begin MEMORY_SEGMENT CALRAM "" VARIABLES RAM INTERN 0x25014 0xDF -1 -1 -1 -1 -1
  /begin IF_DATA XCP
   /begin SEGMENT 0xFF 0x01 0x00 0x00 0x00
    /begin PAGE 0x00 ECU_ACCESS_DONT_CARE XCP_READ_ACCESS_DONT_CARE XCP_WRITE_ACCESS_DONT_CARE INIT_SEGMENT 0x00 /end PAGE
    /begin ADDRESS_MAPPING 0x025014 0x025014 0xDF /end ADDRESS_MAPPING
    /begin ADDRESS_MAPPING 0x025014 0x00 0xDF /end ADDRESS_MAPPING
   /end SEGMENT
  /end IF_DATA
 /end MEMORY_SEGMENT
/end MOD_PAR
/begin MOD_COMMON "" BYTE_ORDER MSB_LAST ALIGNMENT_BYTE 1 ALIGNMENT_WORD 1 ALIGNMENT_LONG 1 ALIGNMENT_FLOAT16_IEEE 1 ALIGNMENT_FLOAT32_IEEE 1 ALIGNMENT_FLOAT64_IEEE 1 ALIGNMENT_INT64 1 /end MOD_COMMON
/begin IF_DATA XCP
 /begin PROTOCOL_LAYER 0x0101 0x03E8 0x2710 0x00 0x00 0x00 0x00 0x00 0xFA 0x0574 BYTE_ORDER_MSB_LAST ADDRESS_GRANULARITY_BYTE OPTIONAL_CMD ALLOC_ODT_ENTRY OPTIONAL_CMD ALLOC_ODT OPTIONAL_CMD ALLOC_DAQ OPTIONAL_CMD FREE_DAQ OPTIONAL_CMD GET_DAQ_RESOLUTION_INFO OPTIONAL_CMD GET_DAQ_PROCESSOR_INFO OPTIONAL_CMD GET_DAQ_CLOCK OPTIONAL_CMD START_STOP_SYNCH OPTIONAL_CMD START_STOP_DAQ_LIST OPTIONAL_CMD GET_DAQ_LIST_MODE OPTIONAL_CMD SET_DAQ_LIST_MODE OPTIONAL_CMD WRITE_DAQ OPTIONAL_CMD SET_DAQ_PTR OPTIONAL_CMD CLEAR_DAQ_LIST OPTIONAL_CMD DOWNLOAD OPTIONAL_CMD UPLOAD OPTIONAL_CMD SET_MTA OPTIONAL_CMD GET_COMM_MODE_INFO /end PROTOCOL_LAYER
 /begin DAQ DYNAMIC 0x00 0x02 0x00 OPTIMISATION_TYPE_DEFAULT ADDRESS_EXTENSION_FREE IDENTIFICATION_FIELD_TYPE_RELATIVE_BYTE GRANULARITY_ODT_ENTRY_SIZE_DAQ_BYTE 0x6E OVERLOAD_INDICATION_PID /begin TIMESTAMP_SUPPORTED 0x01 SIZE_DWORD UNIT_1US TIMESTAMP_FIXED /end TIMESTAMP_SUPPORTED /begin EVENT "Event1" "Event1" 0x01 DAQ 0xFF 0x01 0x06 0x00 /end EVENT /begin EVENT "Event2" "Event2" 0x02 DAQ 0xFF 0x01 0x06 0x00 /end EVENT /end DAQ
 /begin PAG 0x01 /end PAG
 /begin PGM PGM_MODE_ABSOLUTE 0x00 0x00 /end PGM
 /begin XCP_ON_TCP_IP 0x0100 0x15B3 ADDRESS "127.0.0.1" /end XCP_ON_TCP_IP
 /begin XCP_ON_UDP_IP 0x0100 0x15B3 ADDRESS "172.31.31.194" /end XCP_ON_UDP_IP
/end IF_DATA
/begin TYPEDEF_MEASUREMENT Measurement_UByte "" UBYTE NO_COMPU_METHOD 0 0 0 255 /end TYPEDEF_MEASUREMENT
/begin TYPEDEF_MEASUREMENT Measurement_ULong "" ULONG NO_COMPU_METHOD 0 0 0 4294967295 /end TYPEDEF_MEASUREMENT
/begin TYPEDEF_MEASUREMENT Measurement_UWord "" UWORD NO_COMPU_METHOD 0 0 0 65535 /end TYPEDEF_MEASUREMENT
/begin TYPEDEF_STRUCTURE ecu "" 0xC SYMBOL_TYPE_LINK "ecu" /begin STRUCTURE_COMPONENT counter Measurement_UWord 0 SYMBOL_TYPE_LINK "counter" /end STRUCTURE_COMPONENT /begin STRUCTURE_COMPONENT byte Measurement_UByte 2 SYMBOL_TYPE_LINK "byte" /end STRUCTURE_COMPONENT /begin STRUCTURE_COMPONENT word Measurement_UWord 4 SYMBOL_TYPE_LINK "word" /end STRUCTURE_COMPONENT /begin STRUCTURE_COMPONENT dword Measurement_ULong 8 SYMBOL_TYPE_LINK "dword" /end STRUCTURE_COMPONENT /end TYPEDEF_STRUCTURE
/begin CHARACTERISTIC CALRAM_LAST "" VALUE 0x2501C __UWord_Value 0 NO_COMPU_METHOD 0 65535 FORMAT "%.15" /end CHARACTERISTIC
/begin CHARACTERISTIC CALRAM_SIGN "" VALUE 0x25020 __ULong_Value 0 NO_COMPU_METHOD 0 4294967295 FORMAT "%.15" /end CHARACTERISTIC
/begin CHARACTERISTIC CALRAM_START "" VALUE 0x25188 __UWord_Value 0 NO_COMPU_METHOD 0 65535 FORMAT "%.15" /end CHARACTERISTIC
/begin MEASUREMENT PWM "Pulse width signal from PWM_level and Triangle" UBYTE HighLow 0 0 0 255 ECU_ADDRESS 0x32D76 FORMAT "%.0" SYMBOL_LINK "bytePWM" 0 /end MEASUREMENT
/begin MEASUREMENT PWMFiltered "Low pass filtered PWM signal" UBYTE BitSlice.CONVERSION 0 0 0 255 ECU_ADDRESS 0x342FD FORMAT "%.3" SYMBOL_LINK "bytePWMFiltered" 0 /end MEASUREMENT
/begin MEASUREMENT PWM_Level "" SBYTE BitSlice.CONVERSION 0 0 -50 50 ECU_ADDRESS 0x251C8 FORMAT "%.0" READ_WRITE SYMBOL_LINK "sbytePWMLevel" 0 /end MEASUREMENT
/begin MEASUREMENT Triangle "Triangle test signal used for PWM output PWM" SBYTE BitSlice.CONVERSION 0 0 -50 50 ECU_ADDRESS 0x30D02 FORMAT "%.3" SYMBOL_LINK "sbyteTriangle" 0 /end MEASUREMENT
/begin CHARACTERISTIC a0 "Digital Filter v=(vin*a0+v*b0)/c0" VALUE 0x25018 __UWord_Value 0 DigitalFilterConversion 0 1 FORMAT "%.3" SYMBOL_LINK "a" 0 /end CHARACTERISTIC
/begin MEASUREMENT ampl "Amplitude of channel 1-3 " FLOAT32_IEEE NO_COMPU_METHOD 0 0 0 200 ECU_ADDRESS 0x2500C FORMAT "%.3" READ_WRITE /end MEASUREMENT
/begin CHARACTERISTIC b0 "Digital Filter v=(vin*a0+v*b0)/c0" VALUE 0x2501A __UWord_Value 0 DigitalFilterConversion 0 1 FORMAT "%.3" SYMBOL_LINK "b" 0 /end CHARACTERISTIC
/begin MEASUREMENT byte1 "Demo, read and write possible" UBYTE NO_COMPU_METHOD 0 0 0 255 ECU_ADDRESS 0x25167 FORMAT "%.3" READ_WRITE /end MEASUREMENT
/begin MEASUREMENT byte2 "Demo, read and write possible" UBYTE NO_COMPU_METHOD 0 0 0 255 ECU_ADDRESS 0x25166 FORMAT "%.3" READ_WRITE /end MEASUREMENT
/begin MEASUREMENT byte3 "Demo, read and write possible" SBYTE NO_COMPU_METHOD 0 0 0 255 ECU_ADDRESS 0x25165 FORMAT "%.3" READ_WRITE /end MEASUREMENT
/begin MEASUREMENT byte4 "Demo, read and write possible" UBYTE NO_COMPU_METHOD 0 0 0 255 ECU_ADDRESS 0x25164 FORMAT "%.3" READ_WRITE /end MEASUREMENT
/begin CHARACTERISTIC byteArray1 "" VAL_BLK 0x32284 __UByte_Value 0 NO_COMPU_METHOD 0 255 FORMAT "%.15" MATRIX_DIM 1400 /end CHARACTERISTIC
/begin CHARACTERISTIC byteArray10 "" VAL_BLK 0x35300 __UByte_Value 0 NO_COMPU_METHOD 0 255 FORMAT "%.15" MATRIX_DIM 1400 /end CHARACTERISTIC
/begin CHARACTERISTIC byteArray11 "" VAL_BLK 0x30210 __UByte_Value 0 NO_COMPU_METHOD 0 255 FORMAT "%.15" MATRIX_DIM 1400 /end CHARACTERISTIC
/begin CHARACTERISTIC byteArray12 "" VAL_BLK 0x31D0C __UByte_Value 0 NO_COMPU_METHOD 0 255 FORMAT "%.15" MATRIX_DIM 1400 /end CHARACTERISTIC
/begin CHARACTERISTIC byteArray13 "" VAL_BLK 0x38960 __UByte_Value 0 NO_COMPU_METHOD 0 255 FORMAT "%.15" MATRIX_DIM 1400 /end CHARACTERISTIC
/begin CHARACTERISTIC byteArray14 "" VAL_BLK 0x38EE8 __UByte_Value 0 NO_COMPU_METHOD 0 255 FORMAT "%.15" MATRIX_DIM 1400 /end CHARACTERISTIC
/begin CHARACTERISTIC byteArray15 "" VAL_BLK 0x36DFC __UByte_Value 0 NO_COMPU_METHOD 0 255 FORMAT "%.15" MATRIX_DIM 1400 /end CHARACTERISTIC
/begin CHARACTERISTIC byteArray16 "" VAL_BLK 0x378F0 __UByte_Value 0 NO_COMPU_METHOD 0 255 FORMAT "%.15" MATRIX_DIM 1400 /end CHARACTERISTIC
/begin CHARACTERISTIC byteArray2 "" VAL_BLK 0x37374 __UByte_Value 0 NO_COMPU_METHOD 0 255 FORMAT "%.15" MATRIX_DIM 1400 /end CHARACTERISTIC
/begin CHARACTERISTIC byteArray3 "" VAL_BLK 0x35878 __UByte_Value 0 NO_COMPU_METHOD 0 255 FORMAT "%.15" MATRIX_DIM 1400 /end CHARACTERISTIC
/begin CHARACTERISTIC byteArray4 "" VAL_BLK 0x383E8 __UByte_Value 0 NO_COMPU_METHOD 0 255 FORMAT "%.15" MATRIX_DIM 1400 /end CHARACTERISTIC
/begin CHARACTERISTIC byteArray5 "" VAL_BLK 0x37E68 __UByte_Value 0 NO_COMPU_METHOD 0 255 FORMAT "%.15" MATRIX_DIM 1400 /end CHARACTERISTIC
/begin CHARACTERISTIC byteArray6 "" VAL_BLK 0x30788 __UByte_Value 0 NO_COMPU_METHOD 0 255 FORMAT "%.15" MATRIX_DIM 1400 /end CHARACTERISTIC
/begin CHARACTERISTIC byteArray7 "" VAL_BLK 0x39460 __UByte_Value 0 NO_COMPU_METHOD 0 255 FORMAT "%.15" MATRIX_DIM 1400 /end CHARACTERISTIC
/begin CHARACTERISTIC byteArray8 "" VAL_BLK 0x33D84 __UByte_Value 0 NO_COMPU_METHOD 0 255 FORMAT "%.15" MATRIX_DIM 1400 /end CHARACTERISTIC
/begin CHARACTERISTIC byteArray9 "" VAL_BLK 0x327FC __UByte_Value 0 NO_COMPU_METHOD 0 255 FORMAT "%.15" MATRIX_DIM 1400 /end CHARACTERISTIC
/begin MEASUREMENT byteCounter "Demo signal (byte, incrementing)" UBYTE NO_COMPU_METHOD 0 0 0 255 ECU_ADDRESS 0x3020C FORMAT "%.3" /end MEASUREMENT
/begin MEASUREMENT bytePWMFilter "Filter constant for PWM filter" UBYTE BitSlice.CONVERSION 0 0 0 100 ECU_ADDRESS 0x25014 FORMAT "%.3" READ_WRITE /end MEASUREMENT
/begin CHARACTERISTIC c0 "Digital Filter v=(vin*a0+v*b0)/c0" VALUE 0x25016 __UWord_Value 0 DigitalFilterConversion 0 1 FORMAT "%.3" SYMBOL_LINK "c" 0 /end CHARACTERISTIC
/begin MEASUREMENT channel1 "FLOAT demo signal (sine wave)" FLOAT32_IEEE NO_COMPU_METHOD 0 0 -1E+12 1E+12 ECU_ADDRESS 0x35DF4 FORMAT "%.3" /end MEASUREMENT
/begin MEASUREMENT channel2 "FLOAT demo signal (sine wave)" FLOAT32_IEEE NO_COMPU_METHOD 0 0 -1E+12 1E+12 ECU_ADDRESS 0x38EDC FORMAT "%.3" /end MEASUREMENT
/begin MEASUREMENT channel3 "FLOAT demo signal (sine wave)" FLOAT32_IEEE NO_COMPU_METHOD 0 0 -100 100 ECU_ADDRESS 0x383E4 FORMAT "%.3" /end MEASUREMENT
/begin MEASUREMENT channel4 "" FLOAT32_IEEE NO_COMPU_METHOD 0 0 -3.40282346639E+38 3.40282346639E+38 ECU_ADDRESS 0x30D08 FORMAT "%.15" /end MEASUREMENT
/begin MEASUREMENT counter "" UWORD NO_COMPU_METHOD 0 0 0 65535 ECU_ADDRESS 0x251C0 /end MEASUREMENT
/begin MEASUREMENT dto_buffer_ptr "" UBYTE NO_COMPU_METHOD 0 0 0 255 ADDRESS_TYPE PLONG ECU_ADDRESS 0x25204 /end MEASUREMENT
/begin MEASUREMENT dto_queue_len "" ULONG NO_COMPU_METHOD 0 0 0 4294967295 ECU_ADDRESS 0x251E4 /end MEASUREMENT
/begin MEASUREMENT dto_queue_rp "" ULONG NO_COMPU_METHOD 0 0 0 4294967295 ECU_ADDRESS 0x25200 /end MEASUREMENT
/begin MEASUREMENT dwordCounter "Demo signal (dword, incrementing)" ULONG BitSlice.CONVERSION 0 0 0 255 ECU_ADDRESS 0x32D78 FORMAT "%.3" /end MEASUREMENT
/begin INSTANCE ecu "" ecu 0x0 /end INSTANCE
/begin CHARACTERISTIC gCmdCycle "" VALUE 0x251A0 __ULong_Value 0 NO_COMPU_METHOD 0 4294967295 /end CHARACTERISTIC
/begin CHARACTERISTIC gSocketTimeout "" VALUE 0x251D0 __ULong_Value 0 NO_COMPU_METHOD 0 4294967295 /end CHARACTERISTIC
/begin CHARACTERISTIC gTaskCycle "" VALUE 0x251B0 __ULong_Value 0 NO_COMPU_METHOD 0 4294967295 /end CHARACTERISTIC
/begin CHARACTERISTIC gTaskCycleTimerECU "" VALUE 0x251A8 __ULong_Value 0 NO_COMPU_METHOD 0 4294967295 /end CHARACTERISTIC
/begin CHARACTERISTIC gTaskCycleTimerECUpp "" VALUE 0x251AC __ULong_Value 0 NO_COMPU_METHOD 0 4294967295 /end CHARACTERISTIC
/begin CHARACTERISTIC gTaskCycleTimerServer "" VALUE 0x2519C __ULong_Value 0 NO_COMPU_METHOD 0 4294967295 /end CHARACTERISTIC
/begin CHARACTERISTIC gXcpDebugLevel "" VALUE 0x251B4 __UByte_Value 0 NO_COMPU_METHOD 0 255 /end CHARACTERISTIC
/begin CHARACTERISTIC gXcpStationId "" VALUE 0x14008 __UByte_Value 0 NO_COMPU_METHOD 0 255 /end CHARACTERISTIC
/begin MEASUREMENT limit "Limit for channel1" FLOAT32_IEEE NO_COMPU_METHOD 0 0 -1E+12 1E+12 ECU_ADDRESS 0x25010 FORMAT "%.3" READ_WRITE /end MEASUREMENT
/begin CHARACTERISTIC longArray1 "" VAL_BLK 0x35DFC __ULong_Value 0 NO_COMPU_METHOD 0 255 FORMAT "%.15" MATRIX_DIM 1024 /end CHARACTERISTIC
/begin CHARACTERISTIC longArray2 "" VAL_BLK 0x34300 __ULong_Value 0 NO_COMPU_METHOD 0 255 FORMAT "%.15" MATRIX_DIM 1024 /end CHARACTERISTIC
/begin CHARACTERISTIC longArray3 "" VAL_BLK 0x32D80 __ULong_Value 0 NO_COMPU_METHOD 0 255 FORMAT "%.15" MATRIX_DIM 1024 /end CHARACTERISTIC
/begin CHARACTERISTIC longArray4 "" VAL_BLK 0x30D0C __ULong_Value 0 NO_COMPU_METHOD 0 255 FORMAT "%.15" MATRIX_DIM 1024 /end CHARACTERISTIC
/begin CHARACTERISTIC map1 "8*8 BYTE shared axis Curve1/Curve1" MAP 0x25108 MapV88ub 0 map1Conversion 0 2550
 /begin AXIS_DESCR FIX_AXIS map1InputX map1Input_Conversion 8 -12.8 12.7 FIX_AXIS_PAR_DIST 0 1 8 FORMAT "%.3" /end AXIS_DESCR
 /begin AXIS_DESCR FIX_AXIS map1InputY map1Input_Conversion 8 -12.8 12.7 FIX_AXIS_PAR_DIST 0 1 8 FORMAT "%.3" /end AXIS_DESCR
 FORMAT "%.3" SYMBOL_LINK "map1_8_8_uc" 0 /end CHARACTERISTIC
/begin CHARACTERISTIC map2 "8*8 BYTE shared axis Curve1/Curve1" MAP 0x250C8 MapV88ub 0 map1Conversion 0 2550
 /begin AXIS_DESCR FIX_AXIS map1InputX map1Input_Conversion 8 -12.8 12.7 FIX_AXIS_PAR_DIST 0 1 8 FORMAT "%.3" /end AXIS_DESCR
 /begin AXIS_DESCR FIX_AXIS map1InputY map1Input_Conversion 8 -12.8 12.7 FIX_AXIS_PAR_DIST 0 1 8 FORMAT "%.3" /end AXIS_DESCR
 FORMAT "%.3" SYMBOL_LINK "map2_8_8_uc" 0 /end CHARACTERISTIC
/begin MEASUREMENT offset "Offset for channel1" FLOAT32_IEEE NO_COMPU_METHOD 0 0 -1E+12 1E+12 ECU_ADDRESS 0x251C4 FORMAT "%.3" READ_WRITE /end MEASUREMENT
/begin MEASUREMENT period "Period of channel 1-3" FLOAT32_IEEE NO_COMPU_METHOD 0 0 0 100 ECU_ADDRESS 0x25008 FORMAT "%.3" READ_WRITE /end MEASUREMENT
/begin MEASUREMENT sbytePWMLevel "" SBYTE sbytePWMLevel.CONVERSION 0 0 0 255 ECU_ADDRESS 0x251C8 FORMAT "%.15" /end MEASUREMENT
/begin CHARACTERISTIC testString "vcv" ASCII 0x2518C __UByte_Value 0 NO_COMPU_METHOD 0 255 NUMBER 10 /end CHARACTERISTIC
/begin MEASUREMENT v "Digital Filter Outputvalue" UWORD DigitalFilterConversion 0 0 0 1 ECU_ADDRESS 0x32D7C FORMAT "%.3" READ_WRITE /end MEASUREMENT
/begin MEASUREMENT vin "Digital Filter Inputvalue" UWORD DigitalFilterConversion 0 0 0 1 ECU_ADDRESS 0x33D80 FORMAT "%.3" READ_WRITE /end MEASUREMENT
/begin MEASUREMENT wordCounter "Demo signal (word, incrementing)" UWORD NO_COMPU_METHOD 0 0 0 65535 ECU_ADDRESS 0x383E0 FORMAT "%.3" /end MEASUREMENT
/begin COMPU_METHOD BitSlice.CONVERSION "" IDENTICAL "%6.2f" "" /end COMPU_METHOD
/begin COMPU_METHOD Current "Convert Voltage into Current" FORM "%7.3" "" /begin FORMULA "X*X*2" /end FORMULA /end COMPU_METHOD
/begin COMPU_METHOD DigitalFilterConversion "" LINEAR "%3.1" "Volt" COEFFS_LINEAR 0.001 0 /end COMPU_METHOD
/begin COMPU_METHOD DtChannel1.CONVERSIONV "@@@@RuleName created by CANape" FORM "%3.1" "" /begin FORMULA "time(X1)-time(X1[-1])" /end FORMULA /end COMPU_METHOD
/begin COMPU_METHOD Factor100 "" LINEAR "%3.1" "" COEFFS_LINEAR 0.01 0 /end COMPU_METHOD
/begin COMPU_METHOD HighLow "High/Low for bits" TAB_VERB "%7.3" "" COMPU_TAB_REF HighLow /end COMPU_METHOD
/begin COMPU_METHOD KF8_Conversion "" LINEAR "%3.1" "1/min" COEFFS_LINEAR 0.1 0 /end COMPU_METHOD
/begin COMPU_METHOD MaxChannel1.CONVERSIONV "@@@@RuleName created by CANape" FORM "%3.1" "" /begin FORMULA "max(phy(X1))" /end FORMULA /end COMPU_METHOD
/begin COMPU_METHOD MinChannel1.CONVERSIONV "@@@@RuleName created by CANape" FORM "%3.1" "" /begin FORMULA "min(phy(X1))" /end FORMULA /end COMPU_METHOD
/begin COMPU_METHOD Pressure "Convert Voltage into Pressure" LINEAR "%7.3" "" COEFFS_LINEAR 0.123457 0 /end COMPU_METHOD
/begin COMPU_METHOD TestStatus.CONVERSION "" TAB_VERB "%3.1" "" COMPU_TAB_REF TestStatus.CONVERSION /end COMPU_METHOD
/begin COMPU_METHOD map1Conversion "" LINEAR "%3.1" "cm" COEFFS_LINEAR 10 0 /end COMPU_METHOD
/begin COMPU_METHOD map1Input_Conversion "" LINEAR "%3.1" "m" COEFFS_LINEAR 0.1 0 /end COMPU_METHOD
/begin COMPU_METHOD sbytePWMLevel.CONVERSION "" IDENTICAL "%6.2" "" /end COMPU_METHOD
/begin COMPU_VTAB HighLow "High/Low for bits" TAB_VERB 2 0 "Low" 1 "High" DEFAULT_VALUE "" /end COMPU_VTAB
/begin COMPU_VTAB TestStatus.CONVERSION "" TAB_VERB 4 0 "Off" 1 "Silent" 2 "Pending" 3 "Running" DEFAULT_VALUE "" /end COMPU_VTAB
/begin RECORD_LAYOUT CurveNxVub AXIS_PTS_X 1 UBYTE INDEX_INCR DIRECT FNC_VALUES 2 UBYTE ROW_DIR DIRECT /end RECORD_LAYOUT
/begin RECORD_LAYOUT CurveNxXVub NO_AXIS_PTS_X 1 UBYTE AXIS_PTS_X 2 UBYTE INDEX_INCR DIRECT FNC_VALUES 3 UBYTE ROW_DIR DIRECT /end RECORD_LAYOUT
/begin RECORD_LAYOUT CurveV8ub FNC_VALUES 1 UBYTE ROW_DIR DIRECT FIX_NO_AXIS_PTS_X 8 /end RECORD_LAYOUT
/begin RECORD_LAYOUT CurveX8V8ub AXIS_PTS_X 1 UBYTE INDEX_INCR DIRECT FNC_VALUES 2 UBYTE ROW_DIR DIRECT FIX_NO_AXIS_PTS_X 8 /end RECORD_LAYOUT
/begin RECORD_LAYOUT CurveX8V8ubAlternate AXIS_PTS_X 1 UWORD INDEX_INCR DIRECT FNC_VALUES 2 UWORD ALTERNATE_WITH_X DIRECT FIX_NO_AXIS_PTS_X 8 /end RECORD_LAYOUT
/begin RECORD_LAYOUT CurveX8ub AXIS_PTS_X 1 UBYTE INDEX_INCR DIRECT FIX_NO_AXIS_PTS_X 8 /end RECORD_LAYOUT
/begin RECORD_LAYOUT MapNxNyVub NO_AXIS_PTS_X 1 UBYTE NO_AXIS_PTS_Y 2 UBYTE FNC_VALUES 3 UBYTE ROW_DIR DIRECT /end RECORD_LAYOUT
/begin RECORD_LAYOUT MapNxNyXYVsb NO_AXIS_PTS_X 1 SBYTE NO_AXIS_PTS_Y 2 SBYTE AXIS_PTS_X 3 SBYTE INDEX_INCR DIRECT AXIS_PTS_Y 4 SBYTE INDEX_INCR DIRECT FNC_VALUES 5 SBYTE ROW_DIR DIRECT ALIGNMENT_BYTE 1 /end RECORD_LAYOUT
/begin RECORD_LAYOUT MapNxNyXYVub NO_AXIS_PTS_X 1 UBYTE NO_AXIS_PTS_Y 2 UBYTE AXIS_PTS_X 3 UBYTE INDEX_INCR DIRECT AXIS_PTS_Y 4 UBYTE INDEX_INCR DIRECT FNC_VALUES 5 UBYTE ROW_DIR DIRECT /end RECORD_LAYOUT
/begin RECORD_LAYOUT MapNxXNyYVuc NO_AXIS_PTS_X 1 UBYTE AXIS_PTS_X 2 UBYTE INDEX_INCR DIRECT NO_AXIS_PTS_Y 3 UBYTE AXIS_PTS_Y 4 UBYTE INDEX_INCR DIRECT FNC_VALUES 5 UBYTE ROW_DIR DIRECT /end RECORD_LAYOUT
/begin RECORD_LAYOUT MapV86ub FNC_VALUES 1 UBYTE ROW_DIR DIRECT FIX_NO_AXIS_PTS_X 8 FIX_NO_AXIS_PTS_Y 6 /end RECORD_LAYOUT
/begin RECORD_LAYOUT MapV88ub FNC_VALUES 1 UBYTE ROW_DIR DIRECT FIX_NO_AXIS_PTS_X 8 FIX_NO_AXIS_PTS_Y 8 /end RECORD_LAYOUT
/begin RECORD_LAYOUT MapX8Y6V86ub AXIS_PTS_X 1 UBYTE INDEX_INCR DIRECT AXIS_PTS_Y 2 UBYTE INDEX_INCR DIRECT FNC_VALUES 3 UBYTE ROW_DIR DIRECT FIX_NO_AXIS_PTS_X 8 FIX_NO_AXIS_PTS_Y 6 /end RECORD_LAYOUT
/begin RECORD_LAYOUT MapX8Y8V88ub AXIS_PTS_X 1 UBYTE INDEX_INCR DIRECT AXIS_PTS_Y 2 UBYTE INDEX_INCR DIRECT FNC_VALUES 3 UBYTE ROW_DIR DIRECT FIX_NO_AXIS_PTS_X 8 FIX_NO_AXIS_PTS_Y 8 /end RECORD_LAYOUT
/begin RECORD_LAYOUT MapXYVub AXIS_PTS_X 1 UBYTE INDEX_INCR DIRECT AXIS_PTS_Y 2 UBYTE INDEX_INCR DIRECT FNC_VALUES 3 UBYTE ROW_DIR DIRECT /end RECORD_LAYOUT
/begin RECORD_LAYOUT __UByte_Value FNC_VALUES 1 UBYTE ROW_DIR DIRECT /end RECORD_LAYOUT
/begin RECORD_LAYOUT __ULong_Value FNC_VALUES 1 ULONG ROW_DIR DIRECT /end RECORD_LAYOUT
/begin RECORD_LAYOUT __UWord_Value FNC_VALUES 1 UWORD ROW_DIR DIRECT /end RECORD_LAYOUT
/begin GROUP Example_Filter "Digital Filter v=(vin*a0+v*b0)/c0" /begin REF_MEASUREMENT v vin /end REF_MEASUREMENT /begin SUB_GROUP Filter_Parameters /end SUB_GROUP /end GROUP
/begin GROUP Example_PWM "Generator for a PWM Signal" /begin REF_MEASUREMENT PWM PWMFiltered Triangle /end REF_MEASUREMENT /begin SUB_GROUP PWM_Parameters /end SUB_GROUP /end GROUP
/begin GROUP Filter_Parameters "" /begin REF_CHARACTERISTIC a0 b0 c0 /end REF_CHARACTERISTIC /end GROUP
/begin GROUP PWM_Parameters "Parametes for PWM Example" /begin REF_MEASUREMENT FW1 PWM_Level bytePWMFilter sbytePWMLevel /end REF_MEASUREMENT /end GROUP
/begin GROUP TaskECU ""
 /begin REF_CHARACTERISTIC byteArray1 byteArray10 byteArray11 byteArray12 byteArray13 byteArray14 byteArray15 byteArray16 byteArray2 byteArray3 byteArray4 byteArray5 byteArray6 byteArray7 byteArray8 byteArray9 longArray1 longArray2 longArray3 longArray4 /end REF_CHARACTERISTIC
 /begin REF_MEASUREMENT ampl byte1 byte2 byte3 byte4 byteCounter channel1 channel2 channel3 channel4 counter limit offset period wordCounter /end REF_MEASUREMENT
 /begin SUB_GROUP Example_Filter Example_PWM /end SUB_GROUP
/end GROUP
/begin GROUP TaskECUpp "" /begin REF_MEASUREMENT ecu /end REF_MEASUREMENT /end GROUP
/begin GROUP Test_Parameters "Test Parameters, BYTE"
 /begin REF_CHARACTERISTIC CALRAM_LAST CALRAM_SIGN CALRAM_START gCmdCycle gDebugLevel gSocketTimeout gTaskCycle gTaskCycleTimerCMD gTaskCycleTimerDAQ gTaskCycleTimerECU gTaskCycleTimerECUpp gTaskCycleTimerServer gXcpDebugLevel gXcpDebugLevel_Copy1 gXcpStationId /end REF_CHARACTERISTIC
/end GROUP
/begin GROUP Test_Signals "Test Signals" /begin REF_MEASUREMENT dto_buffer_ptr dto_queue_len dto_queue_rp dwordCounter /end REF_MEASUREMENT /end GROUP
/end MODULE
/end PROJECT
