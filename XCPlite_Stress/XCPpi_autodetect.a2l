/* generated by XCPlite */ ASAP2_VERSION 1 71
/begin PROJECT XCPlite ""
/begin HEADER "" VERSION "1.0" /end HEADER
/begin MODULE XCPlite ""
/include "XCP_104.aml"
/begin MOD_COMMON "" BYTE_ORDER MSB_LAST ALIGNMENT_BYTE 1 ALIGNMENT_WORD 1 ALIGNMENT_LONG 1 ALIGNMENT_FLOAT16_IEEE 1 ALIGNMENT_FLOAT32_IEEE 1 ALIGNMENT_FLOAT64_IEEE 1 ALIGNMENT_INT64 1 /end MOD_COMMON
/begin IF_DATA XCP
 /begin PROTOCOL_LAYER 0x0103 0x03E8 0x2710 0x00 0x00 0x00 0x00 0x00 0xFA 0x0574 BYTE_ORDER_MSB_LAST ADDRESS_GRANULARITY_BYTE OPTIONAL_CMD GET_COMM_MODE_INFO /end PROTOCOL_LAYER
 /begin DAQ DYNAMIC 0x00 0x03 0x00 OPTIMISATION_TYPE_DEFAULT ADDRESS_EXTENSION_FREE IDENTIFICATION_FIELD_TYPE_RELATIVE_BYTE GRANULARITY_ODT_ENTRY_SIZE_DAQ_BYTE 0xF8 OVERLOAD_INDICATION_PID /begin TIMESTAMP_SUPPORTED 0x01 SIZE_DWORD UNIT_1US TIMESTAMP_FIXED /end TIMESTAMP_SUPPORTED /begin EVENT "ECU" "ECU" 0x1 DAQ 0xFF 0x01 0x06 0x00 /end EVENT /begin EVENT "ECUPP" "ECUPP" 0x2 DAQ 0xFF 0x01 0x06 0x00 /end EVENT /begin EVENT "ECUPPEXT" "ECUPPEXT" 0x3 DAQ 0xFF 0x01 0x06 0x00 /end EVENT /end DAQ
 /begin PAG 0x00 /end PAG
 /begin PGM PGM_MODE_ABSOLUTE 0x00 0x00 /end PGM
 /begin XCP_ON_UDP_IP 0x0103 0x15B3 ADDRESS "172.31.31.194" /end XCP_ON_UDP_IP
/end IF_DATA
/begin CHARACTERISTIC gCmdCycle "Command handler cycle time" VALUE 0x2709C _ULONG 0 NO_COMPU_METHOD 0 4294967295 PHYS_UNIT "us" /end CHARACTERISTIC
/begin CHARACTERISTIC gFlushCycle "Flush cycle time" VALUE 0x270A0 _ULONG 0 NO_COMPU_METHOD 0 4294967295 PHYS_UNIT "us" /end CHARACTERISTIC
/begin CHARACTERISTIC gTaskCycleTimerECU "ECU cycle time (ns delay)" VALUE 0x270A4 _ULONG 0 NO_COMPU_METHOD 0 4294967295 PHYS_UNIT "ns" /end CHARACTERISTIC
/begin CHARACTERISTIC gTaskCycleTimerECUpp "ECU cycle time (ns delay)" VALUE 0x270A8 _ULONG 0 NO_COMPU_METHOD 0 4294967295 PHYS_UNIT "ns" /end CHARACTERISTIC
/begin CHARACTERISTIC gTaskCycleTimerServer "Server loop cycle time (ns delay)" VALUE 0x27098 _ULONG 0 NO_COMPU_METHOD 0 4294967295 PHYS_UNIT "ns" /end CHARACTERISTIC
/begin CHARACTERISTIC gXcpDebugLevel "Debug verbosity" VALUE 0x270AC _UBYTE 0 NO_COMPU_METHOD 0 255 PHYS_UNIT "" /end CHARACTERISTIC
/begin CHARACTERISTIC gExit "Quit application" VALUE 0x270CC _UBYTE 0 NO_COMPU_METHOD 0 255 PHYS_UNIT "" /end CHARACTERISTIC
/begin GROUP Test_Parameters ""
 /begin REF_CHARACTERISTIC gCmdCycle gFlushCycle gTaskCycleTimerECU gTaskCycleTimerECUpp gTaskCycleTimerServer gXcpDebugLevel gExit /end REF_CHARACTERISTIC
/end GROUP
/begin MEASUREMENT ecuCounter "" UWORD NO_COMPU_METHOD 0 0 0 65535 ECU_ADDRESS 0x270C4
 /begin IF_DATA XCP
  /begin DAQ_EVENT FIXED_EVENT_LIST EVENT 0x1 /end DAQ_EVENT
 /end IF_DATA
/end MEASUREMENT
/begin COMPU_METHOD timer_COMPU_METHOD "" LINEAR "%6.3" "s" COEFFS_LINEAR 1 0 /end COMPU_METHOD
/begin MEASUREMENT timer "Time in s" FLOAT64_IEEE timer_COMPU_METHOD 0 0 -1E12 1E12 ECU_ADDRESS 0x380F8
 /begin IF_DATA XCP
  /begin DAQ_EVENT FIXED_EVENT_LIST EVENT 0x1 /end DAQ_EVENT
 /end IF_DATA
/end MEASUREMENT
/begin COMPU_METHOD channel1_COMPU_METHOD "" LINEAR "%6.3" "Volt" COEFFS_LINEAR 1 1 /end COMPU_METHOD
/begin MEASUREMENT channel1 "Demo floating point signal" FLOAT64_IEEE channel1_COMPU_METHOD 0 0 -1E12 1E12 ECU_ADDRESS 0x380F0
 /begin IF_DATA XCP
  /begin DAQ_EVENT FIXED_EVENT_LIST EVENT 0x1 /end DAQ_EVENT
 /end IF_DATA
/end MEASUREMENT
/begin CHARACTERISTIC ampl "Amplitude" VALUE 0x27018 _FLOAT64_IEEE 0 NO_COMPU_METHOD -1E12 1E12 PHYS_UNIT "V" /end CHARACTERISTIC
/begin CHARACTERISTIC period "Period" VALUE 0x27020 _FLOAT64_IEEE 0 NO_COMPU_METHOD -1E12 1E12 PHYS_UNIT "s" /end CHARACTERISTIC
/begin CHARACTERISTIC map1_8_8 "8*8 byte calibration array" MAP 0x27028 _UBYTE 0 NO_COMPU_METHOD 0 255
 /begin AXIS_DESCR FIX_AXIS NO_INPUT_QUANTITY NO_COMPU_METHOD 8 0 7 FIX_AXIS_PAR_DIST 0 1 8 /end AXIS_DESCR
 /begin AXIS_DESCR FIX_AXIS NO_INPUT_QUANTITY NO_COMPU_METHOD 8 0 7 FIX_AXIS_PAR_DIST 0 1 8 /end AXIS_DESCR
 PHYS_UNIT "" CHARACTERISTIC curve1_32 "32 byte calibration array" MAP 0x27068 _UBYTE 0 NO_COMPU_METHOD 0 255
 /begin AXIS_DESCR FIX_AXIS NO_INPUT_QUANTITY NO_COMPU_METHOD 32 0 31 FIX_AXIS_PAR_DIST 0 1 32 /end AXIS_DESCR
 /begin AXIS_DESCR FIX_AXIS NO_INPUT_QUANTITY NO_COMPU_METHOD 1 0 0 FIX_AXIS_PAR_DIST 0 1 1 /end AXIS_DESCR
 PHYS_UNIT "" MEASUREMENT byteCounter "" UBYTE NO_COMPU_METHOD 0 0 0 255 ECU_ADDRESS 0x32520
 /begin IF_DATA XCP
  /begin DAQ_EVENT FIXED_EVENT_LIST EVENT 0x1 /end DAQ_EVENT
 /end IF_DATA
 /begin MEASUREMENT wordCounter "" UWORD NO_COMPU_METHOD 0 0 0 65535 ECU_ADDRESS 0x3A6E0
  /begin IF_DATA XCP
   /begin DAQ_EVENT FIXED_EVENT_LIST EVENT 0x1 /end DAQ_EVENT
  /end IF_DATA
 /end MEASUREMENT
 /begin MEASUREMENT dwordCounter "" ULONG NO_COMPU_METHOD 0 0 0 4294967295 ECU_ADDRESS 0x35080
  /begin IF_DATA XCP
   /begin DAQ_EVENT FIXED_EVENT_LIST EVENT 0x1 /end DAQ_EVENT
  /end IF_DATA
 /end MEASUREMENT
 /begin MEASUREMENT sbyteCounter "" SBYTE NO_COMPU_METHOD 0 0 -128 127 ECU_ADDRESS 0x3B1D4
  /begin IF_DATA XCP
   /begin DAQ_EVENT FIXED_EVENT_LIST EVENT 0x1 /end DAQ_EVENT
  /end IF_DATA
 /end MEASUREMENT
 /begin MEASUREMENT swordCounter "" SWORD NO_COMPU_METHOD 0 0 -32768 32767 ECU_ADDRESS 0x33014
  /begin IF_DATA XCP
   /begin DAQ_EVENT FIXED_EVENT_LIST EVENT 0x1 /end DAQ_EVENT
  /end IF_DATA
 /end MEASUREMENT
 /begin MEASUREMENT sdwordCounter "" SLONG NO_COMPU_METHOD 0 0 -2147483648 2147483647 ECU_ADDRESS 0x3B1D8
  /begin IF_DATA XCP
   /begin DAQ_EVENT FIXED_EVENT_LIST EVENT 0x1 /end DAQ_EVENT
  /end IF_DATA
 /end MEASUREMENT
 /begin CHARACTERISTIC byteArray1 "" VAL_BLK 0x34590 _UBYTE 0 NO_COMPU_METHOD 0 255 MATRIX_DIM 1400
  /begin IF_DATA XCP
   /begin DAQ_EVENT FIXED_EVENT_LIST EVENT 0x1 /end DAQ_EVENT
  /end IF_DATA
 /end CHARACTERISTIC
 /begin CHARACTERISTIC byteArray2 "" VAL_BLK 0x39678 _UBYTE 0 NO_COMPU_METHOD 0 255 MATRIX_DIM 1400
  /begin IF_DATA XCP
   /begin DAQ_EVENT FIXED_EVENT_LIST EVENT 0x1 /end DAQ_EVENT
  /end IF_DATA
 /end CHARACTERISTIC
 /begin CHARACTERISTIC byteArray3 "" VAL_BLK 0x37B74 _UBYTE 0 NO_COMPU_METHOD 0 255 MATRIX_DIM 1400
  /begin IF_DATA XCP
   /begin DAQ_EVENT FIXED_EVENT_LIST EVENT 0x1 /end DAQ_EVENT
  /end IF_DATA
 /end CHARACTERISTIC
 /begin CHARACTERISTIC byteArray4 "" VAL_BLK 0x3A6E4 _UBYTE 0 NO_COMPU_METHOD 0 255 MATRIX_DIM 1400
  /begin IF_DATA XCP
   /begin DAQ_EVENT FIXED_EVENT_LIST EVENT 0x1 /end DAQ_EVENT
  /end IF_DATA
 /end CHARACTERISTIC
 /begin CHARACTERISTIC byteArray5 "" VAL_BLK 0x3A168 _UBYTE 0 NO_COMPU_METHOD 0 255 MATRIX_DIM 1400
  /begin IF_DATA XCP
   /begin DAQ_EVENT FIXED_EVENT_LIST EVENT 0x1 /end DAQ_EVENT
  /end IF_DATA
 /end CHARACTERISTIC
 /begin CHARACTERISTIC byteArray6 "" VAL_BLK 0x32A9C _UBYTE 0 NO_COMPU_METHOD 0 255 MATRIX_DIM 1400
  /begin IF_DATA XCP
   /begin DAQ_EVENT FIXED_EVENT_LIST EVENT 0x1 /end DAQ_EVENT
  /end IF_DATA
 /end CHARACTERISTIC
 /begin CHARACTERISTIC byteArray7 "" VAL_BLK 0x3B754 _UBYTE 0 NO_COMPU_METHOD 0 255 MATRIX_DIM 1400
  /begin IF_DATA XCP
   /begin DAQ_EVENT FIXED_EVENT_LIST EVENT 0x1 /end DAQ_EVENT
  /end IF_DATA
 /end CHARACTERISTIC
 /begin CHARACTERISTIC byteArray8 "" VAL_BLK 0x36084 _UBYTE 0 NO_COMPU_METHOD 0 255 MATRIX_DIM 1400
  /begin IF_DATA XCP
   /begin DAQ_EVENT FIXED_EVENT_LIST EVENT 0x1 /end DAQ_EVENT
  /end IF_DATA
 /end CHARACTERISTIC
 /begin CHARACTERISTIC byteArray9 "" VAL_BLK 0x34B08 _UBYTE 0 NO_COMPU_METHOD 0 255 MATRIX_DIM 1400
  /begin IF_DATA XCP
   /begin DAQ_EVENT FIXED_EVENT_LIST EVENT 0x1 /end DAQ_EVENT
  /end IF_DATA
 /end CHARACTERISTIC
 /begin CHARACTERISTIC byteArray10 "" VAL_BLK 0x375FC _UBYTE 0 NO_COMPU_METHOD 0 255 MATRIX_DIM 1400
  /begin IF_DATA XCP
   /begin DAQ_EVENT FIXED_EVENT_LIST EVENT 0x1 /end DAQ_EVENT
  /end IF_DATA
 /end CHARACTERISTIC
 /begin CHARACTERISTIC byteArray11 "" VAL_BLK 0x32524 _UBYTE 0 NO_COMPU_METHOD 0 255 MATRIX_DIM 1400
  /begin IF_DATA XCP
   /begin DAQ_EVENT FIXED_EVENT_LIST EVENT 0x1 /end DAQ_EVENT
  /end IF_DATA
 /end CHARACTERISTIC
 /begin CHARACTERISTIC byteArray12 "" VAL_BLK 0x34018 _UBYTE 0 NO_COMPU_METHOD 0 255 MATRIX_DIM 1400
  /begin IF_DATA XCP
   /begin DAQ_EVENT FIXED_EVENT_LIST EVENT 0x1 /end DAQ_EVENT
  /end IF_DATA
 /end CHARACTERISTIC
 /begin CHARACTERISTIC byteArray13 "" VAL_BLK 0x3AC5C _UBYTE 0 NO_COMPU_METHOD 0 255 MATRIX_DIM 1400
  /begin IF_DATA XCP
   /begin DAQ_EVENT FIXED_EVENT_LIST EVENT 0x1 /end DAQ_EVENT
  /end IF_DATA
 /end CHARACTERISTIC
 /begin CHARACTERISTIC byteArray14 "" VAL_BLK 0x3B1DC _UBYTE 0 NO_COMPU_METHOD 0 255 MATRIX_DIM 1400
  /begin IF_DATA XCP
   /begin DAQ_EVENT FIXED_EVENT_LIST EVENT 0x1 /end DAQ_EVENT
  /end IF_DATA
 /end CHARACTERISTIC
 /begin CHARACTERISTIC byteArray15 "" VAL_BLK 0x39100 _UBYTE 0 NO_COMPU_METHOD 0 255 MATRIX_DIM 1400
  /begin IF_DATA XCP
   /begin DAQ_EVENT FIXED_EVENT_LIST EVENT 0x1 /end DAQ_EVENT
  /end IF_DATA
 /end CHARACTERISTIC
 /begin CHARACTERISTIC byteArray16 "" VAL_BLK 0x39BF0 _UBYTE 0 NO_COMPU_METHOD 0 255 MATRIX_DIM 1400
  /begin IF_DATA XCP
   /begin DAQ_EVENT FIXED_EVENT_LIST EVENT 0x1 /end DAQ_EVENT
  /end IF_DATA
 /end CHARACTERISTIC
 /begin CHARACTERISTIC longArray1 "" VAL_BLK 0x38100 _ULONG 0 NO_COMPU_METHOD 0 4294967295 MATRIX_DIM 1024
  /begin IF_DATA XCP
   /begin DAQ_EVENT FIXED_EVENT_LIST EVENT 0x1 /end DAQ_EVENT
  /end IF_DATA
 /end CHARACTERISTIC
 /begin CHARACTERISTIC longArray2 "" VAL_BLK 0x365FC _ULONG 0 NO_COMPU_METHOD 0 4294967295 MATRIX_DIM 1024
  /begin IF_DATA XCP
   /begin DAQ_EVENT FIXED_EVENT_LIST EVENT 0x1 /end DAQ_EVENT
  /end IF_DATA
 /end CHARACTERISTIC
 /begin CHARACTERISTIC longArray3 "" VAL_BLK 0x35084 _ULONG 0 NO_COMPU_METHOD 0 4294967295 MATRIX_DIM 1024
  /begin IF_DATA XCP
   /begin DAQ_EVENT FIXED_EVENT_LIST EVENT 0x1 /end DAQ_EVENT
  /end IF_DATA
 /end CHARACTERISTIC
 /begin CHARACTERISTIC longArray4 "" VAL_BLK 0x33018 _ULONG 0 NO_COMPU_METHOD 0 4294967295 MATRIX_DIM 1024
  /begin IF_DATA XCP
   /begin DAQ_EVENT FIXED_EVENT_LIST EVENT 0x1 /end DAQ_EVENT
  /end IF_DATA
 /end CHARACTERISTIC
 /begin GROUP Arrays ""
  /begin REF_CHARACTERISTIC byteArray1 byteArray2 byteArray3 byteArray4 byteArray5 byteArray6 byteArray7 byteArray8 byteArray9 byteArray10 byteArray11 byteArray12 byteArray13 byteArray14 byteArray15 byteArray16 longArray1 longArray2 longArray3 longArray4 /end REF_CHARACTERISTIC
 /end GROUP
 /begin TYPEDEF_STRUCTURE ecu "class ecu" 0x4 SYMBOL_TYPE_LINK "ecu"
  /begin STRUCTURE_COMPONENT dummy_structure_component _ULONG 0 SYMBOL_TYPE_LINK "dummy_symbol_type_link" /end STRUCTURE_COMPONENT
 /end TYPEDEF_STRUCTURE
 /begin MEASUREMENT gEcu.ecuppCounter "" UWORD NO_COMPU_METHOD 0 0 0 65535 ECU_ADDRESS 0x18D81D0
  /begin IF_DATA XCP
   /begin DAQ_EVENT FIXED_EVENT_LIST EVENT 0x2 /end DAQ_EVENT
  /end IF_DATA
 /end MEASUREMENT
 /begin MEASUREMENT ecu.ecuppCounter "" UWORD NO_COMPU_METHOD 0 0 0 65535 ECU_ADDRESS 0x0
  /begin IF_DATA XCP
   /begin DAQ_EVENT FIXED_EVENT_LIST EVENT 0x3 /end DAQ_EVENT
  /end IF_DATA
 /end MEASUREMENT
 /begin MEASUREMENT ecu.byte "" UBYTE NO_COMPU_METHOD 0 0 0 255 ECU_ADDRESS 0x0
  /begin IF_DATA XCP
   /begin DAQ_EVENT FIXED_EVENT_LIST EVENT 0x3 /end DAQ_EVENT
  /end IF_DATA
 /end MEASUREMENT
 /begin MEASUREMENT ecu.word "" UWORD NO_COMPU_METHOD 0 0 0 65535 ECU_ADDRESS 0x0
  /begin IF_DATA XCP
   /begin DAQ_EVENT FIXED_EVENT_LIST EVENT 0x3 /end DAQ_EVENT
  /end IF_DATA
 /end MEASUREMENT
 /begin MEASUREMENT ecu.dword "" ULONG NO_COMPU_METHOD 0 0 0 4294967295 ECU_ADDRESS 0x0
  /begin IF_DATA XCP
   /begin DAQ_EVENT FIXED_EVENT_LIST EVENT 0x3 /end DAQ_EVENT
  /end IF_DATA
 /end MEASUREMENT
 /begin RECORD_LAYOUT _SLONG FNC_VALUES 1 SLONG ROW_DIR DIRECT /end RECORD_LAYOUT
 /begin RECORD_LAYOUT _SWORD FNC_VALUES 1 SWORD ROW_DIR DIRECT /end RECORD_LAYOUT
 /begin RECORD_LAYOUT _SBYTE FNC_VALUES 1 SBYTE ROW_DIR DIRECT /end RECORD_LAYOUT
 /begin RECORD_LAYOUT _UBYTE FNC_VALUES 1 UBYTE ROW_DIR DIRECT /end RECORD_LAYOUT
 /begin RECORD_LAYOUT _UWORD FNC_VALUES 1 UWORD ROW_DIR DIRECT /end RECORD_LAYOUT
 /begin RECORD_LAYOUT _ULONG FNC_VALUES 1 ULONG ROW_DIR DIRECT /end RECORD_LAYOUT
 /begin RECORD_LAYOUT _FLOAT64_IEEE FNC_VALUES 1 FLOAT64_IEEE ROW_DIR DIRECT /end RECORD_LAYOUT
 /begin TYPEDEF_MEASUREMENT _SLONG "" SLONG NO_COMPU_METHOD 0 0 -2147483648 2147483647 /end TYPEDEF_MEASUREMENT
 /begin TYPEDEF_MEASUREMENT _SWORD "" SWORD NO_COMPU_METHOD 0 0 -32768 32767 /end TYPEDEF_MEASUREMENT
 /begin TYPEDEF_MEASUREMENT _SBYTE "" SBYTE NO_COMPU_METHOD 0 0 -128 127 /end TYPEDEF_MEASUREMENT
 /begin TYPEDEF_MEASUREMENT _UBYTE "" UBYTE NO_COMPU_METHOD 0 0 0 255 /end TYPEDEF_MEASUREMENT
 /begin TYPEDEF_MEASUREMENT _UWORD "" UWORD NO_COMPU_METHOD 0 0 0 65535 /end TYPEDEF_MEASUREMENT
 /begin TYPEDEF_MEASUREMENT _ULONG "" ULONG NO_COMPU_METHOD 0 0 0 4294967295 /end TYPEDEF_MEASUREMENT
 /begin TYPEDEF_MEASUREMENT _FLOAT64_IEEE "" FLOAT64_IEEE NO_COMPU_METHOD 0 0 -1E12 1E12 /end TYPEDEF_MEASUREMENT
/end CHARACTERISTIC
/end MODULE
/end PROJECT
