/*
CSM_X07 V12 (C) 2013-2020 CSM GmbH, Filderstadt, Germany
*/
ASAP2_VERSION 1 70
/begin PROJECT CSM "D:\\USR\\RaspberryPi\\XCPlite\\CANape19\\CSM.a2l"
/begin MODULE XCPGateway "XCPGateway"
/begin MOD_PAR "" VERSION "8.14.0.9368" USER "visza" ECU "XCP-Gateway" CPU_TYPE "Xilinx Spartan 3" /end MOD_PAR
/begin IF_DATA XCPplus 0x0104
 /begin PROTOCOL_LAYER 0x0104 /* XCP protocol layer version: 1.4 */ 10000 /* T1 = 10000ms = 10.0s */ 1000 /* T2 = 1000ms = 1.0s */ 0x00 /* T3 = 0ms */ 0x00 /* T4 = 0ms */ 0x00 /* T5 = 0ms */ 0x00 /* T6 = 0ms */ 0x00 /* T7 = 0ms */ 0xFF /* MAX_CTO = 255 */ 0x05BC /* MAX_DTO = 1468 */ BYTE_ORDER_MSB_LAST /* BIG_ENDIAN = Intel */ ADDRESS_GRANULARITY_BYTE /* 1-Byte-Alignment */ OPTIONAL_CMD GET_DAQ_EVENT_INFO /* List of commands supported by XCP-Gateway */ OPTIONAL_CMD GET_DAQ_LIST_INFO OPTIONAL_CMD GET_DAQ_RESOLUTION_INFO OPTIONAL_CMD GET_DAQ_PROCESSOR_INFO OPTIONAL_CMD GET_DAQ_CLOCK OPTIONAL_CMD START_STOP_SYNCH OPTIONAL_CMD START_STOP_DAQ_LIST OPTIONAL_CMD GET_DAQ_LIST_MODE OPTIONAL_CMD SET_DAQ_LIST_MODE OPTIONAL_CMD WRITE_DAQ OPTIONAL_CMD SET_DAQ_PTR OPTIONAL_CMD CLEAR_DAQ_LIST OPTIONAL_CMD UPLOAD OPTIONAL_CMD WRITE_DAQ_MULTIPLE OPTIONAL_CMD TIME_CORRELATION_PROPERTIES OPTIONAL_LEVEL1_CMD GET_VERSION OPTIONAL_LEVEL1_CMD SET_DAQ_PACKED_MODE OPTIONAL_LEVEL1_CMD GET_DAQ_PACKED_MODE /end PROTOCOL_LAYER
 /begin DAQ STATIC 0x20 0x26 0x00 OPTIMISATION_TYPE_DEFAULT ADDRESS_EXTENSION_FREE IDENTIFICATION_FIELD_TYPE_RELATIVE_WORD_ALIGNED GRANULARITY_ODT_ENTRY_SIZE_DAQ_BYTE 0x02 NO_OVERLOAD_INDICATION /begin TIMESTAMP_SUPPORTED 0x01 SIZE_DWORD UNIT_1US TIMESTAMP_FIXED /end TIMESTAMP_SUPPORTED
  /begin DAQ_LIST 0x00 DAQ_LIST_TYPE DAQ MAX_ODT 1 MAX_ODT_ENTRIES 150 EVENT_FIXED 0x00 /end DAQ_LIST
  /begin DAQ_LIST 0x01 DAQ_LIST_TYPE DAQ MAX_ODT 1 MAX_ODT_ENTRIES 150 EVENT_FIXED 0x01 /end DAQ_LIST
  /begin DAQ_LIST 0x02 DAQ_LIST_TYPE DAQ MAX_ODT 1 MAX_ODT_ENTRIES 150 EVENT_FIXED 0x02 /end DAQ_LIST
  /begin DAQ_LIST 0x03 DAQ_LIST_TYPE DAQ MAX_ODT 1 MAX_ODT_ENTRIES 150 EVENT_FIXED 0x03 /end DAQ_LIST
  /begin DAQ_LIST 0x04 DAQ_LIST_TYPE DAQ MAX_ODT 1 MAX_ODT_ENTRIES 150 EVENT_FIXED 0x04 /end DAQ_LIST
  /begin DAQ_LIST 0x05 DAQ_LIST_TYPE DAQ MAX_ODT 1 MAX_ODT_ENTRIES 150 EVENT_FIXED 0x05 /end DAQ_LIST
  /begin DAQ_LIST 0x06 DAQ_LIST_TYPE DAQ MAX_ODT 1 MAX_ODT_ENTRIES 150 EVENT_FIXED 0x06 /end DAQ_LIST
  /begin DAQ_LIST 0x07 DAQ_LIST_TYPE DAQ MAX_ODT 1 MAX_ODT_ENTRIES 150 EVENT_FIXED 0x07 /end DAQ_LIST
  /begin DAQ_LIST 0x08 DAQ_LIST_TYPE DAQ MAX_ODT 1 MAX_ODT_ENTRIES 150 EVENT_FIXED 0x08 /end DAQ_LIST
  /begin DAQ_LIST 0x09 DAQ_LIST_TYPE DAQ MAX_ODT 1 MAX_ODT_ENTRIES 150 EVENT_FIXED 0x09 /end DAQ_LIST
  /begin DAQ_LIST 0x0A DAQ_LIST_TYPE DAQ MAX_ODT 1 MAX_ODT_ENTRIES 100 EVENT_FIXED 0x10 /end DAQ_LIST
  /begin DAQ_LIST 0x0B DAQ_LIST_TYPE DAQ MAX_ODT 1 MAX_ODT_ENTRIES 100 EVENT_FIXED 0x11 /end DAQ_LIST
  /begin DAQ_LIST 0x0C DAQ_LIST_TYPE DAQ MAX_ODT 1 MAX_ODT_ENTRIES 100 EVENT_FIXED 0x12 /end DAQ_LIST
  /begin DAQ_LIST 0x0D DAQ_LIST_TYPE DAQ MAX_ODT 1 MAX_ODT_ENTRIES 100 EVENT_FIXED 0x13 /end DAQ_LIST
  /begin DAQ_LIST 0x0E DAQ_LIST_TYPE DAQ MAX_ODT 1 MAX_ODT_ENTRIES 100 EVENT_FIXED 0x14 /end DAQ_LIST
  /begin DAQ_LIST 0x0F DAQ_LIST_TYPE DAQ MAX_ODT 1 MAX_ODT_ENTRIES 100 EVENT_FIXED 0x15 /end DAQ_LIST
  /begin DAQ_LIST 0x10 DAQ_LIST_TYPE DAQ MAX_ODT 1 MAX_ODT_ENTRIES 100 EVENT_FIXED 0x16 /end DAQ_LIST
  /begin DAQ_LIST 0x11 DAQ_LIST_TYPE DAQ MAX_ODT 1 MAX_ODT_ENTRIES 100 EVENT_FIXED 0x17 /end DAQ_LIST
  /begin DAQ_LIST 0x12 DAQ_LIST_TYPE DAQ MAX_ODT 1 MAX_ODT_ENTRIES 100 EVENT_FIXED 0x18 /end DAQ_LIST
  /begin DAQ_LIST 0x13 DAQ_LIST_TYPE DAQ MAX_ODT 1 MAX_ODT_ENTRIES 100 EVENT_FIXED 0x19 /end DAQ_LIST
  /begin DAQ_LIST 0x14 DAQ_LIST_TYPE DAQ MAX_ODT 1 MAX_ODT_ENTRIES 100 EVENT_FIXED 0x1A /end DAQ_LIST
  /begin DAQ_LIST 0x15 DAQ_LIST_TYPE DAQ MAX_ODT 1 MAX_ODT_ENTRIES 100 EVENT_FIXED 0x1B /end DAQ_LIST
  /begin DAQ_LIST 0x16 DAQ_LIST_TYPE DAQ MAX_ODT 1 MAX_ODT_ENTRIES 150 EVENT_FIXED 0x1C DAQ_PACKED_MODE_SUPPORTED /end DAQ_LIST
  /begin DAQ_LIST 0x17 DAQ_LIST_TYPE DAQ MAX_ODT 1 MAX_ODT_ENTRIES 150 EVENT_FIXED 0x1D DAQ_PACKED_MODE_SUPPORTED /end DAQ_LIST
  /begin DAQ_LIST 0x18 DAQ_LIST_TYPE DAQ MAX_ODT 1 MAX_ODT_ENTRIES 150 EVENT_FIXED 0x1E DAQ_PACKED_MODE_SUPPORTED /end DAQ_LIST
  /begin DAQ_LIST 0x19 DAQ_LIST_TYPE DAQ MAX_ODT 1 MAX_ODT_ENTRIES 150 EVENT_FIXED 0x1F DAQ_PACKED_MODE_SUPPORTED /end DAQ_LIST
  /begin DAQ_LIST 0x1A DAQ_LIST_TYPE DAQ MAX_ODT 1 MAX_ODT_ENTRIES 150 EVENT_FIXED 0x20 DAQ_PACKED_MODE_SUPPORTED /end DAQ_LIST
  /begin DAQ_LIST 0x1B DAQ_LIST_TYPE DAQ MAX_ODT 1 MAX_ODT_ENTRIES 150 EVENT_FIXED 0x21 DAQ_PACKED_MODE_SUPPORTED /end DAQ_LIST
  /begin DAQ_LIST 0x1C DAQ_LIST_TYPE DAQ MAX_ODT 1 MAX_ODT_ENTRIES 150 EVENT_FIXED 0x22 DAQ_PACKED_MODE_SUPPORTED /end DAQ_LIST
  /begin DAQ_LIST 0x1D DAQ_LIST_TYPE DAQ MAX_ODT 1 MAX_ODT_ENTRIES 150 EVENT_FIXED 0x23 DAQ_PACKED_MODE_SUPPORTED /end DAQ_LIST
  /begin DAQ_LIST 0x1E DAQ_LIST_TYPE DAQ MAX_ODT 1 MAX_ODT_ENTRIES 150 EVENT_FIXED 0x24 DAQ_PACKED_MODE_SUPPORTED /end DAQ_LIST
  /begin DAQ_LIST 0x1F DAQ_LIST_TYPE DAQ MAX_ODT 1 MAX_ODT_ENTRIES 150 EVENT_FIXED 0x25 DAQ_PACKED_MODE_SUPPORTED /end DAQ_LIST
  /begin EVENT "Event   0 - 100 us" "Event   0" 0x00 DAQ 0x01 100 0x03 0x00 /end EVENT
  /begin EVENT "Event   1 - 200 us" "Event   1" 0x01 DAQ 0x01 2 0x05 0x00 /end EVENT
  /begin EVENT "Event   2 - 500 us" "Event   2" 0x02 DAQ 0x01 5 0x05 0x00 /end EVENT
  /begin EVENT "Event   3 - 1 ms" "Event   3" 0x03 DAQ 0x01 10 0x05 0x00 /end EVENT
  /begin EVENT "Event   4 - 2 ms" "Event   4" 0x04 DAQ 0x01 20 0x05 0x00 /end EVENT
  /begin EVENT "Event   5 - 5 ms" "Event   5" 0x05 DAQ 0x01 50 0x05 0x00 /end EVENT
  /begin EVENT "Event   6 - 10 ms" "Event   6" 0x06 DAQ 0x01 100 0x05 0x00 /end EVENT
  /begin EVENT "Event   7 - 20 ms" "Event   7" 0x07 DAQ 0x01 2 0x07 0x00 /end EVENT
  /begin EVENT "Event   8 - 50 ms" "Event   8" 0x08 DAQ 0x01 5 0x07 0x00 /end EVENT
  /begin EVENT "Event   9 - 100 ms" "Event   9" 0x09 DAQ 0x01 10 0x07 0x00 /end EVENT
  /begin EVENT "Event  10 - 200 ms" "Event  10" 0x0A DAQ 0x01 20 0x07 0x00 /end EVENT
  /begin EVENT "Event  11 - 500 ms" "Event  11" 0x0B DAQ 0x01 50 0x07 0x00 /end EVENT
  /begin EVENT "Event  12 - 1 s" "Event  12" 0x0C DAQ 0x01 100 0x07 0x00 /end EVENT
  /begin EVENT "Event  13 - 100 us" "Event  13" 0x0D DAQ 0x01 100 0x03 0x00 /end EVENT
  /begin EVENT "Event  14 - 200 us" "Event  14" 0x0E DAQ 0x01 2 0x05 0x00 /end EVENT
  /begin EVENT "Event  15 - 500 us" "Event  15" 0x0F DAQ 0x01 5 0x05 0x00 /end EVENT
  /begin EVENT "Event  16 - 1 ms" "Event  16" 0x10 DAQ 0x01 10 0x05 0x00 /end EVENT
  /begin EVENT "Event  17 - 2 ms" "Event  17" 0x11 DAQ 0x01 20 0x05 0x00 /end EVENT
  /begin EVENT "Event  18 - 5 ms" "Event  18" 0x12 DAQ 0x01 50 0x05 0x00 /end EVENT
  /begin EVENT "Event  19 - 10 ms" "Event  19" 0x13 DAQ 0x01 100 0x05 0x00 /end EVENT
  /begin EVENT "Event  20 - 20 ms" "Event  20" 0x14 DAQ 0x01 2 0x07 0x00 /end EVENT
  /begin EVENT "Event  21 - 50 ms" "Event  21" 0x15 DAQ 0x01 5 0x07 0x00 /end EVENT
  /begin EVENT "Event  22 - 100 ms" "Event  22" 0x16 DAQ 0x01 10 0x07 0x00 /end EVENT
  /begin EVENT "Event  23 - 200 ms" "Event  23" 0x17 DAQ 0x01 20 0x07 0x00 /end EVENT
  /begin EVENT "Event  24 - 500 ms" "Event  24" 0x18 DAQ 0x01 50 0x07 0x00 /end EVENT
  /begin EVENT "Event  25 - 1 s" "Event  25" 0x19 DAQ 0x01 100 0x07 0x00 /end EVENT
  /begin EVENT "Event  26 - 100 us first HS" "Event  26" 0x1A DAQ 0x01 100 0x03 0x00 /end EVENT
  /begin EVENT "Event  27 - 100 us second HS" "Event  27" 0x1B DAQ 0x01 100 0x03 0x00 /end EVENT
  /begin EVENT "Event  28 - 1000 ns" "Event  28" 0x1C DAQ 0x01 100 0x01 /* _TIME_UNIT_10NS */ 0x00 /begin DAQ_PACKED_MODE ELEMENT_GROUPED STS_LAST MANDATORY 100 /end DAQ_PACKED_MODE /end EVENT
  /begin EVENT "Event  29 - 1250 ns" "Event  29" 0x1D DAQ 0x01 125 0x01 /* _TIME_UNIT_10NS */ 0x00 /begin DAQ_PACKED_MODE ELEMENT_GROUPED STS_LAST MANDATORY 80 /end DAQ_PACKED_MODE /end EVENT
  /begin EVENT "Event  30 - 2000 ns" "Event  30" 0x1E DAQ 0x01 20 0x02 0x00 /begin DAQ_PACKED_MODE ELEMENT_GROUPED STS_LAST MANDATORY 50 /end DAQ_PACKED_MODE /end EVENT
  /begin EVENT "Event  31 - 2500 ns" "Event  31" 0x1F DAQ 0x01 25 0x02 0x00 /begin DAQ_PACKED_MODE ELEMENT_GROUPED STS_LAST MANDATORY 40 /end DAQ_PACKED_MODE /end EVENT
  /begin EVENT "Event  32 - 5000 ns" "Event  32" 0x20 DAQ 0x01 50 0x02 0x00 /begin DAQ_PACKED_MODE ELEMENT_GROUPED STS_LAST MANDATORY 20 /end DAQ_PACKED_MODE /end EVENT
  /begin EVENT "Event  33 - 10000 ns" "Event  33" 0x21 DAQ 0x01 100 0x02 0x00 /begin DAQ_PACKED_MODE ELEMENT_GROUPED STS_LAST MANDATORY 10 /end DAQ_PACKED_MODE /end EVENT
  /begin EVENT "Event  34 - 12500 ns" "Event  34" 0x22 DAQ 0x01 125 0x02 0x00 /begin DAQ_PACKED_MODE ELEMENT_GROUPED STS_LAST MANDATORY 8 /end DAQ_PACKED_MODE /end EVENT
  /begin EVENT "Event  35 - 20 us" "Event  35" 0x23 DAQ 0x01 20 0x03 0x00 /begin DAQ_PACKED_MODE ELEMENT_GROUPED STS_LAST MANDATORY 5 /end DAQ_PACKED_MODE /end EVENT
  /begin EVENT "Event  36 - 25 us" "Event  36" 0x24 DAQ 0x01 25 0x03 0x00 /begin DAQ_PACKED_MODE ELEMENT_GROUPED STS_LAST MANDATORY 4 /end DAQ_PACKED_MODE /end EVENT
  /begin EVENT "Event  37 - 50 us" "Event  37" 0x25 DAQ 0x01 50 0x03 0x00 /begin DAQ_PACKED_MODE ELEMENT_GROUPED STS_LAST MANDATORY 2 /end DAQ_PACKED_MODE /end EVENT
 /end DAQ
 /begin PAG 0x00 /end PAG
 /begin PGM PGM_MODE_ABSOLUTE 0x00 0x00 /end PGM
 /begin TIME_CORRELATION DAQ_TIMESTAMPS_RELATE_TO XCP_SLAVE_CLOCK
  /begin CLOCK 0x00 0x00 0x00 0x00 0x00 0x00 0x00 0x00 XCP_SLAVE_CLOCK RANDOMLY_READABLE SYN_ALL 0x00 /begin TIMESTAMP_CHARACTERIZATION 1 UNIT_1US SIZE_EIGHT_BYTE /end TIMESTAMP_CHARACTERIZATION 0xFFFFFFFFFFFFFFFF UNIVERSAL_COORDINATED_TIME /end CLOCK
 /end TIME_CORRELATION
 /begin XCP_ON_UDP_IP 0x0104 5555 ADDRESS "172.31.31.242" MAX_BUS_LOAD 90 MAX_BIT_RATE 100 PACKET_ALIGNMENT PACKET_ALIGNMENT_16 OPTIONAL_TL_SUBCMD GET_SLAVE_ID OPTIONAL_TL_SUBCMD GET_SLAVE_ID_EXTENDED OPTIONAL_TL_SUBCMD SET_SLAVE_IP_ADDRESS OPTIONAL_TL_SUBCMD GET_DAQ_CLOCK_MULTICAST /end XCP_ON_UDP_IP
/end IF_DATA
/begin IF_DATA CSM_X07 12
 /begin GATEWAY "255.255.255.0" SNO 539 MULTIECAT MULTIECAT_10KHZ SYNC_EVT_CFG 0x40 0x01 PTP_CFG 0x00 0x00 2 0x03
  /begin PTP_INFO 0 0 0 0 0 0x00 0x00 0x00 0x00 0x00 0x00 0x00 0x00 0x00 0x00 0x00 0x00 0x00 0x00 0x00 0x00 0 0 0 0 0 0 0 /end PTP_INFO
 /end GATEWAY
 /begin BUS "ECAT1" 0x03 BUS_ETHERCAT /end BUS
 /begin BUS "CAN1" 0x00 BUS_CAN CAN_11BIT 500000 66 0x00 "" 0 /end BUS
 /begin BUS "CAN2" 0x00 BUS_CAN CAN_11BIT 500000 66 0x00 "" 0 /end BUS
 /begin DEVICE "ADMMEC_20385" "ADMMEC_20385" "ECAT1" 20385 "" 3002 23 0x03 4 50402 DEVICEPROPS 0x41303034 0x0111 0x00014571 0xA0 0x00000001 CONFIGHASH 0xF28A0452 BYTE_ORDER MSB_LAST /end DEVICE
 /begin CHANNEL "ADMMEC_20385_A01" "ADMMEC_20385" 1 0x03 5 0 BIPOLAR FILTER 2 0 LINSCALE 0.00019240358305846328 -6.4270492884849073 DISPSCALE "V" -5 5 SENSSUPPLY 0 ADJUSTMENT_PARAMS 0.00019240358305846328 -6.4270492884849073 /end CHANNEL
 /begin CHANNEL "ADMMEC_20385_A02" "ADMMEC_20385" 2 0x03 5 0 BIPOLAR FILTER 2 0 LINSCALE 0.00019271257580088429 -6.4337093431125219 DISPSCALE "V" -5 5 SENSSUPPLY 0 ADJUSTMENT_PARAMS 0.00019271257580088429 -6.4337093431125219 /end CHANNEL
 /begin CHANNEL "ADMMEC_20385_A03" "ADMMEC_20385" 3 0x03 45 0 BIPOLAR FILTER 2 0 LINSCALE 0.0015422223999233119 -51.508685935038692 DISPSCALE "V" -45 45 SENSSUPPLY 0 ADJUSTMENT_PARAMS 0.0015422223999233119 -51.508685935038692 /end CHANNEL
 /begin CHANNEL "ADMMEC_20385_A04" "ADMMEC_20385" 4 0x03 5 0 BIPOLAR FILTER 2 0 LINSCALE -0.0019240769641597742 64.269942833828935 DISPSCALE "A" -50 50 SENSSUPPLY 5.0 ADJUSTMENT_PARAMS 0.00019240769641597742 -6.4269942833828937 /end CHANNEL
/end IF_DATA
/begin MOD_COMMON "XCPGateway" BYTE_ORDER MSB_LAST ALIGNMENT_BYTE 1 ALIGNMENT_WORD 2 ALIGNMENT_LONG 4 ALIGNMENT_INT64 8 ALIGNMENT_FLOAT32_IEEE 4 ALIGNMENT_FLOAT64_IEEE 8 /end MOD_COMMON
/begin COMPU_VTAB CSM_ADMM_SWORD_STATES "CSM_ADMM_SWORD_STATES" TAB_VERB 1 -32768 "OUT_OF_RANGE" /end COMPU_VTAB
/begin COMPU_VTAB CSM_ADMM_UWORD_STATES "CSM_ADMM_UWORD_STATES" TAB_VERB 1 65535 "OUT_OF_RANGE" /end COMPU_VTAB
/begin COMPU_VTAB CSM_THMM_UWORD_STATES "CSM_THMM_UWORD_STATES" TAB_VERB 1 0 "NO_SENSOR" /end COMPU_VTAB
/begin COMPU_VTAB CSM_THMM_SWORD_STATES "CSM_THMM_SWORD_STATES" TAB_VERB 1 -32768 "NO_SENSOR" /end COMPU_VTAB
/begin COMPU_VTAB CSM_PTMM_UWORD_STATES "CSM_PTMM_UWORD_STATES" TAB_VERB 1 65535 "NO_SENSOR" /end COMPU_VTAB
/begin COMPU_VTAB CSM_PTMM_SWORD_STATES "CSM_THMM_SWORD_STATES" TAB_VERB 1 -32768 "NO_SENSOR" /end COMPU_VTAB
/begin COMPU_VTAB CSM_CNMM0_UWORD_STATES "CSM_CNMM0_UWORD_STATES" TAB_VERB 2 0 "TIME_OUT" 65535 "OVERFLOW" /end COMPU_VTAB
/begin COMPU_VTAB CSM_CNMM1_UWORD_STATES "CSM_CNMM1_UWORD_STATES" TAB_VERB 2 0 "PERIOD_TOO_SMALL" 65535 "TIME_OUT" /end COMPU_VTAB
/begin COMPU_VTAB CSM_CNMM8_UWORD_STATES "CSM_CNMM8_UWORD_STATES" TAB_VERB 1 65535 "OVERFLOW" /end COMPU_VTAB
/begin COMPU_VTAB CSM_CNMM20_SWORD_STATES "CSM_CNMM20_SWORD_STATES" TAB_VERB 3 -32768 "UNDERFLOW" 0 "TIME_OUT" 32767 "OVERFLOW" /end COMPU_VTAB
/begin COMPU_VTAB CSM_CNMM21_SWORD_STATES "CSM_CNMM21_SWORD_STATES" TAB_VERB 2 -32768 "UNDERFLOW" 32767 "OVERFLOW" /end COMPU_VTAB
/begin COMPU_VTAB CSM_STGMM_SWORD_STATES "CSM_STGMM_SWORD_STATES" TAB_VERB 15 32767 "ERROR_7FFF" 32766 "ERROR_7FFE" 32765 "ERROR_7FFD" 32764 "ERROR_7FFC" 32763 "EXCITATION_RANGE_OVERFLOW" 32762 "INPUT_RANGE_OVERFLOW" 32761 "MEASUREMENT_RANGE_OVERFLOW" -32761 "MEASUREMENT_RANGE_UNDERFLOW" -32762 "INPUT_RANGE_UNDERFLOW" -32763 "EXCITATION_RANGE_UNDERFLOW" -32764 "ERROR_8004" -32765 "ERROR_8003" -32766 "ERROR_8002" -32767 "ERROR_8001" -32768 "EXCITATION_ERROR" /end COMPU_VTAB
/begin COMPU_VTAB CSM_ECATADMMHS_SWORD_STATES "CSM_ECATADMMHS_SWORD_STATES" TAB_VERB 15 32767 "ERROR_7FFF" 32766 "ERROR_7FFE" 32765 "ERROR_7FFD" 32764 "INVALID_TEDS" 32763 "EXCITATION_RANGE_OVERFLOW" 32762 "INPUT_RANGE_OVERFLOW" 32761 "MEASUREMENT_RANGE_OVERFLOW" -32761 "MEASUREMENT_RANGE_UNDERFLOW" -32762 "INPUT_RANGE_UNDERFLOW" -32763 "EXCITATION_RANGE_UNDERFLOW" -32764 "ERROR_8004" -32765 "ERROR_8003" -32766 "ERROR_8002" -32767 "ERROR_8001" -32768 "ERROR_8000" /end COMPU_VTAB
/begin COMPU_VTAB CSM_HVBM_SWORD_STATES "CSM_HVBM_SWORD_STATES" TAB_VERB 15 32767 "ERROR_7FFF" 32766 "ERROR_7FFE" 32765 "ERROR_7FFD" 32764 "ERROR_7FFC" 32763 "ERROR_7FFB" 32762 "INPUT_RANGE_OVERFLOW" 32761 "MEASUREMENT_RANGE_OVERFLOW" -32761 "MEASUREMENT_RANGE_UNDERFLOW" -32762 "INPUT_RANGE_UNDERFLOW" -32763 "ERROR_8005" -32764 "SHUNT_ERROR" -32765 "ERROR_8003" -32766 "ERROR_8002" -32767 "ERROR_8001" -32768 "CONFIGURATION_ERROR" /end COMPU_VTAB
/* Channel ADMMEC_20385_A01 */
/begin MEASUREMENT ADMMEC_20385_A01 "" UWORD CNV_ADMMEC_20385_A01 0 0 -5 5 ECU_ADDRESS 0x4FA11700
 /begin IF_DATA XCPplus 0x0104
  /begin DAQ_EVENT VARIABLE /begin AVAILABLE_EVENT_LIST EVENT 0x1D /end AVAILABLE_EVENT_LIST /begin DEFAULT_EVENT_LIST EVENT 0x1D /end DEFAULT_EVENT_LIST /end DAQ_EVENT
 /end IF_DATA
 /begin ANNOTATION ANNOTATION_LABEL "UserFactor" /begin ANNOTATION_TEXT "1" /end ANNOTATION_TEXT /end ANNOTATION
 /begin ANNOTATION ANNOTATION_LABEL "UserOffset" /begin ANNOTATION_TEXT "0" /end ANNOTATION_TEXT /end ANNOTATION
 /begin ANNOTATION ANNOTATION_LABEL "AdjustmentGain" /begin ANNOTATION_TEXT "0.00019240358305846328" /end ANNOTATION_TEXT /end ANNOTATION
 /begin ANNOTATION ANNOTATION_LABEL "AdjustmentOffset" /begin ANNOTATION_TEXT "-6.4270492884849073" /end ANNOTATION_TEXT /end ANNOTATION
/end MEASUREMENT
/begin COMPU_METHOD CNV_ADMMEC_20385_A01 "CNV_ADMMEC_20385_A01" RAT_FUNC "%8.6" "V" COEFFS 0 1 6.4270492884849073 0 0 0.00019240358305846328 /end COMPU_METHOD
/* Channel ADMMEC_20385_A02 */
/begin MEASUREMENT ADMMEC_20385_A02 "" UWORD CNV_ADMMEC_20385_A02 0 0 -5 5 ECU_ADDRESS 0x4FA11710
 /begin IF_DATA XCPplus 0x0104
  /begin DAQ_EVENT VARIABLE /begin AVAILABLE_EVENT_LIST EVENT 0x1D /end AVAILABLE_EVENT_LIST /begin DEFAULT_EVENT_LIST EVENT 0x1D /end DEFAULT_EVENT_LIST /end DAQ_EVENT
 /end IF_DATA
 /begin ANNOTATION ANNOTATION_LABEL "UserFactor" /begin ANNOTATION_TEXT "1" /end ANNOTATION_TEXT /end ANNOTATION
 /begin ANNOTATION ANNOTATION_LABEL "UserOffset" /begin ANNOTATION_TEXT "0" /end ANNOTATION_TEXT /end ANNOTATION
 /begin ANNOTATION ANNOTATION_LABEL "AdjustmentGain" /begin ANNOTATION_TEXT "0.00019271257580088429" /end ANNOTATION_TEXT /end ANNOTATION
 /begin ANNOTATION ANNOTATION_LABEL "AdjustmentOffset" /begin ANNOTATION_TEXT "-6.4337093431125219" /end ANNOTATION_TEXT /end ANNOTATION
/end MEASUREMENT
/begin COMPU_METHOD CNV_ADMMEC_20385_A02 "CNV_ADMMEC_20385_A02" RAT_FUNC "%8.6" "V" COEFFS 0 1 6.4337093431125219 0 0 0.00019271257580088429 /end COMPU_METHOD
/* Channel ADMMEC_20385_A03 */
/begin MEASUREMENT ADMMEC_20385_A03 "" UWORD CNV_ADMMEC_20385_A03 0 0 -45 45 ECU_ADDRESS 0x4FA11720
 /begin IF_DATA XCPplus 0x0104
  /begin DAQ_EVENT VARIABLE /begin AVAILABLE_EVENT_LIST EVENT 0x1D /end AVAILABLE_EVENT_LIST /begin DEFAULT_EVENT_LIST EVENT 0x1D /end DEFAULT_EVENT_LIST /end DAQ_EVENT
 /end IF_DATA
 /begin ANNOTATION ANNOTATION_LABEL "UserFactor" /begin ANNOTATION_TEXT "1" /end ANNOTATION_TEXT /end ANNOTATION
 /begin ANNOTATION ANNOTATION_LABEL "UserOffset" /begin ANNOTATION_TEXT "0" /end ANNOTATION_TEXT /end ANNOTATION
 /begin ANNOTATION ANNOTATION_LABEL "AdjustmentGain" /begin ANNOTATION_TEXT "0.0015422223999233119" /end ANNOTATION_TEXT /end ANNOTATION
 /begin ANNOTATION ANNOTATION_LABEL "AdjustmentOffset" /begin ANNOTATION_TEXT "-51.508685935038692" /end ANNOTATION_TEXT /end ANNOTATION
/end MEASUREMENT
/begin COMPU_METHOD CNV_ADMMEC_20385_A03 "CNV_ADMMEC_20385_A03" RAT_FUNC "%8.6" "V" COEFFS 0 1 51.508685935038692 0 0 0.0015422223999233119 /end COMPU_METHOD
/* Channel ADMMEC_20385_A04 */
/begin MEASUREMENT ADMMEC_20385_A04 "" UWORD CNV_ADMMEC_20385_A04 0 0 -50 50 ECU_ADDRESS 0x4FA11730
 /begin IF_DATA XCPplus 0x0104
  /begin DAQ_EVENT VARIABLE /begin AVAILABLE_EVENT_LIST EVENT 0x1D /end AVAILABLE_EVENT_LIST /begin DEFAULT_EVENT_LIST EVENT 0x1D /end DEFAULT_EVENT_LIST /end DAQ_EVENT
 /end IF_DATA
 /begin ANNOTATION ANNOTATION_LABEL "UserFactor" /begin ANNOTATION_TEXT "-10" /end ANNOTATION_TEXT /end ANNOTATION
 /begin ANNOTATION ANNOTATION_LABEL "UserOffset" /begin ANNOTATION_TEXT "0" /end ANNOTATION_TEXT /end ANNOTATION
 /begin ANNOTATION ANNOTATION_LABEL "AdjustmentGain" /begin ANNOTATION_TEXT "0.00019240769641597742" /end ANNOTATION_TEXT /end ANNOTATION
 /begin ANNOTATION ANNOTATION_LABEL "AdjustmentOffset" /begin ANNOTATION_TEXT "-6.4269942833828937" /end ANNOTATION_TEXT /end ANNOTATION
/end MEASUREMENT
/begin COMPU_METHOD CNV_ADMMEC_20385_A04 "CNV_ADMMEC_20385_A04" RAT_FUNC "%8.6" "A" COEFFS 0 1 -64.269942833828935 0 0 -0.0019240769641597742 /end COMPU_METHOD
/begin GROUP EtherCAT "EtherCAT measurements" ROOT /begin SUB_GROUP ADMMEC_20385 /end SUB_GROUP /end GROUP
/begin GROUP ADMMEC_20385 "ADMMEC_20385 measurements"
 /begin REF_MEASUREMENT ADMMEC_20385_A01 ADMMEC_20385_A02 ADMMEC_20385_A03 ADMMEC_20385_A04 /end REF_MEASUREMENT
/end GROUP
/* <MEASUREMENTS_CAN1> */
/begin GROUP CAN1 "CAN1 measurements" ROOT /begin REF_MEASUREMENT /* <GROUP_REF_MEASUREMENTS_CAN1> */ /end REF_MEASUREMENT /end GROUP
/* <MEASUREMENTS_CAN2> */
/begin GROUP CAN2 "CAN2 measurements" ROOT /begin REF_MEASUREMENT /* <GROUP_REF_MEASUREMENTS_CAN2> */ /end REF_MEASUREMENT /end GROUP
/end MODULE
/end PROJECT
