ASAP2_VERSION 1 71
/begin PROJECT daq_test ""
/begin HEADER "" VERSION "1.0" PROJECT_NO XCPLITE__CASDD /end HEADER
/begin MODULE daq_test ""
/include "XCP_104.aml"
/begin MOD_COMMON "" BYTE_ORDER MSB_LAST ALIGNMENT_BYTE 1 ALIGNMENT_WORD 1 ALIGNMENT_LONG 1 ALIGNMENT_FLOAT16_IEEE 1 ALIGNMENT_FLOAT32_IEEE 1 ALIGNMENT_FLOAT64_IEEE 1 ALIGNMENT_INT64 1 /end MOD_COMMON
/begin CHARACTERISTIC params.counter_max "Max counter value, wrap around" VALUE 0x80010000 U16 0 NO_COMPU_METHOD 0 65535 /end CHARACTERISTIC
/begin CHARACTERISTIC params.delay_us "task delay time in us" VALUE 0x80010004 U32 0 NO_COMPU_METHOD 0 1e+06 PHYS_UNIT "us" /end CHARACTERISTIC
/begin CHARACTERISTIC params.run "stop task" VALUE 0x80010008 U8 0 NO_COMPU_METHOD 0 1 /end CHARACTERISTIC
/begin CHARACTERISTIC params.test_byte1 "Test byte for calibration consistency test" VALUE 0x80010009 I8 0 NO_COMPU_METHOD -128 127 /end CHARACTERISTIC
/begin CHARACTERISTIC params.test_byte2 "Test byte for calibration consistency test" VALUE 0x8001000A I8 0 NO_COMPU_METHOD -128 127 /end CHARACTERISTIC
/begin MEASUREMENT task_1.counter "Taskloop counter" UWORD NO_COMPU_METHOD 0 0 0 65535 ECU_ADDRESS 0x146 ECU_ADDRESS_EXTENSION 2 READ_WRITE
 /begin IF_DATA XCP
  /begin DAQ_EVENT FIXED_EVENT_LIST EVENT 0x0 /end DAQ_EVENT
 /end IF_DATA
/end MEASUREMENT
/begin MEASUREMENT task_1.counter8 "Taskloop counter 8 bit" UBYTE NO_COMPU_METHOD 0 0 0 255 ECU_ADDRESS 0x145 ECU_ADDRESS_EXTENSION 2 READ_WRITE
 /begin IF_DATA XCP
  /begin DAQ_EVENT FIXED_EVENT_LIST EVENT 0x0 /end DAQ_EVENT
 /end IF_DATA
/end MEASUREMENT
/begin MEASUREMENT task_1.counter16 "Taskloop counter 16 bit" UWORD NO_COMPU_METHOD 0 0 0 65535 ECU_ADDRESS 0x142 ECU_ADDRESS_EXTENSION 2 READ_WRITE
 /begin IF_DATA XCP
  /begin DAQ_EVENT FIXED_EVENT_LIST EVENT 0x0 /end DAQ_EVENT
 /end IF_DATA
/end MEASUREMENT
/begin MEASUREMENT task_1.counter32 "Taskloop counter 32 bit" ULONG NO_COMPU_METHOD 0 0 0 4.29497e+09 ECU_ADDRESS 0x13C ECU_ADDRESS_EXTENSION 2 READ_WRITE
 /begin IF_DATA XCP
  /begin DAQ_EVENT FIXED_EVENT_LIST EVENT 0x0 /end DAQ_EVENT
 /end IF_DATA
/end MEASUREMENT
/begin MEASUREMENT task_1.counter64 "Taskloop counter 64 bit" A_UINT64 NO_COMPU_METHOD 0 0 0 1e+12 ECU_ADDRESS 0x130 ECU_ADDRESS_EXTENSION 2 READ_WRITE
 /begin IF_DATA XCP
  /begin DAQ_EVENT FIXED_EVENT_LIST EVENT 0x0 /end DAQ_EVENT
 /end IF_DATA
/end MEASUREMENT
/begin CHARACTERISTIC task_1.array "task array (to increase measurement workload)" VAL_BLK 0x30 U32 0 NO_COMPU_METHOD 0 4.29497e+09 MATRIX_DIM 64 1 ECU_ADDRESS_EXTENSION 2
 /begin IF_DATA XCP
  /begin DAQ_EVENT FIXED_EVENT_LIST EVENT 0x0 /end DAQ_EVENT
 /end IF_DATA
/end CHARACTERISTIC
/begin MEASUREMENT task_14.counter "Taskloop counter" UWORD NO_COMPU_METHOD 0 0 0 65535 ECU_ADDRESS 0x3400146 ECU_ADDRESS_EXTENSION 2 READ_WRITE
 /begin IF_DATA XCP
  /begin DAQ_EVENT FIXED_EVENT_LIST EVENT 0xD /end DAQ_EVENT
 /end IF_DATA
/end MEASUREMENT
/begin MEASUREMENT task_14.counter8 "Taskloop counter 8 bit" UBYTE NO_COMPU_METHOD 0 0 0 255 ECU_ADDRESS 0x3400145 ECU_ADDRESS_EXTENSION 2 READ_WRITE
 /begin IF_DATA XCP
  /begin DAQ_EVENT FIXED_EVENT_LIST EVENT 0xD /end DAQ_EVENT
 /end IF_DATA
/end MEASUREMENT
/begin MEASUREMENT task_14.counter16 "Taskloop counter 16 bit" UWORD NO_COMPU_METHOD 0 0 0 65535 ECU_ADDRESS 0x3400142 ECU_ADDRESS_EXTENSION 2 READ_WRITE
 /begin IF_DATA XCP
  /begin DAQ_EVENT FIXED_EVENT_LIST EVENT 0xD /end DAQ_EVENT
 /end IF_DATA
/end MEASUREMENT
/begin MEASUREMENT task_14.counter32 "Taskloop counter 32 bit" ULONG NO_COMPU_METHOD 0 0 0 4.29497e+09 ECU_ADDRESS 0x340013C ECU_ADDRESS_EXTENSION 2 READ_WRITE
 /begin IF_DATA XCP
  /begin DAQ_EVENT FIXED_EVENT_LIST EVENT 0xD /end DAQ_EVENT
 /end IF_DATA
/end MEASUREMENT
/begin MEASUREMENT task_14.counter64 "Taskloop counter 64 bit" A_UINT64 NO_COMPU_METHOD 0 0 0 1e+12 ECU_ADDRESS 0x3400130 ECU_ADDRESS_EXTENSION 2 READ_WRITE
 /begin IF_DATA XCP
  /begin DAQ_EVENT FIXED_EVENT_LIST EVENT 0xD /end DAQ_EVENT
 /end IF_DATA
/end MEASUREMENT
/begin CHARACTERISTIC task_14.array "task array (to increase measurement workload)" VAL_BLK 0x3400030 U32 0 NO_COMPU_METHOD 0 4.29497e+09 MATRIX_DIM 64 1 ECU_ADDRESS_EXTENSION 2
 /begin IF_DATA XCP
  /begin DAQ_EVENT FIXED_EVENT_LIST EVENT 0xD /end DAQ_EVENT
 /end IF_DATA
/end CHARACTERISTIC
/begin MEASUREMENT task_3.counter "Taskloop counter" UWORD NO_COMPU_METHOD 0 0 0 65535 ECU_ADDRESS 0x800146 ECU_ADDRESS_EXTENSION 2 READ_WRITE
 /begin IF_DATA XCP
  /begin DAQ_EVENT FIXED_EVENT_LIST EVENT 0x2 /end DAQ_EVENT
 /end IF_DATA
/end MEASUREMENT
/begin MEASUREMENT task_3.counter8 "Taskloop counter 8 bit" UBYTE NO_COMPU_METHOD 0 0 0 255 ECU_ADDRESS 0x800145 ECU_ADDRESS_EXTENSION 2 READ_WRITE
 /begin IF_DATA XCP
  /begin DAQ_EVENT FIXED_EVENT_LIST EVENT 0x2 /end DAQ_EVENT
 /end IF_DATA
/end MEASUREMENT
/begin MEASUREMENT task_3.counter16 "Taskloop counter 16 bit" UWORD NO_COMPU_METHOD 0 0 0 65535 ECU_ADDRESS 0x800142 ECU_ADDRESS_EXTENSION 2 READ_WRITE
 /begin IF_DATA XCP
  /begin DAQ_EVENT FIXED_EVENT_LIST EVENT 0x2 /end DAQ_EVENT
 /end IF_DATA
/end MEASUREMENT
/begin MEASUREMENT task_3.counter32 "Taskloop counter 32 bit" ULONG NO_COMPU_METHOD 0 0 0 4.29497e+09 ECU_ADDRESS 0x80013C ECU_ADDRESS_EXTENSION 2 READ_WRITE
 /begin IF_DATA XCP
  /begin DAQ_EVENT FIXED_EVENT_LIST EVENT 0x2 /end DAQ_EVENT
 /end IF_DATA
/end MEASUREMENT
/begin MEASUREMENT task_3.counter64 "Taskloop counter 64 bit" A_UINT64 NO_COMPU_METHOD 0 0 0 1e+12 ECU_ADDRESS 0x800130 ECU_ADDRESS_EXTENSION 2 READ_WRITE
 /begin IF_DATA XCP
  /begin DAQ_EVENT FIXED_EVENT_LIST EVENT 0x2 /end DAQ_EVENT
 /end IF_DATA
/end MEASUREMENT
/begin CHARACTERISTIC task_3.array "task array (to increase measurement workload)" VAL_BLK 0x800030 U32 0 NO_COMPU_METHOD 0 4.29497e+09 MATRIX_DIM 64 1 ECU_ADDRESS_EXTENSION 2
 /begin IF_DATA XCP
  /begin DAQ_EVENT FIXED_EVENT_LIST EVENT 0x2 /end DAQ_EVENT
 /end IF_DATA
/end CHARACTERISTIC
/begin MEASUREMENT task_4.counter "Taskloop counter" UWORD NO_COMPU_METHOD 0 0 0 65535 ECU_ADDRESS 0xC00146 ECU_ADDRESS_EXTENSION 2 READ_WRITE
 /begin IF_DATA XCP
  /begin DAQ_EVENT FIXED_EVENT_LIST EVENT 0x3 /end DAQ_EVENT
 /end IF_DATA
/end MEASUREMENT
/begin MEASUREMENT task_4.counter8 "Taskloop counter 8 bit" UBYTE NO_COMPU_METHOD 0 0 0 255 ECU_ADDRESS 0xC00145 ECU_ADDRESS_EXTENSION 2 READ_WRITE
 /begin IF_DATA XCP
  /begin DAQ_EVENT FIXED_EVENT_LIST EVENT 0x3 /end DAQ_EVENT
 /end IF_DATA
/end MEASUREMENT
/begin MEASUREMENT task_4.counter16 "Taskloop counter 16 bit" UWORD NO_COMPU_METHOD 0 0 0 65535 ECU_ADDRESS 0xC00142 ECU_ADDRESS_EXTENSION 2 READ_WRITE
 /begin IF_DATA XCP
  /begin DAQ_EVENT FIXED_EVENT_LIST EVENT 0x3 /end DAQ_EVENT
 /end IF_DATA
/end MEASUREMENT
/begin MEASUREMENT task_4.counter32 "Taskloop counter 32 bit" ULONG NO_COMPU_METHOD 0 0 0 4.29497e+09 ECU_ADDRESS 0xC0013C ECU_ADDRESS_EXTENSION 2 READ_WRITE
 /begin IF_DATA XCP
  /begin DAQ_EVENT FIXED_EVENT_LIST EVENT 0x3 /end DAQ_EVENT
 /end IF_DATA
/end MEASUREMENT
/begin MEASUREMENT task_4.counter64 "Taskloop counter 64 bit" A_UINT64 NO_COMPU_METHOD 0 0 0 1e+12 ECU_ADDRESS 0xC00130 ECU_ADDRESS_EXTENSION 2 READ_WRITE
 /begin IF_DATA XCP
  /begin DAQ_EVENT FIXED_EVENT_LIST EVENT 0x3 /end DAQ_EVENT
 /end IF_DATA
/end MEASUREMENT
/begin CHARACTERISTIC task_4.array "task array (to increase measurement workload)" VAL_BLK 0xC00030 U32 0 NO_COMPU_METHOD 0 4.29497e+09 MATRIX_DIM 64 1 ECU_ADDRESS_EXTENSION 2
 /begin IF_DATA XCP
  /begin DAQ_EVENT FIXED_EVENT_LIST EVENT 0x3 /end DAQ_EVENT
 /end IF_DATA
/end CHARACTERISTIC
/begin MEASUREMENT task_5.counter "Taskloop counter" UWORD NO_COMPU_METHOD 0 0 0 65535 ECU_ADDRESS 0x1000146 ECU_ADDRESS_EXTENSION 2 READ_WRITE
 /begin IF_DATA XCP
  /begin DAQ_EVENT FIXED_EVENT_LIST EVENT 0x4 /end DAQ_EVENT
 /end IF_DATA
/end MEASUREMENT
/begin MEASUREMENT task_5.counter8 "Taskloop counter 8 bit" UBYTE NO_COMPU_METHOD 0 0 0 255 ECU_ADDRESS 0x1000145 ECU_ADDRESS_EXTENSION 2 READ_WRITE
 /begin IF_DATA XCP
  /begin DAQ_EVENT FIXED_EVENT_LIST EVENT 0x4 /end DAQ_EVENT
 /end IF_DATA
/end MEASUREMENT
/begin MEASUREMENT task_5.counter16 "Taskloop counter 16 bit" UWORD NO_COMPU_METHOD 0 0 0 65535 ECU_ADDRESS 0x1000142 ECU_ADDRESS_EXTENSION 2 READ_WRITE
 /begin IF_DATA XCP
  /begin DAQ_EVENT FIXED_EVENT_LIST EVENT 0x4 /end DAQ_EVENT
 /end IF_DATA
/end MEASUREMENT
/begin MEASUREMENT task_5.counter32 "Taskloop counter 32 bit" ULONG NO_COMPU_METHOD 0 0 0 4.29497e+09 ECU_ADDRESS 0x100013C ECU_ADDRESS_EXTENSION 2 READ_WRITE
 /begin IF_DATA XCP
  /begin DAQ_EVENT FIXED_EVENT_LIST EVENT 0x4 /end DAQ_EVENT
 /end IF_DATA
/end MEASUREMENT
/begin MEASUREMENT task_5.counter64 "Taskloop counter 64 bit" A_UINT64 NO_COMPU_METHOD 0 0 0 1e+12 ECU_ADDRESS 0x1000130 ECU_ADDRESS_EXTENSION 2 READ_WRITE
 /begin IF_DATA XCP
  /begin DAQ_EVENT FIXED_EVENT_LIST EVENT 0x4 /end DAQ_EVENT
 /end IF_DATA
/end MEASUREMENT
/begin CHARACTERISTIC task_5.array "task array (to increase measurement workload)" VAL_BLK 0x1000030 U32 0 NO_COMPU_METHOD 0 4.29497e+09 MATRIX_DIM 64 1 ECU_ADDRESS_EXTENSION 2
 /begin IF_DATA XCP
  /begin DAQ_EVENT FIXED_EVENT_LIST EVENT 0x4 /end DAQ_EVENT
 /end IF_DATA
/end CHARACTERISTIC
/begin MEASUREMENT task_6.counter "Taskloop counter" UWORD NO_COMPU_METHOD 0 0 0 65535 ECU_ADDRESS 0x1400146 ECU_ADDRESS_EXTENSION 2 READ_WRITE
 /begin IF_DATA XCP
  /begin DAQ_EVENT FIXED_EVENT_LIST EVENT 0x5 /end DAQ_EVENT
 /end IF_DATA
/end MEASUREMENT
/begin MEASUREMENT task_6.counter8 "Taskloop counter 8 bit" UBYTE NO_COMPU_METHOD 0 0 0 255 ECU_ADDRESS 0x1400145 ECU_ADDRESS_EXTENSION 2 READ_WRITE
 /begin IF_DATA XCP
  /begin DAQ_EVENT FIXED_EVENT_LIST EVENT 0x5 /end DAQ_EVENT
 /end IF_DATA
/end MEASUREMENT
/begin MEASUREMENT task_6.counter16 "Taskloop counter 16 bit" UWORD NO_COMPU_METHOD 0 0 0 65535 ECU_ADDRESS 0x1400142 ECU_ADDRESS_EXTENSION 2 READ_WRITE
 /begin IF_DATA XCP
  /begin DAQ_EVENT FIXED_EVENT_LIST EVENT 0x5 /end DAQ_EVENT
 /end IF_DATA
/end MEASUREMENT
/begin MEASUREMENT task_6.counter32 "Taskloop counter 32 bit" ULONG NO_COMPU_METHOD 0 0 0 4.29497e+09 ECU_ADDRESS 0x140013C ECU_ADDRESS_EXTENSION 2 READ_WRITE
 /begin IF_DATA XCP
  /begin DAQ_EVENT FIXED_EVENT_LIST EVENT 0x5 /end DAQ_EVENT
 /end IF_DATA
/end MEASUREMENT
/begin MEASUREMENT task_6.counter64 "Taskloop counter 64 bit" A_UINT64 NO_COMPU_METHOD 0 0 0 1e+12 ECU_ADDRESS 0x1400130 ECU_ADDRESS_EXTENSION 2 READ_WRITE
 /begin IF_DATA XCP
  /begin DAQ_EVENT FIXED_EVENT_LIST EVENT 0x5 /end DAQ_EVENT
 /end IF_DATA
/end MEASUREMENT
/begin CHARACTERISTIC task_6.array "task array (to increase measurement workload)" VAL_BLK 0x1400030 U32 0 NO_COMPU_METHOD 0 4.29497e+09 MATRIX_DIM 64 1 ECU_ADDRESS_EXTENSION 2
 /begin IF_DATA XCP
  /begin DAQ_EVENT FIXED_EVENT_LIST EVENT 0x5 /end DAQ_EVENT
 /end IF_DATA
/end CHARACTERISTIC
/begin MEASUREMENT task_7.counter "Taskloop counter" UWORD NO_COMPU_METHOD 0 0 0 65535 ECU_ADDRESS 0x1800146 ECU_ADDRESS_EXTENSION 2 READ_WRITE
 /begin IF_DATA XCP
  /begin DAQ_EVENT FIXED_EVENT_LIST EVENT 0x6 /end DAQ_EVENT
 /end IF_DATA
/end MEASUREMENT
/begin MEASUREMENT task_7.counter8 "Taskloop counter 8 bit" UBYTE NO_COMPU_METHOD 0 0 0 255 ECU_ADDRESS 0x1800145 ECU_ADDRESS_EXTENSION 2 READ_WRITE
 /begin IF_DATA XCP
  /begin DAQ_EVENT FIXED_EVENT_LIST EVENT 0x6 /end DAQ_EVENT
 /end IF_DATA
/end MEASUREMENT
/begin MEASUREMENT task_7.counter16 "Taskloop counter 16 bit" UWORD NO_COMPU_METHOD 0 0 0 65535 ECU_ADDRESS 0x1800142 ECU_ADDRESS_EXTENSION 2 READ_WRITE
 /begin IF_DATA XCP
  /begin DAQ_EVENT FIXED_EVENT_LIST EVENT 0x6 /end DAQ_EVENT
 /end IF_DATA
/end MEASUREMENT
/begin MEASUREMENT task_7.counter32 "Taskloop counter 32 bit" ULONG NO_COMPU_METHOD 0 0 0 4.29497e+09 ECU_ADDRESS 0x180013C ECU_ADDRESS_EXTENSION 2 READ_WRITE
 /begin IF_DATA XCP
  /begin DAQ_EVENT FIXED_EVENT_LIST EVENT 0x6 /end DAQ_EVENT
 /end IF_DATA
/end MEASUREMENT
/begin MEASUREMENT task_7.counter64 "Taskloop counter 64 bit" A_UINT64 NO_COMPU_METHOD 0 0 0 1e+12 ECU_ADDRESS 0x1800130 ECU_ADDRESS_EXTENSION 2 READ_WRITE
 /begin IF_DATA XCP
  /begin DAQ_EVENT FIXED_EVENT_LIST EVENT 0x6 /end DAQ_EVENT
 /end IF_DATA
/end MEASUREMENT
/begin CHARACTERISTIC task_7.array "task array (to increase measurement workload)" VAL_BLK 0x1800030 U32 0 NO_COMPU_METHOD 0 4.29497e+09 MATRIX_DIM 64 1 ECU_ADDRESS_EXTENSION 2
 /begin IF_DATA XCP
  /begin DAQ_EVENT FIXED_EVENT_LIST EVENT 0x6 /end DAQ_EVENT
 /end IF_DATA
/end CHARACTERISTIC
/begin MEASUREMENT task_8.counter "Taskloop counter" UWORD NO_COMPU_METHOD 0 0 0 65535 ECU_ADDRESS 0x1C00146 ECU_ADDRESS_EXTENSION 2 READ_WRITE
 /begin IF_DATA XCP
  /begin DAQ_EVENT FIXED_EVENT_LIST EVENT 0x7 /end DAQ_EVENT
 /end IF_DATA
/end MEASUREMENT
/begin MEASUREMENT task_8.counter8 "Taskloop counter 8 bit" UBYTE NO_COMPU_METHOD 0 0 0 255 ECU_ADDRESS 0x1C00145 ECU_ADDRESS_EXTENSION 2 READ_WRITE
 /begin IF_DATA XCP
  /begin DAQ_EVENT FIXED_EVENT_LIST EVENT 0x7 /end DAQ_EVENT
 /end IF_DATA
/end MEASUREMENT
/begin MEASUREMENT task_8.counter16 "Taskloop counter 16 bit" UWORD NO_COMPU_METHOD 0 0 0 65535 ECU_ADDRESS 0x1C00142 ECU_ADDRESS_EXTENSION 2 READ_WRITE
 /begin IF_DATA XCP
  /begin DAQ_EVENT FIXED_EVENT_LIST EVENT 0x7 /end DAQ_EVENT
 /end IF_DATA
/end MEASUREMENT
/begin MEASUREMENT task_8.counter32 "Taskloop counter 32 bit" ULONG NO_COMPU_METHOD 0 0 0 4.29497e+09 ECU_ADDRESS 0x1C0013C ECU_ADDRESS_EXTENSION 2 READ_WRITE
 /begin IF_DATA XCP
  /begin DAQ_EVENT FIXED_EVENT_LIST EVENT 0x7 /end DAQ_EVENT
 /end IF_DATA
/end MEASUREMENT
/begin MEASUREMENT task_8.counter64 "Taskloop counter 64 bit" A_UINT64 NO_COMPU_METHOD 0 0 0 1e+12 ECU_ADDRESS 0x1C00130 ECU_ADDRESS_EXTENSION 2 READ_WRITE
 /begin IF_DATA XCP
  /begin DAQ_EVENT FIXED_EVENT_LIST EVENT 0x7 /end DAQ_EVENT
 /end IF_DATA
/end MEASUREMENT
/begin CHARACTERISTIC task_8.array "task array (to increase measurement workload)" VAL_BLK 0x1C00030 U32 0 NO_COMPU_METHOD 0 4.29497e+09 MATRIX_DIM 64 1 ECU_ADDRESS_EXTENSION 2
 /begin IF_DATA XCP
  /begin DAQ_EVENT FIXED_EVENT_LIST EVENT 0x7 /end DAQ_EVENT
 /end IF_DATA
/end CHARACTERISTIC
/begin MEASUREMENT task_9.counter "Taskloop counter" UWORD NO_COMPU_METHOD 0 0 0 65535 ECU_ADDRESS 0x2000146 ECU_ADDRESS_EXTENSION 2 READ_WRITE
 /begin IF_DATA XCP
  /begin DAQ_EVENT FIXED_EVENT_LIST EVENT 0x8 /end DAQ_EVENT
 /end IF_DATA
/end MEASUREMENT
/begin MEASUREMENT task_9.counter8 "Taskloop counter 8 bit" UBYTE NO_COMPU_METHOD 0 0 0 255 ECU_ADDRESS 0x2000145 ECU_ADDRESS_EXTENSION 2 READ_WRITE
 /begin IF_DATA XCP
  /begin DAQ_EVENT FIXED_EVENT_LIST EVENT 0x8 /end DAQ_EVENT
 /end IF_DATA
/end MEASUREMENT
/begin MEASUREMENT task_9.counter16 "Taskloop counter 16 bit" UWORD NO_COMPU_METHOD 0 0 0 65535 ECU_ADDRESS 0x2000142 ECU_ADDRESS_EXTENSION 2 READ_WRITE
 /begin IF_DATA XCP
  /begin DAQ_EVENT FIXED_EVENT_LIST EVENT 0x8 /end DAQ_EVENT
 /end IF_DATA
/end MEASUREMENT
/begin MEASUREMENT task_9.counter32 "Taskloop counter 32 bit" ULONG NO_COMPU_METHOD 0 0 0 4.29497e+09 ECU_ADDRESS 0x200013C ECU_ADDRESS_EXTENSION 2 READ_WRITE
 /begin IF_DATA XCP
  /begin DAQ_EVENT FIXED_EVENT_LIST EVENT 0x8 /end DAQ_EVENT
 /end IF_DATA
/end MEASUREMENT
/begin MEASUREMENT task_9.counter64 "Taskloop counter 64 bit" A_UINT64 NO_COMPU_METHOD 0 0 0 1e+12 ECU_ADDRESS 0x2000130 ECU_ADDRESS_EXTENSION 2 READ_WRITE
 /begin IF_DATA XCP
  /begin DAQ_EVENT FIXED_EVENT_LIST EVENT 0x8 /end DAQ_EVENT
 /end IF_DATA
/end MEASUREMENT
/begin CHARACTERISTIC task_9.array "task array (to increase measurement workload)" VAL_BLK 0x2000030 U32 0 NO_COMPU_METHOD 0 4.29497e+09 MATRIX_DIM 64 1 ECU_ADDRESS_EXTENSION 2
 /begin IF_DATA XCP
  /begin DAQ_EVENT FIXED_EVENT_LIST EVENT 0x8 /end DAQ_EVENT
 /end IF_DATA
/end CHARACTERISTIC
/begin MEASUREMENT task_10.counter "Taskloop counter" UWORD NO_COMPU_METHOD 0 0 0 65535 ECU_ADDRESS 0x2400146 ECU_ADDRESS_EXTENSION 2 READ_WRITE
 /begin IF_DATA XCP
  /begin DAQ_EVENT FIXED_EVENT_LIST EVENT 0x9 /end DAQ_EVENT
 /end IF_DATA
/end MEASUREMENT
/begin MEASUREMENT task_10.counter8 "Taskloop counter 8 bit" UBYTE NO_COMPU_METHOD 0 0 0 255 ECU_ADDRESS 0x2400145 ECU_ADDRESS_EXTENSION 2 READ_WRITE
 /begin IF_DATA XCP
  /begin DAQ_EVENT FIXED_EVENT_LIST EVENT 0x9 /end DAQ_EVENT
 /end IF_DATA
/end MEASUREMENT
/begin MEASUREMENT task_10.counter16 "Taskloop counter 16 bit" UWORD NO_COMPU_METHOD 0 0 0 65535 ECU_ADDRESS 0x2400142 ECU_ADDRESS_EXTENSION 2 READ_WRITE
 /begin IF_DATA XCP
  /begin DAQ_EVENT FIXED_EVENT_LIST EVENT 0x9 /end DAQ_EVENT
 /end IF_DATA
/end MEASUREMENT
/begin MEASUREMENT task_10.counter32 "Taskloop counter 32 bit" ULONG NO_COMPU_METHOD 0 0 0 4.29497e+09 ECU_ADDRESS 0x240013C ECU_ADDRESS_EXTENSION 2 READ_WRITE
 /begin IF_DATA XCP
  /begin DAQ_EVENT FIXED_EVENT_LIST EVENT 0x9 /end DAQ_EVENT
 /end IF_DATA
/end MEASUREMENT
/begin MEASUREMENT task_10.counter64 "Taskloop counter 64 bit" A_UINT64 NO_COMPU_METHOD 0 0 0 1e+12 ECU_ADDRESS 0x2400130 ECU_ADDRESS_EXTENSION 2 READ_WRITE
 /begin IF_DATA XCP
  /begin DAQ_EVENT FIXED_EVENT_LIST EVENT 0x9 /end DAQ_EVENT
 /end IF_DATA
/end MEASUREMENT
/begin CHARACTERISTIC task_10.array "task array (to increase measurement workload)" VAL_BLK 0x2400030 U32 0 NO_COMPU_METHOD 0 4.29497e+09 MATRIX_DIM 64 1 ECU_ADDRESS_EXTENSION 2
 /begin IF_DATA XCP
  /begin DAQ_EVENT FIXED_EVENT_LIST EVENT 0x9 /end DAQ_EVENT
 /end IF_DATA
/end CHARACTERISTIC
/begin MEASUREMENT task_11.counter "Taskloop counter" UWORD NO_COMPU_METHOD 0 0 0 65535 ECU_ADDRESS 0x2800146 ECU_ADDRESS_EXTENSION 2 READ_WRITE
 /begin IF_DATA XCP
  /begin DAQ_EVENT FIXED_EVENT_LIST EVENT 0xA /end DAQ_EVENT
 /end IF_DATA
/end MEASUREMENT
/begin MEASUREMENT task_11.counter8 "Taskloop counter 8 bit" UBYTE NO_COMPU_METHOD 0 0 0 255 ECU_ADDRESS 0x2800145 ECU_ADDRESS_EXTENSION 2 READ_WRITE
 /begin IF_DATA XCP
  /begin DAQ_EVENT FIXED_EVENT_LIST EVENT 0xA /end DAQ_EVENT
 /end IF_DATA
/end MEASUREMENT
/begin MEASUREMENT task_11.counter16 "Taskloop counter 16 bit" UWORD NO_COMPU_METHOD 0 0 0 65535 ECU_ADDRESS 0x2800142 ECU_ADDRESS_EXTENSION 2 READ_WRITE
 /begin IF_DATA XCP
  /begin DAQ_EVENT FIXED_EVENT_LIST EVENT 0xA /end DAQ_EVENT
 /end IF_DATA
/end MEASUREMENT
/begin MEASUREMENT task_11.counter32 "Taskloop counter 32 bit" ULONG NO_COMPU_METHOD 0 0 0 4.29497e+09 ECU_ADDRESS 0x280013C ECU_ADDRESS_EXTENSION 2 READ_WRITE
 /begin IF_DATA XCP
  /begin DAQ_EVENT FIXED_EVENT_LIST EVENT 0xA /end DAQ_EVENT
 /end IF_DATA
/end MEASUREMENT
/begin MEASUREMENT task_11.counter64 "Taskloop counter 64 bit" A_UINT64 NO_COMPU_METHOD 0 0 0 1e+12 ECU_ADDRESS 0x2800130 ECU_ADDRESS_EXTENSION 2 READ_WRITE
 /begin IF_DATA XCP
  /begin DAQ_EVENT FIXED_EVENT_LIST EVENT 0xA /end DAQ_EVENT
 /end IF_DATA
/end MEASUREMENT
/begin CHARACTERISTIC task_11.array "task array (to increase measurement workload)" VAL_BLK 0x2800030 U32 0 NO_COMPU_METHOD 0 4.29497e+09 MATRIX_DIM 64 1 ECU_ADDRESS_EXTENSION 2
 /begin IF_DATA XCP
  /begin DAQ_EVENT FIXED_EVENT_LIST EVENT 0xA /end DAQ_EVENT
 /end IF_DATA
/end CHARACTERISTIC
/begin MEASUREMENT task_12.counter "Taskloop counter" UWORD NO_COMPU_METHOD 0 0 0 65535 ECU_ADDRESS 0x2C00146 ECU_ADDRESS_EXTENSION 2 READ_WRITE
 /begin IF_DATA XCP
  /begin DAQ_EVENT FIXED_EVENT_LIST EVENT 0xB /end DAQ_EVENT
 /end IF_DATA
/end MEASUREMENT
/begin MEASUREMENT task_12.counter8 "Taskloop counter 8 bit" UBYTE NO_COMPU_METHOD 0 0 0 255 ECU_ADDRESS 0x2C00145 ECU_ADDRESS_EXTENSION 2 READ_WRITE
 /begin IF_DATA XCP
  /begin DAQ_EVENT FIXED_EVENT_LIST EVENT 0xB /end DAQ_EVENT
 /end IF_DATA
/end MEASUREMENT
/begin MEASUREMENT task_12.counter16 "Taskloop counter 16 bit" UWORD NO_COMPU_METHOD 0 0 0 65535 ECU_ADDRESS 0x2C00142 ECU_ADDRESS_EXTENSION 2 READ_WRITE
 /begin IF_DATA XCP
  /begin DAQ_EVENT FIXED_EVENT_LIST EVENT 0xB /end DAQ_EVENT
 /end IF_DATA
/end MEASUREMENT
/begin MEASUREMENT task_12.counter32 "Taskloop counter 32 bit" ULONG NO_COMPU_METHOD 0 0 0 4.29497e+09 ECU_ADDRESS 0x2C0013C ECU_ADDRESS_EXTENSION 2 READ_WRITE
 /begin IF_DATA XCP
  /begin DAQ_EVENT FIXED_EVENT_LIST EVENT 0xB /end DAQ_EVENT
 /end IF_DATA
/end MEASUREMENT
/begin MEASUREMENT task_12.counter64 "Taskloop counter 64 bit" A_UINT64 NO_COMPU_METHOD 0 0 0 1e+12 ECU_ADDRESS 0x2C00130 ECU_ADDRESS_EXTENSION 2 READ_WRITE
 /begin IF_DATA XCP
  /begin DAQ_EVENT FIXED_EVENT_LIST EVENT 0xB /end DAQ_EVENT
 /end IF_DATA
/end MEASUREMENT
/begin CHARACTERISTIC task_12.array "task array (to increase measurement workload)" VAL_BLK 0x2C00030 U32 0 NO_COMPU_METHOD 0 4.29497e+09 MATRIX_DIM 64 1 ECU_ADDRESS_EXTENSION 2
 /begin IF_DATA XCP
  /begin DAQ_EVENT FIXED_EVENT_LIST EVENT 0xB /end DAQ_EVENT
 /end IF_DATA
/end CHARACTERISTIC
/begin MEASUREMENT task_13.counter "Taskloop counter" UWORD NO_COMPU_METHOD 0 0 0 65535 ECU_ADDRESS 0x3000146 ECU_ADDRESS_EXTENSION 2 READ_WRITE
 /begin IF_DATA XCP
  /begin DAQ_EVENT FIXED_EVENT_LIST EVENT 0xC /end DAQ_EVENT
 /end IF_DATA
/end MEASUREMENT
/begin MEASUREMENT task_13.counter8 "Taskloop counter 8 bit" UBYTE NO_COMPU_METHOD 0 0 0 255 ECU_ADDRESS 0x3000145 ECU_ADDRESS_EXTENSION 2 READ_WRITE
 /begin IF_DATA XCP
  /begin DAQ_EVENT FIXED_EVENT_LIST EVENT 0xC /end DAQ_EVENT
 /end IF_DATA
/end MEASUREMENT
/begin MEASUREMENT task_13.counter16 "Taskloop counter 16 bit" UWORD NO_COMPU_METHOD 0 0 0 65535 ECU_ADDRESS 0x3000142 ECU_ADDRESS_EXTENSION 2 READ_WRITE
 /begin IF_DATA XCP
  /begin DAQ_EVENT FIXED_EVENT_LIST EVENT 0xC /end DAQ_EVENT
 /end IF_DATA
/end MEASUREMENT
/begin MEASUREMENT task_13.counter32 "Taskloop counter 32 bit" ULONG NO_COMPU_METHOD 0 0 0 4.29497e+09 ECU_ADDRESS 0x300013C ECU_ADDRESS_EXTENSION 2 READ_WRITE
 /begin IF_DATA XCP
  /begin DAQ_EVENT FIXED_EVENT_LIST EVENT 0xC /end DAQ_EVENT
 /end IF_DATA
/end MEASUREMENT
/begin MEASUREMENT task_13.counter64 "Taskloop counter 64 bit" A_UINT64 NO_COMPU_METHOD 0 0 0 1e+12 ECU_ADDRESS 0x3000130 ECU_ADDRESS_EXTENSION 2 READ_WRITE
 /begin IF_DATA XCP
  /begin DAQ_EVENT FIXED_EVENT_LIST EVENT 0xC /end DAQ_EVENT
 /end IF_DATA
/end MEASUREMENT
/begin CHARACTERISTIC task_13.array "task array (to increase measurement workload)" VAL_BLK 0x3000030 U32 0 NO_COMPU_METHOD 0 4.29497e+09 MATRIX_DIM 64 1 ECU_ADDRESS_EXTENSION 2
 /begin IF_DATA XCP
  /begin DAQ_EVENT FIXED_EVENT_LIST EVENT 0xC /end DAQ_EVENT
 /end IF_DATA
/end CHARACTERISTIC
/begin MEASUREMENT task_2.counter "Taskloop counter" UWORD NO_COMPU_METHOD 0 0 0 65535 ECU_ADDRESS 0x400146 ECU_ADDRESS_EXTENSION 2 READ_WRITE
 /begin IF_DATA XCP
  /begin DAQ_EVENT FIXED_EVENT_LIST EVENT 0x1 /end DAQ_EVENT
 /end IF_DATA
/end MEASUREMENT
/begin MEASUREMENT task_2.counter8 "Taskloop counter 8 bit" UBYTE NO_COMPU_METHOD 0 0 0 255 ECU_ADDRESS 0x400145 ECU_ADDRESS_EXTENSION 2 READ_WRITE
 /begin IF_DATA XCP
  /begin DAQ_EVENT FIXED_EVENT_LIST EVENT 0x1 /end DAQ_EVENT
 /end IF_DATA
/end MEASUREMENT
/begin MEASUREMENT task_2.counter16 "Taskloop counter 16 bit" UWORD NO_COMPU_METHOD 0 0 0 65535 ECU_ADDRESS 0x400142 ECU_ADDRESS_EXTENSION 2 READ_WRITE
 /begin IF_DATA XCP
  /begin DAQ_EVENT FIXED_EVENT_LIST EVENT 0x1 /end DAQ_EVENT
 /end IF_DATA
/end MEASUREMENT
/begin MEASUREMENT task_2.counter32 "Taskloop counter 32 bit" ULONG NO_COMPU_METHOD 0 0 0 4.29497e+09 ECU_ADDRESS 0x40013C ECU_ADDRESS_EXTENSION 2 READ_WRITE
 /begin IF_DATA XCP
  /begin DAQ_EVENT FIXED_EVENT_LIST EVENT 0x1 /end DAQ_EVENT
 /end IF_DATA
/end MEASUREMENT
/begin MEASUREMENT task_2.counter64 "Taskloop counter 64 bit" A_UINT64 NO_COMPU_METHOD 0 0 0 1e+12 ECU_ADDRESS 0x400130 ECU_ADDRESS_EXTENSION 2 READ_WRITE
 /begin IF_DATA XCP
  /begin DAQ_EVENT FIXED_EVENT_LIST EVENT 0x1 /end DAQ_EVENT
 /end IF_DATA
/end MEASUREMENT
/begin CHARACTERISTIC task_2.array "task array (to increase measurement workload)" VAL_BLK 0x400030 U32 0 NO_COMPU_METHOD 0 4.29497e+09 MATRIX_DIM 64 1 ECU_ADDRESS_EXTENSION 2
 /begin IF_DATA XCP
  /begin DAQ_EVENT FIXED_EVENT_LIST EVENT 0x1 /end DAQ_EVENT
 /end IF_DATA
/end CHARACTERISTIC
/begin MEASUREMENT task_15.counter "Taskloop counter" UWORD NO_COMPU_METHOD 0 0 0 65535 ECU_ADDRESS 0x3800146 ECU_ADDRESS_EXTENSION 2 READ_WRITE
 /begin IF_DATA XCP
  /begin DAQ_EVENT FIXED_EVENT_LIST EVENT 0xE /end DAQ_EVENT
 /end IF_DATA
/end MEASUREMENT
/begin MEASUREMENT task_15.counter8 "Taskloop counter 8 bit" UBYTE NO_COMPU_METHOD 0 0 0 255 ECU_ADDRESS 0x3800145 ECU_ADDRESS_EXTENSION 2 READ_WRITE
 /begin IF_DATA XCP
  /begin DAQ_EVENT FIXED_EVENT_LIST EVENT 0xE /end DAQ_EVENT
 /end IF_DATA
/end MEASUREMENT
/begin MEASUREMENT task_15.counter16 "Taskloop counter 16 bit" UWORD NO_COMPU_METHOD 0 0 0 65535 ECU_ADDRESS 0x3800142 ECU_ADDRESS_EXTENSION 2 READ_WRITE
 /begin IF_DATA XCP
  /begin DAQ_EVENT FIXED_EVENT_LIST EVENT 0xE /end DAQ_EVENT
 /end IF_DATA
/end MEASUREMENT
/begin MEASUREMENT task_15.counter32 "Taskloop counter 32 bit" ULONG NO_COMPU_METHOD 0 0 0 4.29497e+09 ECU_ADDRESS 0x380013C ECU_ADDRESS_EXTENSION 2 READ_WRITE
 /begin IF_DATA XCP
  /begin DAQ_EVENT FIXED_EVENT_LIST EVENT 0xE /end DAQ_EVENT
 /end IF_DATA
/end MEASUREMENT
/begin MEASUREMENT task_15.counter64 "Taskloop counter 64 bit" A_UINT64 NO_COMPU_METHOD 0 0 0 1e+12 ECU_ADDRESS 0x3800130 ECU_ADDRESS_EXTENSION 2 READ_WRITE
 /begin IF_DATA XCP
  /begin DAQ_EVENT FIXED_EVENT_LIST EVENT 0xE /end DAQ_EVENT
 /end IF_DATA
/end MEASUREMENT
/begin CHARACTERISTIC task_15.array "task array (to increase measurement workload)" VAL_BLK 0x3800030 U32 0 NO_COMPU_METHOD 0 4.29497e+09 MATRIX_DIM 64 1 ECU_ADDRESS_EXTENSION 2
 /begin IF_DATA XCP
  /begin DAQ_EVENT FIXED_EVENT_LIST EVENT 0xE /end DAQ_EVENT
 /end IF_DATA
/end CHARACTERISTIC
/begin MEASUREMENT task_16.counter "Taskloop counter" UWORD NO_COMPU_METHOD 0 0 0 65535 ECU_ADDRESS 0x3C00146 ECU_ADDRESS_EXTENSION 2 READ_WRITE
 /begin IF_DATA XCP
  /begin DAQ_EVENT FIXED_EVENT_LIST EVENT 0xF /end DAQ_EVENT
 /end IF_DATA
/end MEASUREMENT
/begin MEASUREMENT task_16.counter8 "Taskloop counter 8 bit" UBYTE NO_COMPU_METHOD 0 0 0 255 ECU_ADDRESS 0x3C00145 ECU_ADDRESS_EXTENSION 2 READ_WRITE
 /begin IF_DATA XCP
  /begin DAQ_EVENT FIXED_EVENT_LIST EVENT 0xF /end DAQ_EVENT
 /end IF_DATA
/end MEASUREMENT
/begin MEASUREMENT task_16.counter16 "Taskloop counter 16 bit" UWORD NO_COMPU_METHOD 0 0 0 65535 ECU_ADDRESS 0x3C00142 ECU_ADDRESS_EXTENSION 2 READ_WRITE
 /begin IF_DATA XCP
  /begin DAQ_EVENT FIXED_EVENT_LIST EVENT 0xF /end DAQ_EVENT
 /end IF_DATA
/end MEASUREMENT
/begin MEASUREMENT task_16.counter32 "Taskloop counter 32 bit" ULONG NO_COMPU_METHOD 0 0 0 4.29497e+09 ECU_ADDRESS 0x3C0013C ECU_ADDRESS_EXTENSION 2 READ_WRITE
 /begin IF_DATA XCP
  /begin DAQ_EVENT FIXED_EVENT_LIST EVENT 0xF /end DAQ_EVENT
 /end IF_DATA
/end MEASUREMENT
/begin MEASUREMENT task_16.counter64 "Taskloop counter 64 bit" A_UINT64 NO_COMPU_METHOD 0 0 0 1e+12 ECU_ADDRESS 0x3C00130 ECU_ADDRESS_EXTENSION 2 READ_WRITE
 /begin IF_DATA XCP
  /begin DAQ_EVENT FIXED_EVENT_LIST EVENT 0xF /end DAQ_EVENT
 /end IF_DATA
/end MEASUREMENT
/begin CHARACTERISTIC task_16.array "task array (to increase measurement workload)" VAL_BLK 0x3C00030 U32 0 NO_COMPU_METHOD 0 4.29497e+09 MATRIX_DIM 64 1 ECU_ADDRESS_EXTENSION 2
 /begin IF_DATA XCP
  /begin DAQ_EVENT FIXED_EVENT_LIST EVENT 0xF /end DAQ_EVENT
 /end IF_DATA
/end CHARACTERISTIC
/begin MEASUREMENT task_17.counter "Taskloop counter" UWORD NO_COMPU_METHOD 0 0 0 65535 ECU_ADDRESS 0x4000146 ECU_ADDRESS_EXTENSION 2 READ_WRITE
 /begin IF_DATA XCP
  /begin DAQ_EVENT FIXED_EVENT_LIST EVENT 0x10 /end DAQ_EVENT
 /end IF_DATA
/end MEASUREMENT
/begin MEASUREMENT task_17.counter8 "Taskloop counter 8 bit" UBYTE NO_COMPU_METHOD 0 0 0 255 ECU_ADDRESS 0x4000145 ECU_ADDRESS_EXTENSION 2 READ_WRITE
 /begin IF_DATA XCP
  /begin DAQ_EVENT FIXED_EVENT_LIST EVENT 0x10 /end DAQ_EVENT
 /end IF_DATA
/end MEASUREMENT
/begin MEASUREMENT task_17.counter16 "Taskloop counter 16 bit" UWORD NO_COMPU_METHOD 0 0 0 65535 ECU_ADDRESS 0x4000142 ECU_ADDRESS_EXTENSION 2 READ_WRITE
 /begin IF_DATA XCP
  /begin DAQ_EVENT FIXED_EVENT_LIST EVENT 0x10 /end DAQ_EVENT
 /end IF_DATA
/end MEASUREMENT
/begin MEASUREMENT task_17.counter32 "Taskloop counter 32 bit" ULONG NO_COMPU_METHOD 0 0 0 4.29497e+09 ECU_ADDRESS 0x400013C ECU_ADDRESS_EXTENSION 2 READ_WRITE
 /begin IF_DATA XCP
  /begin DAQ_EVENT FIXED_EVENT_LIST EVENT 0x10 /end DAQ_EVENT
 /end IF_DATA
/end MEASUREMENT
/begin MEASUREMENT task_17.counter64 "Taskloop counter 64 bit" A_UINT64 NO_COMPU_METHOD 0 0 0 1e+12 ECU_ADDRESS 0x4000130 ECU_ADDRESS_EXTENSION 2 READ_WRITE
 /begin IF_DATA XCP
  /begin DAQ_EVENT FIXED_EVENT_LIST EVENT 0x10 /end DAQ_EVENT
 /end IF_DATA
/end MEASUREMENT
/begin CHARACTERISTIC task_17.array "task array (to increase measurement workload)" VAL_BLK 0x4000030 U32 0 NO_COMPU_METHOD 0 4.29497e+09 MATRIX_DIM 64 1 ECU_ADDRESS_EXTENSION 2
 /begin IF_DATA XCP
  /begin DAQ_EVENT FIXED_EVENT_LIST EVENT 0x10 /end DAQ_EVENT
 /end IF_DATA
/end CHARACTERISTIC
/begin MEASUREMENT task_18.counter "Taskloop counter" UWORD NO_COMPU_METHOD 0 0 0 65535 ECU_ADDRESS 0x4400146 ECU_ADDRESS_EXTENSION 2 READ_WRITE
 /begin IF_DATA XCP
  /begin DAQ_EVENT FIXED_EVENT_LIST EVENT 0x11 /end DAQ_EVENT
 /end IF_DATA
/end MEASUREMENT
/begin MEASUREMENT task_18.counter8 "Taskloop counter 8 bit" UBYTE NO_COMPU_METHOD 0 0 0 255 ECU_ADDRESS 0x4400145 ECU_ADDRESS_EXTENSION 2 READ_WRITE
 /begin IF_DATA XCP
  /begin DAQ_EVENT FIXED_EVENT_LIST EVENT 0x11 /end DAQ_EVENT
 /end IF_DATA
/end MEASUREMENT
/begin MEASUREMENT task_18.counter16 "Taskloop counter 16 bit" UWORD NO_COMPU_METHOD 0 0 0 65535 ECU_ADDRESS 0x4400142 ECU_ADDRESS_EXTENSION 2 READ_WRITE
 /begin IF_DATA XCP
  /begin DAQ_EVENT FIXED_EVENT_LIST EVENT 0x11 /end DAQ_EVENT
 /end IF_DATA
/end MEASUREMENT
/begin MEASUREMENT task_18.counter32 "Taskloop counter 32 bit" ULONG NO_COMPU_METHOD 0 0 0 4.29497e+09 ECU_ADDRESS 0x440013C ECU_ADDRESS_EXTENSION 2 READ_WRITE
 /begin IF_DATA XCP
  /begin DAQ_EVENT FIXED_EVENT_LIST EVENT 0x11 /end DAQ_EVENT
 /end IF_DATA
/end MEASUREMENT
/begin MEASUREMENT task_18.counter64 "Taskloop counter 64 bit" A_UINT64 NO_COMPU_METHOD 0 0 0 1e+12 ECU_ADDRESS 0x4400130 ECU_ADDRESS_EXTENSION 2 READ_WRITE
 /begin IF_DATA XCP
  /begin DAQ_EVENT FIXED_EVENT_LIST EVENT 0x11 /end DAQ_EVENT
 /end IF_DATA
/end MEASUREMENT
/begin CHARACTERISTIC task_18.array "task array (to increase measurement workload)" VAL_BLK 0x4400030 U32 0 NO_COMPU_METHOD 0 4.29497e+09 MATRIX_DIM 64 1 ECU_ADDRESS_EXTENSION 2
 /begin IF_DATA XCP
  /begin DAQ_EVENT FIXED_EVENT_LIST EVENT 0x11 /end DAQ_EVENT
 /end IF_DATA
/end CHARACTERISTIC
/begin MEASUREMENT counter "Main loop counter" UWORD NO_COMPU_METHOD 0 0 0 65535 ECU_ADDRESS 0x8000016 ECU_ADDRESS_EXTENSION 2 READ_WRITE
 /begin IF_DATA XCP
  /begin DAQ_EVENT FIXED_EVENT_LIST EVENT 0x20 /end DAQ_EVENT
 /end IF_DATA
/end MEASUREMENT
/begin MEASUREMENT task_19.counter "Taskloop counter" UWORD NO_COMPU_METHOD 0 0 0 65535 ECU_ADDRESS 0x4800146 ECU_ADDRESS_EXTENSION 2 READ_WRITE
 /begin IF_DATA XCP
  /begin DAQ_EVENT FIXED_EVENT_LIST EVENT 0x12 /end DAQ_EVENT
 /end IF_DATA
/end MEASUREMENT
/begin MEASUREMENT task_19.counter8 "Taskloop counter 8 bit" UBYTE NO_COMPU_METHOD 0 0 0 255 ECU_ADDRESS 0x4800145 ECU_ADDRESS_EXTENSION 2 READ_WRITE
 /begin IF_DATA XCP
  /begin DAQ_EVENT FIXED_EVENT_LIST EVENT 0x12 /end DAQ_EVENT
 /end IF_DATA
/end MEASUREMENT
/begin MEASUREMENT task_19.counter16 "Taskloop counter 16 bit" UWORD NO_COMPU_METHOD 0 0 0 65535 ECU_ADDRESS 0x4800142 ECU_ADDRESS_EXTENSION 2 READ_WRITE
 /begin IF_DATA XCP
  /begin DAQ_EVENT FIXED_EVENT_LIST EVENT 0x12 /end DAQ_EVENT
 /end IF_DATA
/end MEASUREMENT
/begin MEASUREMENT task_19.counter32 "Taskloop counter 32 bit" ULONG NO_COMPU_METHOD 0 0 0 4.29497e+09 ECU_ADDRESS 0x480013C ECU_ADDRESS_EXTENSION 2 READ_WRITE
 /begin IF_DATA XCP
  /begin DAQ_EVENT FIXED_EVENT_LIST EVENT 0x12 /end DAQ_EVENT
 /end IF_DATA
/end MEASUREMENT
/begin MEASUREMENT task_19.counter64 "Taskloop counter 64 bit" A_UINT64 NO_COMPU_METHOD 0 0 0 1e+12 ECU_ADDRESS 0x4800130 ECU_ADDRESS_EXTENSION 2 READ_WRITE
 /begin IF_DATA XCP
  /begin DAQ_EVENT FIXED_EVENT_LIST EVENT 0x12 /end DAQ_EVENT
 /end IF_DATA
/end MEASUREMENT
/begin CHARACTERISTIC task_19.array "task array (to increase measurement workload)" VAL_BLK 0x4800030 U32 0 NO_COMPU_METHOD 0 4.29497e+09 MATRIX_DIM 64 1 ECU_ADDRESS_EXTENSION 2
 /begin IF_DATA XCP
  /begin DAQ_EVENT FIXED_EVENT_LIST EVENT 0x12 /end DAQ_EVENT
 /end IF_DATA
/end CHARACTERISTIC
/begin MEASUREMENT task_20.counter "Taskloop counter" UWORD NO_COMPU_METHOD 0 0 0 65535 ECU_ADDRESS 0x4C00146 ECU_ADDRESS_EXTENSION 2 READ_WRITE
 /begin IF_DATA XCP
  /begin DAQ_EVENT FIXED_EVENT_LIST EVENT 0x13 /end DAQ_EVENT
 /end IF_DATA
/end MEASUREMENT
/begin MEASUREMENT task_20.counter8 "Taskloop counter 8 bit" UBYTE NO_COMPU_METHOD 0 0 0 255 ECU_ADDRESS 0x4C00145 ECU_ADDRESS_EXTENSION 2 READ_WRITE
 /begin IF_DATA XCP
  /begin DAQ_EVENT FIXED_EVENT_LIST EVENT 0x13 /end DAQ_EVENT
 /end IF_DATA
/end MEASUREMENT
/begin MEASUREMENT task_20.counter16 "Taskloop counter 16 bit" UWORD NO_COMPU_METHOD 0 0 0 65535 ECU_ADDRESS 0x4C00142 ECU_ADDRESS_EXTENSION 2 READ_WRITE
 /begin IF_DATA XCP
  /begin DAQ_EVENT FIXED_EVENT_LIST EVENT 0x13 /end DAQ_EVENT
 /end IF_DATA
/end MEASUREMENT
/begin MEASUREMENT task_20.counter32 "Taskloop counter 32 bit" ULONG NO_COMPU_METHOD 0 0 0 4.29497e+09 ECU_ADDRESS 0x4C0013C ECU_ADDRESS_EXTENSION 2 READ_WRITE
 /begin IF_DATA XCP
  /begin DAQ_EVENT FIXED_EVENT_LIST EVENT 0x13 /end DAQ_EVENT
 /end IF_DATA
/end MEASUREMENT
/begin MEASUREMENT task_20.counter64 "Taskloop counter 64 bit" A_UINT64 NO_COMPU_METHOD 0 0 0 1e+12 ECU_ADDRESS 0x4C00130 ECU_ADDRESS_EXTENSION 2 READ_WRITE
 /begin IF_DATA XCP
  /begin DAQ_EVENT FIXED_EVENT_LIST EVENT 0x13 /end DAQ_EVENT
 /end IF_DATA
/end MEASUREMENT
/begin CHARACTERISTIC task_20.array "task array (to increase measurement workload)" VAL_BLK 0x4C00030 U32 0 NO_COMPU_METHOD 0 4.29497e+09 MATRIX_DIM 64 1 ECU_ADDRESS_EXTENSION 2
 /begin IF_DATA XCP
  /begin DAQ_EVENT FIXED_EVENT_LIST EVENT 0x13 /end DAQ_EVENT
 /end IF_DATA
/end CHARACTERISTIC
/begin MEASUREMENT task_21.counter "Taskloop counter" UWORD NO_COMPU_METHOD 0 0 0 65535 ECU_ADDRESS 0x5000146 ECU_ADDRESS_EXTENSION 2 READ_WRITE
 /begin IF_DATA XCP
  /begin DAQ_EVENT FIXED_EVENT_LIST EVENT 0x14 /end DAQ_EVENT
 /end IF_DATA
/end MEASUREMENT
/begin MEASUREMENT task_21.counter8 "Taskloop counter 8 bit" UBYTE NO_COMPU_METHOD 0 0 0 255 ECU_ADDRESS 0x5000145 ECU_ADDRESS_EXTENSION 2 READ_WRITE
 /begin IF_DATA XCP
  /begin DAQ_EVENT FIXED_EVENT_LIST EVENT 0x14 /end DAQ_EVENT
 /end IF_DATA
/end MEASUREMENT
/begin MEASUREMENT task_21.counter16 "Taskloop counter 16 bit" UWORD NO_COMPU_METHOD 0 0 0 65535 ECU_ADDRESS 0x5000142 ECU_ADDRESS_EXTENSION 2 READ_WRITE
 /begin IF_DATA XCP
  /begin DAQ_EVENT FIXED_EVENT_LIST EVENT 0x14 /end DAQ_EVENT
 /end IF_DATA
/end MEASUREMENT
/begin MEASUREMENT task_21.counter32 "Taskloop counter 32 bit" ULONG NO_COMPU_METHOD 0 0 0 4.29497e+09 ECU_ADDRESS 0x500013C ECU_ADDRESS_EXTENSION 2 READ_WRITE
 /begin IF_DATA XCP
  /begin DAQ_EVENT FIXED_EVENT_LIST EVENT 0x14 /end DAQ_EVENT
 /end IF_DATA
/end MEASUREMENT
/begin MEASUREMENT task_21.counter64 "Taskloop counter 64 bit" A_UINT64 NO_COMPU_METHOD 0 0 0 1e+12 ECU_ADDRESS 0x5000130 ECU_ADDRESS_EXTENSION 2 READ_WRITE
 /begin IF_DATA XCP
  /begin DAQ_EVENT FIXED_EVENT_LIST EVENT 0x14 /end DAQ_EVENT
 /end IF_DATA
/end MEASUREMENT
/begin CHARACTERISTIC task_21.array "task array (to increase measurement workload)" VAL_BLK 0x5000030 U32 0 NO_COMPU_METHOD 0 4.29497e+09 MATRIX_DIM 64 1 ECU_ADDRESS_EXTENSION 2
 /begin IF_DATA XCP
  /begin DAQ_EVENT FIXED_EVENT_LIST EVENT 0x14 /end DAQ_EVENT
 /end IF_DATA
/end CHARACTERISTIC
/begin MEASUREMENT task_22.counter "Taskloop counter" UWORD NO_COMPU_METHOD 0 0 0 65535 ECU_ADDRESS 0x5400146 ECU_ADDRESS_EXTENSION 2 READ_WRITE
 /begin IF_DATA XCP
  /begin DAQ_EVENT FIXED_EVENT_LIST EVENT 0x15 /end DAQ_EVENT
 /end IF_DATA
/end MEASUREMENT
/begin MEASUREMENT task_22.counter8 "Taskloop counter 8 bit" UBYTE NO_COMPU_METHOD 0 0 0 255 ECU_ADDRESS 0x5400145 ECU_ADDRESS_EXTENSION 2 READ_WRITE
 /begin IF_DATA XCP
  /begin DAQ_EVENT FIXED_EVENT_LIST EVENT 0x15 /end DAQ_EVENT
 /end IF_DATA
/end MEASUREMENT
/begin MEASUREMENT task_22.counter16 "Taskloop counter 16 bit" UWORD NO_COMPU_METHOD 0 0 0 65535 ECU_ADDRESS 0x5400142 ECU_ADDRESS_EXTENSION 2 READ_WRITE
 /begin IF_DATA XCP
  /begin DAQ_EVENT FIXED_EVENT_LIST EVENT 0x15 /end DAQ_EVENT
 /end IF_DATA
/end MEASUREMENT
/begin MEASUREMENT task_22.counter32 "Taskloop counter 32 bit" ULONG NO_COMPU_METHOD 0 0 0 4.29497e+09 ECU_ADDRESS 0x540013C ECU_ADDRESS_EXTENSION 2 READ_WRITE
 /begin IF_DATA XCP
  /begin DAQ_EVENT FIXED_EVENT_LIST EVENT 0x15 /end DAQ_EVENT
 /end IF_DATA
/end MEASUREMENT
/begin MEASUREMENT task_22.counter64 "Taskloop counter 64 bit" A_UINT64 NO_COMPU_METHOD 0 0 0 1e+12 ECU_ADDRESS 0x5400130 ECU_ADDRESS_EXTENSION 2 READ_WRITE
 /begin IF_DATA XCP
  /begin DAQ_EVENT FIXED_EVENT_LIST EVENT 0x15 /end DAQ_EVENT
 /end IF_DATA
/end MEASUREMENT
/begin CHARACTERISTIC task_22.array "task array (to increase measurement workload)" VAL_BLK 0x5400030 U32 0 NO_COMPU_METHOD 0 4.29497e+09 MATRIX_DIM 64 1 ECU_ADDRESS_EXTENSION 2
 /begin IF_DATA XCP
  /begin DAQ_EVENT FIXED_EVENT_LIST EVENT 0x15 /end DAQ_EVENT
 /end IF_DATA
/end CHARACTERISTIC
/begin MEASUREMENT task_23.counter "Taskloop counter" UWORD NO_COMPU_METHOD 0 0 0 65535 ECU_ADDRESS 0x5800146 ECU_ADDRESS_EXTENSION 2 READ_WRITE
 /begin IF_DATA XCP
  /begin DAQ_EVENT FIXED_EVENT_LIST EVENT 0x16 /end DAQ_EVENT
 /end IF_DATA
/end MEASUREMENT
/begin MEASUREMENT task_23.counter8 "Taskloop counter 8 bit" UBYTE NO_COMPU_METHOD 0 0 0 255 ECU_ADDRESS 0x5800145 ECU_ADDRESS_EXTENSION 2 READ_WRITE
 /begin IF_DATA XCP
  /begin DAQ_EVENT FIXED_EVENT_LIST EVENT 0x16 /end DAQ_EVENT
 /end IF_DATA
/end MEASUREMENT
/begin MEASUREMENT task_23.counter16 "Taskloop counter 16 bit" UWORD NO_COMPU_METHOD 0 0 0 65535 ECU_ADDRESS 0x5800142 ECU_ADDRESS_EXTENSION 2 READ_WRITE
 /begin IF_DATA XCP
  /begin DAQ_EVENT FIXED_EVENT_LIST EVENT 0x16 /end DAQ_EVENT
 /end IF_DATA
/end MEASUREMENT
/begin MEASUREMENT task_23.counter32 "Taskloop counter 32 bit" ULONG NO_COMPU_METHOD 0 0 0 4.29497e+09 ECU_ADDRESS 0x580013C ECU_ADDRESS_EXTENSION 2 READ_WRITE
 /begin IF_DATA XCP
  /begin DAQ_EVENT FIXED_EVENT_LIST EVENT 0x16 /end DAQ_EVENT
 /end IF_DATA
/end MEASUREMENT
/begin MEASUREMENT task_23.counter64 "Taskloop counter 64 bit" A_UINT64 NO_COMPU_METHOD 0 0 0 1e+12 ECU_ADDRESS 0x5800130 ECU_ADDRESS_EXTENSION 2 READ_WRITE
 /begin IF_DATA XCP
  /begin DAQ_EVENT FIXED_EVENT_LIST EVENT 0x16 /end DAQ_EVENT
 /end IF_DATA
/end MEASUREMENT
/begin CHARACTERISTIC task_23.array "task array (to increase measurement workload)" VAL_BLK 0x5800030 U32 0 NO_COMPU_METHOD 0 4.29497e+09 MATRIX_DIM 64 1 ECU_ADDRESS_EXTENSION 2
 /begin IF_DATA XCP
  /begin DAQ_EVENT FIXED_EVENT_LIST EVENT 0x16 /end DAQ_EVENT
 /end IF_DATA
/end CHARACTERISTIC
/begin MEASUREMENT task_24.counter "Taskloop counter" UWORD NO_COMPU_METHOD 0 0 0 65535 ECU_ADDRESS 0x5C00146 ECU_ADDRESS_EXTENSION 2 READ_WRITE
 /begin IF_DATA XCP
  /begin DAQ_EVENT FIXED_EVENT_LIST EVENT 0x17 /end DAQ_EVENT
 /end IF_DATA
/end MEASUREMENT
/begin MEASUREMENT task_24.counter8 "Taskloop counter 8 bit" UBYTE NO_COMPU_METHOD 0 0 0 255 ECU_ADDRESS 0x5C00145 ECU_ADDRESS_EXTENSION 2 READ_WRITE
 /begin IF_DATA XCP
  /begin DAQ_EVENT FIXED_EVENT_LIST EVENT 0x17 /end DAQ_EVENT
 /end IF_DATA
/end MEASUREMENT
/begin MEASUREMENT task_24.counter16 "Taskloop counter 16 bit" UWORD NO_COMPU_METHOD 0 0 0 65535 ECU_ADDRESS 0x5C00142 ECU_ADDRESS_EXTENSION 2 READ_WRITE
 /begin IF_DATA XCP
  /begin DAQ_EVENT FIXED_EVENT_LIST EVENT 0x17 /end DAQ_EVENT
 /end IF_DATA
/end MEASUREMENT
/begin MEASUREMENT task_24.counter32 "Taskloop counter 32 bit" ULONG NO_COMPU_METHOD 0 0 0 4.29497e+09 ECU_ADDRESS 0x5C0013C ECU_ADDRESS_EXTENSION 2 READ_WRITE
 /begin IF_DATA XCP
  /begin DAQ_EVENT FIXED_EVENT_LIST EVENT 0x17 /end DAQ_EVENT
 /end IF_DATA
/end MEASUREMENT
/begin MEASUREMENT task_24.counter64 "Taskloop counter 64 bit" A_UINT64 NO_COMPU_METHOD 0 0 0 1e+12 ECU_ADDRESS 0x5C00130 ECU_ADDRESS_EXTENSION 2 READ_WRITE
 /begin IF_DATA XCP
  /begin DAQ_EVENT FIXED_EVENT_LIST EVENT 0x17 /end DAQ_EVENT
 /end IF_DATA
/end MEASUREMENT
/begin CHARACTERISTIC task_24.array "task array (to increase measurement workload)" VAL_BLK 0x5C00030 U32 0 NO_COMPU_METHOD 0 4.29497e+09 MATRIX_DIM 64 1 ECU_ADDRESS_EXTENSION 2
 /begin IF_DATA XCP
  /begin DAQ_EVENT FIXED_EVENT_LIST EVENT 0x17 /end DAQ_EVENT
 /end IF_DATA
/end CHARACTERISTIC
/begin MEASUREMENT task_25.counter "Taskloop counter" UWORD NO_COMPU_METHOD 0 0 0 65535 ECU_ADDRESS 0x6000146 ECU_ADDRESS_EXTENSION 2 READ_WRITE
 /begin IF_DATA XCP
  /begin DAQ_EVENT FIXED_EVENT_LIST EVENT 0x18 /end DAQ_EVENT
 /end IF_DATA
/end MEASUREMENT
/begin MEASUREMENT task_25.counter8 "Taskloop counter 8 bit" UBYTE NO_COMPU_METHOD 0 0 0 255 ECU_ADDRESS 0x6000145 ECU_ADDRESS_EXTENSION 2 READ_WRITE
 /begin IF_DATA XCP
  /begin DAQ_EVENT FIXED_EVENT_LIST EVENT 0x18 /end DAQ_EVENT
 /end IF_DATA
/end MEASUREMENT
/begin MEASUREMENT task_25.counter16 "Taskloop counter 16 bit" UWORD NO_COMPU_METHOD 0 0 0 65535 ECU_ADDRESS 0x6000142 ECU_ADDRESS_EXTENSION 2 READ_WRITE
 /begin IF_DATA XCP
  /begin DAQ_EVENT FIXED_EVENT_LIST EVENT 0x18 /end DAQ_EVENT
 /end IF_DATA
/end MEASUREMENT
/begin MEASUREMENT task_25.counter32 "Taskloop counter 32 bit" ULONG NO_COMPU_METHOD 0 0 0 4.29497e+09 ECU_ADDRESS 0x600013C ECU_ADDRESS_EXTENSION 2 READ_WRITE
 /begin IF_DATA XCP
  /begin DAQ_EVENT FIXED_EVENT_LIST EVENT 0x18 /end DAQ_EVENT
 /end IF_DATA
/end MEASUREMENT
/begin MEASUREMENT task_25.counter64 "Taskloop counter 64 bit" A_UINT64 NO_COMPU_METHOD 0 0 0 1e+12 ECU_ADDRESS 0x6000130 ECU_ADDRESS_EXTENSION 2 READ_WRITE
 /begin IF_DATA XCP
  /begin DAQ_EVENT FIXED_EVENT_LIST EVENT 0x18 /end DAQ_EVENT
 /end IF_DATA
/end MEASUREMENT
/begin CHARACTERISTIC task_25.array "task array (to increase measurement workload)" VAL_BLK 0x6000030 U32 0 NO_COMPU_METHOD 0 4.29497e+09 MATRIX_DIM 64 1 ECU_ADDRESS_EXTENSION 2
 /begin IF_DATA XCP
  /begin DAQ_EVENT FIXED_EVENT_LIST EVENT 0x18 /end DAQ_EVENT
 /end IF_DATA
/end CHARACTERISTIC
/begin MEASUREMENT task_26.counter "Taskloop counter" UWORD NO_COMPU_METHOD 0 0 0 65535 ECU_ADDRESS 0x6400146 ECU_ADDRESS_EXTENSION 2 READ_WRITE
 /begin IF_DATA XCP
  /begin DAQ_EVENT FIXED_EVENT_LIST EVENT 0x19 /end DAQ_EVENT
 /end IF_DATA
/end MEASUREMENT
/begin MEASUREMENT task_26.counter8 "Taskloop counter 8 bit" UBYTE NO_COMPU_METHOD 0 0 0 255 ECU_ADDRESS 0x6400145 ECU_ADDRESS_EXTENSION 2 READ_WRITE
 /begin IF_DATA XCP
  /begin DAQ_EVENT FIXED_EVENT_LIST EVENT 0x19 /end DAQ_EVENT
 /end IF_DATA
/end MEASUREMENT
/begin MEASUREMENT task_26.counter16 "Taskloop counter 16 bit" UWORD NO_COMPU_METHOD 0 0 0 65535 ECU_ADDRESS 0x6400142 ECU_ADDRESS_EXTENSION 2 READ_WRITE
 /begin IF_DATA XCP
  /begin DAQ_EVENT FIXED_EVENT_LIST EVENT 0x19 /end DAQ_EVENT
 /end IF_DATA
/end MEASUREMENT
/begin MEASUREMENT task_26.counter32 "Taskloop counter 32 bit" ULONG NO_COMPU_METHOD 0 0 0 4.29497e+09 ECU_ADDRESS 0x640013C ECU_ADDRESS_EXTENSION 2 READ_WRITE
 /begin IF_DATA XCP
  /begin DAQ_EVENT FIXED_EVENT_LIST EVENT 0x19 /end DAQ_EVENT
 /end IF_DATA
/end MEASUREMENT
/begin MEASUREMENT task_26.counter64 "Taskloop counter 64 bit" A_UINT64 NO_COMPU_METHOD 0 0 0 1e+12 ECU_ADDRESS 0x6400130 ECU_ADDRESS_EXTENSION 2 READ_WRITE
 /begin IF_DATA XCP
  /begin DAQ_EVENT FIXED_EVENT_LIST EVENT 0x19 /end DAQ_EVENT
 /end IF_DATA
/end MEASUREMENT
/begin CHARACTERISTIC task_26.array "task array (to increase measurement workload)" VAL_BLK 0x6400030 U32 0 NO_COMPU_METHOD 0 4.29497e+09 MATRIX_DIM 64 1 ECU_ADDRESS_EXTENSION 2
 /begin IF_DATA XCP
  /begin DAQ_EVENT FIXED_EVENT_LIST EVENT 0x19 /end DAQ_EVENT
 /end IF_DATA
/end CHARACTERISTIC
/begin MEASUREMENT task_27.counter "Taskloop counter" UWORD NO_COMPU_METHOD 0 0 0 65535 ECU_ADDRESS 0x6800146 ECU_ADDRESS_EXTENSION 2 READ_WRITE
 /begin IF_DATA XCP
  /begin DAQ_EVENT FIXED_EVENT_LIST EVENT 0x1A /end DAQ_EVENT
 /end IF_DATA
/end MEASUREMENT
/begin MEASUREMENT task_27.counter8 "Taskloop counter 8 bit" UBYTE NO_COMPU_METHOD 0 0 0 255 ECU_ADDRESS 0x6800145 ECU_ADDRESS_EXTENSION 2 READ_WRITE
 /begin IF_DATA XCP
  /begin DAQ_EVENT FIXED_EVENT_LIST EVENT 0x1A /end DAQ_EVENT
 /end IF_DATA
/end MEASUREMENT
/begin MEASUREMENT task_27.counter16 "Taskloop counter 16 bit" UWORD NO_COMPU_METHOD 0 0 0 65535 ECU_ADDRESS 0x6800142 ECU_ADDRESS_EXTENSION 2 READ_WRITE
 /begin IF_DATA XCP
  /begin DAQ_EVENT FIXED_EVENT_LIST EVENT 0x1A /end DAQ_EVENT
 /end IF_DATA
/end MEASUREMENT
/begin MEASUREMENT task_27.counter32 "Taskloop counter 32 bit" ULONG NO_COMPU_METHOD 0 0 0 4.29497e+09 ECU_ADDRESS 0x680013C ECU_ADDRESS_EXTENSION 2 READ_WRITE
 /begin IF_DATA XCP
  /begin DAQ_EVENT FIXED_EVENT_LIST EVENT 0x1A /end DAQ_EVENT
 /end IF_DATA
/end MEASUREMENT
/begin MEASUREMENT task_27.counter64 "Taskloop counter 64 bit" A_UINT64 NO_COMPU_METHOD 0 0 0 1e+12 ECU_ADDRESS 0x6800130 ECU_ADDRESS_EXTENSION 2 READ_WRITE
 /begin IF_DATA XCP
  /begin DAQ_EVENT FIXED_EVENT_LIST EVENT 0x1A /end DAQ_EVENT
 /end IF_DATA
/end MEASUREMENT
/begin CHARACTERISTIC task_27.array "task array (to increase measurement workload)" VAL_BLK 0x6800030 U32 0 NO_COMPU_METHOD 0 4.29497e+09 MATRIX_DIM 64 1 ECU_ADDRESS_EXTENSION 2
 /begin IF_DATA XCP
  /begin DAQ_EVENT FIXED_EVENT_LIST EVENT 0x1A /end DAQ_EVENT
 /end IF_DATA
/end CHARACTERISTIC
/begin MEASUREMENT task_28.counter "Taskloop counter" UWORD NO_COMPU_METHOD 0 0 0 65535 ECU_ADDRESS 0x6C00146 ECU_ADDRESS_EXTENSION 2 READ_WRITE
 /begin IF_DATA XCP
  /begin DAQ_EVENT FIXED_EVENT_LIST EVENT 0x1B /end DAQ_EVENT
 /end IF_DATA
/end MEASUREMENT
/begin MEASUREMENT task_28.counter8 "Taskloop counter 8 bit" UBYTE NO_COMPU_METHOD 0 0 0 255 ECU_ADDRESS 0x6C00145 ECU_ADDRESS_EXTENSION 2 READ_WRITE
 /begin IF_DATA XCP
  /begin DAQ_EVENT FIXED_EVENT_LIST EVENT 0x1B /end DAQ_EVENT
 /end IF_DATA
/end MEASUREMENT
/begin MEASUREMENT task_28.counter16 "Taskloop counter 16 bit" UWORD NO_COMPU_METHOD 0 0 0 65535 ECU_ADDRESS 0x6C00142 ECU_ADDRESS_EXTENSION 2 READ_WRITE
 /begin IF_DATA XCP
  /begin DAQ_EVENT FIXED_EVENT_LIST EVENT 0x1B /end DAQ_EVENT
 /end IF_DATA
/end MEASUREMENT
/begin MEASUREMENT task_28.counter32 "Taskloop counter 32 bit" ULONG NO_COMPU_METHOD 0 0 0 4.29497e+09 ECU_ADDRESS 0x6C0013C ECU_ADDRESS_EXTENSION 2 READ_WRITE
 /begin IF_DATA XCP
  /begin DAQ_EVENT FIXED_EVENT_LIST EVENT 0x1B /end DAQ_EVENT
 /end IF_DATA
/end MEASUREMENT
/begin MEASUREMENT task_28.counter64 "Taskloop counter 64 bit" A_UINT64 NO_COMPU_METHOD 0 0 0 1e+12 ECU_ADDRESS 0x6C00130 ECU_ADDRESS_EXTENSION 2 READ_WRITE
 /begin IF_DATA XCP
  /begin DAQ_EVENT FIXED_EVENT_LIST EVENT 0x1B /end DAQ_EVENT
 /end IF_DATA
/end MEASUREMENT
/begin CHARACTERISTIC task_28.array "task array (to increase measurement workload)" VAL_BLK 0x6C00030 U32 0 NO_COMPU_METHOD 0 4.29497e+09 MATRIX_DIM 64 1 ECU_ADDRESS_EXTENSION 2
 /begin IF_DATA XCP
  /begin DAQ_EVENT FIXED_EVENT_LIST EVENT 0x1B /end DAQ_EVENT
 /end IF_DATA
/end CHARACTERISTIC
/begin MEASUREMENT task_29.counter "Taskloop counter" UWORD NO_COMPU_METHOD 0 0 0 65535 ECU_ADDRESS 0x7000146 ECU_ADDRESS_EXTENSION 2 READ_WRITE
 /begin IF_DATA XCP
  /begin DAQ_EVENT FIXED_EVENT_LIST EVENT 0x1C /end DAQ_EVENT
 /end IF_DATA
/end MEASUREMENT
/begin MEASUREMENT task_29.counter8 "Taskloop counter 8 bit" UBYTE NO_COMPU_METHOD 0 0 0 255 ECU_ADDRESS 0x7000145 ECU_ADDRESS_EXTENSION 2 READ_WRITE
 /begin IF_DATA XCP
  /begin DAQ_EVENT FIXED_EVENT_LIST EVENT 0x1C /end DAQ_EVENT
 /end IF_DATA
/end MEASUREMENT
/begin MEASUREMENT task_29.counter16 "Taskloop counter 16 bit" UWORD NO_COMPU_METHOD 0 0 0 65535 ECU_ADDRESS 0x7000142 ECU_ADDRESS_EXTENSION 2 READ_WRITE
 /begin IF_DATA XCP
  /begin DAQ_EVENT FIXED_EVENT_LIST EVENT 0x1C /end DAQ_EVENT
 /end IF_DATA
/end MEASUREMENT
/begin MEASUREMENT task_29.counter32 "Taskloop counter 32 bit" ULONG NO_COMPU_METHOD 0 0 0 4.29497e+09 ECU_ADDRESS 0x700013C ECU_ADDRESS_EXTENSION 2 READ_WRITE
 /begin IF_DATA XCP
  /begin DAQ_EVENT FIXED_EVENT_LIST EVENT 0x1C /end DAQ_EVENT
 /end IF_DATA
/end MEASUREMENT
/begin MEASUREMENT task_29.counter64 "Taskloop counter 64 bit" A_UINT64 NO_COMPU_METHOD 0 0 0 1e+12 ECU_ADDRESS 0x7000130 ECU_ADDRESS_EXTENSION 2 READ_WRITE
 /begin IF_DATA XCP
  /begin DAQ_EVENT FIXED_EVENT_LIST EVENT 0x1C /end DAQ_EVENT
 /end IF_DATA
/end MEASUREMENT
/begin CHARACTERISTIC task_29.array "task array (to increase measurement workload)" VAL_BLK 0x7000030 U32 0 NO_COMPU_METHOD 0 4.29497e+09 MATRIX_DIM 64 1 ECU_ADDRESS_EXTENSION 2
 /begin IF_DATA XCP
  /begin DAQ_EVENT FIXED_EVENT_LIST EVENT 0x1C /end DAQ_EVENT
 /end IF_DATA
/end CHARACTERISTIC
/begin MEASUREMENT task_30.counter "Taskloop counter" UWORD NO_COMPU_METHOD 0 0 0 65535 ECU_ADDRESS 0x7400146 ECU_ADDRESS_EXTENSION 2 READ_WRITE
 /begin IF_DATA XCP
  /begin DAQ_EVENT FIXED_EVENT_LIST EVENT 0x1D /end DAQ_EVENT
 /end IF_DATA
/end MEASUREMENT
/begin MEASUREMENT task_30.counter8 "Taskloop counter 8 bit" UBYTE NO_COMPU_METHOD 0 0 0 255 ECU_ADDRESS 0x7400145 ECU_ADDRESS_EXTENSION 2 READ_WRITE
 /begin IF_DATA XCP
  /begin DAQ_EVENT FIXED_EVENT_LIST EVENT 0x1D /end DAQ_EVENT
 /end IF_DATA
/end MEASUREMENT
/begin MEASUREMENT task_30.counter16 "Taskloop counter 16 bit" UWORD NO_COMPU_METHOD 0 0 0 65535 ECU_ADDRESS 0x7400142 ECU_ADDRESS_EXTENSION 2 READ_WRITE
 /begin IF_DATA XCP
  /begin DAQ_EVENT FIXED_EVENT_LIST EVENT 0x1D /end DAQ_EVENT
 /end IF_DATA
/end MEASUREMENT
/begin MEASUREMENT task_30.counter32 "Taskloop counter 32 bit" ULONG NO_COMPU_METHOD 0 0 0 4.29497e+09 ECU_ADDRESS 0x740013C ECU_ADDRESS_EXTENSION 2 READ_WRITE
 /begin IF_DATA XCP
  /begin DAQ_EVENT FIXED_EVENT_LIST EVENT 0x1D /end DAQ_EVENT
 /end IF_DATA
/end MEASUREMENT
/begin MEASUREMENT task_30.counter64 "Taskloop counter 64 bit" A_UINT64 NO_COMPU_METHOD 0 0 0 1e+12 ECU_ADDRESS 0x7400130 ECU_ADDRESS_EXTENSION 2 READ_WRITE
 /begin IF_DATA XCP
  /begin DAQ_EVENT FIXED_EVENT_LIST EVENT 0x1D /end DAQ_EVENT
 /end IF_DATA
/end MEASUREMENT
/begin CHARACTERISTIC task_30.array "task array (to increase measurement workload)" VAL_BLK 0x7400030 U32 0 NO_COMPU_METHOD 0 4.29497e+09 MATRIX_DIM 64 1 ECU_ADDRESS_EXTENSION 2
 /begin IF_DATA XCP
  /begin DAQ_EVENT FIXED_EVENT_LIST EVENT 0x1D /end DAQ_EVENT
 /end IF_DATA
/end CHARACTERISTIC
/begin MEASUREMENT task_31.counter "Taskloop counter" UWORD NO_COMPU_METHOD 0 0 0 65535 ECU_ADDRESS 0x7800146 ECU_ADDRESS_EXTENSION 2 READ_WRITE
 /begin IF_DATA XCP
  /begin DAQ_EVENT FIXED_EVENT_LIST EVENT 0x1E /end DAQ_EVENT
 /end IF_DATA
/end MEASUREMENT
/begin MEASUREMENT task_31.counter8 "Taskloop counter 8 bit" UBYTE NO_COMPU_METHOD 0 0 0 255 ECU_ADDRESS 0x7800145 ECU_ADDRESS_EXTENSION 2 READ_WRITE
 /begin IF_DATA XCP
  /begin DAQ_EVENT FIXED_EVENT_LIST EVENT 0x1E /end DAQ_EVENT
 /end IF_DATA
/end MEASUREMENT
/begin MEASUREMENT task_31.counter16 "Taskloop counter 16 bit" UWORD NO_COMPU_METHOD 0 0 0 65535 ECU_ADDRESS 0x7800142 ECU_ADDRESS_EXTENSION 2 READ_WRITE
 /begin IF_DATA XCP
  /begin DAQ_EVENT FIXED_EVENT_LIST EVENT 0x1E /end DAQ_EVENT
 /end IF_DATA
/end MEASUREMENT
/begin MEASUREMENT task_31.counter32 "Taskloop counter 32 bit" ULONG NO_COMPU_METHOD 0 0 0 4.29497e+09 ECU_ADDRESS 0x780013C ECU_ADDRESS_EXTENSION 2 READ_WRITE
 /begin IF_DATA XCP
  /begin DAQ_EVENT FIXED_EVENT_LIST EVENT 0x1E /end DAQ_EVENT
 /end IF_DATA
/end MEASUREMENT
/begin MEASUREMENT task_31.counter64 "Taskloop counter 64 bit" A_UINT64 NO_COMPU_METHOD 0 0 0 1e+12 ECU_ADDRESS 0x7800130 ECU_ADDRESS_EXTENSION 2 READ_WRITE
 /begin IF_DATA XCP
  /begin DAQ_EVENT FIXED_EVENT_LIST EVENT 0x1E /end DAQ_EVENT
 /end IF_DATA
/end MEASUREMENT
/begin CHARACTERISTIC task_31.array "task array (to increase measurement workload)" VAL_BLK 0x7800030 U32 0 NO_COMPU_METHOD 0 4.29497e+09 MATRIX_DIM 64 1 ECU_ADDRESS_EXTENSION 2
 /begin IF_DATA XCP
  /begin DAQ_EVENT FIXED_EVENT_LIST EVENT 0x1E /end DAQ_EVENT
 /end IF_DATA
/end CHARACTERISTIC
/begin MEASUREMENT task_32.counter "Taskloop counter" UWORD NO_COMPU_METHOD 0 0 0 65535 ECU_ADDRESS 0x7C00146 ECU_ADDRESS_EXTENSION 2 READ_WRITE
 /begin IF_DATA XCP
  /begin DAQ_EVENT FIXED_EVENT_LIST EVENT 0x1F /end DAQ_EVENT
 /end IF_DATA
/end MEASUREMENT
/begin MEASUREMENT task_32.counter8 "Taskloop counter 8 bit" UBYTE NO_COMPU_METHOD 0 0 0 255 ECU_ADDRESS 0x7C00145 ECU_ADDRESS_EXTENSION 2 READ_WRITE
 /begin IF_DATA XCP
  /begin DAQ_EVENT FIXED_EVENT_LIST EVENT 0x1F /end DAQ_EVENT
 /end IF_DATA
/end MEASUREMENT
/begin MEASUREMENT task_32.counter16 "Taskloop counter 16 bit" UWORD NO_COMPU_METHOD 0 0 0 65535 ECU_ADDRESS 0x7C00142 ECU_ADDRESS_EXTENSION 2 READ_WRITE
 /begin IF_DATA XCP
  /begin DAQ_EVENT FIXED_EVENT_LIST EVENT 0x1F /end DAQ_EVENT
 /end IF_DATA
/end MEASUREMENT
/begin MEASUREMENT task_32.counter32 "Taskloop counter 32 bit" ULONG NO_COMPU_METHOD 0 0 0 4.29497e+09 ECU_ADDRESS 0x7C0013C ECU_ADDRESS_EXTENSION 2 READ_WRITE
 /begin IF_DATA XCP
  /begin DAQ_EVENT FIXED_EVENT_LIST EVENT 0x1F /end DAQ_EVENT
 /end IF_DATA
/end MEASUREMENT
/begin MEASUREMENT task_32.counter64 "Taskloop counter 64 bit" A_UINT64 NO_COMPU_METHOD 0 0 0 1e+12 ECU_ADDRESS 0x7C00130 ECU_ADDRESS_EXTENSION 2 READ_WRITE
 /begin IF_DATA XCP
  /begin DAQ_EVENT FIXED_EVENT_LIST EVENT 0x1F /end DAQ_EVENT
 /end IF_DATA
/end MEASUREMENT
/begin CHARACTERISTIC task_32.array "task array (to increase measurement workload)" VAL_BLK 0x7C00030 U32 0 NO_COMPU_METHOD 0 4.29497e+09 MATRIX_DIM 64 1 ECU_ADDRESS_EXTENSION 2
 /begin IF_DATA XCP
  /begin DAQ_EVENT FIXED_EVENT_LIST EVENT 0x1F /end DAQ_EVENT
 /end IF_DATA
/end CHARACTERISTIC
/* Typedefs */
/begin RECORD_LAYOUT U8 FNC_VALUES 1 UBYTE ROW_DIR DIRECT /end RECORD_LAYOUT
/begin RECORD_LAYOUT A_U8 AXIS_PTS_X 1 UBYTE INDEX_INCR DIRECT /end RECORD_LAYOUT
/begin TYPEDEF_MEASUREMENT M_U8 "" UBYTE NO_COMPU_METHOD 0 0 0 255 /end TYPEDEF_MEASUREMENT
/begin TYPEDEF_CHARACTERISTIC C_U8 "" VALUE U8 0 NO_COMPU_METHOD 0 255 /end TYPEDEF_CHARACTERISTIC
/begin RECORD_LAYOUT U16 FNC_VALUES 1 UWORD ROW_DIR DIRECT /end RECORD_LAYOUT
/begin RECORD_LAYOUT A_U16 AXIS_PTS_X 1 UWORD INDEX_INCR DIRECT /end RECORD_LAYOUT
/begin TYPEDEF_MEASUREMENT M_U16 "" UWORD NO_COMPU_METHOD 0 0 0 65535 /end TYPEDEF_MEASUREMENT
/begin TYPEDEF_CHARACTERISTIC C_U16 "" VALUE U16 0 NO_COMPU_METHOD 0 65535 /end TYPEDEF_CHARACTERISTIC
/begin RECORD_LAYOUT U32 FNC_VALUES 1 ULONG ROW_DIR DIRECT /end RECORD_LAYOUT
/begin RECORD_LAYOUT A_U32 AXIS_PTS_X 1 ULONG INDEX_INCR DIRECT /end RECORD_LAYOUT
/begin TYPEDEF_MEASUREMENT M_U32 "" ULONG NO_COMPU_METHOD 0 0 0 4294967295 /end TYPEDEF_MEASUREMENT
/begin TYPEDEF_CHARACTERISTIC C_U32 "" VALUE U32 0 NO_COMPU_METHOD 0 4.29497e+09 /end TYPEDEF_CHARACTERISTIC
/begin RECORD_LAYOUT U64 FNC_VALUES 1 A_UINT64 ROW_DIR DIRECT /end RECORD_LAYOUT
/begin RECORD_LAYOUT A_U64 AXIS_PTS_X 1 A_UINT64 INDEX_INCR DIRECT /end RECORD_LAYOUT
/begin TYPEDEF_MEASUREMENT M_U64 "" A_UINT64 NO_COMPU_METHOD 0 0 0 1000000000000 /end TYPEDEF_MEASUREMENT
/begin TYPEDEF_CHARACTERISTIC C_U64 "" VALUE U64 0 NO_COMPU_METHOD 0 1e+12 /end TYPEDEF_CHARACTERISTIC
/begin RECORD_LAYOUT I8 FNC_VALUES 1 SBYTE ROW_DIR DIRECT /end RECORD_LAYOUT
/begin RECORD_LAYOUT A_I8 AXIS_PTS_X 1 SBYTE INDEX_INCR DIRECT /end RECORD_LAYOUT
/begin TYPEDEF_MEASUREMENT M_I8 "" SBYTE NO_COMPU_METHOD 0 0 -128 127 /end TYPEDEF_MEASUREMENT
/begin TYPEDEF_CHARACTERISTIC C_I8 "" VALUE I8 0 NO_COMPU_METHOD -128 127 /end TYPEDEF_CHARACTERISTIC
/begin RECORD_LAYOUT I16 FNC_VALUES 1 SWORD ROW_DIR DIRECT /end RECORD_LAYOUT
/begin RECORD_LAYOUT A_I16 AXIS_PTS_X 1 SWORD INDEX_INCR DIRECT /end RECORD_LAYOUT
/begin TYPEDEF_MEASUREMENT M_I16 "" SWORD NO_COMPU_METHOD 0 0 -32768 32767 /end TYPEDEF_MEASUREMENT
/begin TYPEDEF_CHARACTERISTIC C_I16 "" VALUE I16 0 NO_COMPU_METHOD -32768 32767 /end TYPEDEF_CHARACTERISTIC
/begin RECORD_LAYOUT I32 FNC_VALUES 1 SLONG ROW_DIR DIRECT /end RECORD_LAYOUT
/begin RECORD_LAYOUT A_I32 AXIS_PTS_X 1 SLONG INDEX_INCR DIRECT /end RECORD_LAYOUT
/begin TYPEDEF_MEASUREMENT M_I32 "" SLONG NO_COMPU_METHOD 0 0 -2147483648 2147483647 /end TYPEDEF_MEASUREMENT
/begin TYPEDEF_CHARACTERISTIC C_I32 "" VALUE I32 0 NO_COMPU_METHOD -2.14748e+09 2.14748e+09 /end TYPEDEF_CHARACTERISTIC
/begin RECORD_LAYOUT I64 FNC_VALUES 1 A_INT64 ROW_DIR DIRECT /end RECORD_LAYOUT
/begin RECORD_LAYOUT A_I64 AXIS_PTS_X 1 A_INT64 INDEX_INCR DIRECT /end RECORD_LAYOUT
/begin TYPEDEF_MEASUREMENT M_I64 "" A_INT64 NO_COMPU_METHOD 0 0 -1000000000000 1000000000000 /end TYPEDEF_MEASUREMENT
/begin TYPEDEF_CHARACTERISTIC C_I64 "" VALUE I64 0 NO_COMPU_METHOD -1e+12 1e+12 /end TYPEDEF_CHARACTERISTIC
/begin RECORD_LAYOUT F32 FNC_VALUES 1 FLOAT32_IEEE ROW_DIR DIRECT /end RECORD_LAYOUT
/begin RECORD_LAYOUT A_F32 AXIS_PTS_X 1 FLOAT32_IEEE INDEX_INCR DIRECT /end RECORD_LAYOUT
/begin TYPEDEF_MEASUREMENT M_F32 "" FLOAT32_IEEE NO_COMPU_METHOD 0 0 -1e+12 1e+12 /end TYPEDEF_MEASUREMENT
/begin TYPEDEF_CHARACTERISTIC C_F32 "" VALUE F32 0 NO_COMPU_METHOD -1e+12 1e+12 /end TYPEDEF_CHARACTERISTIC
/begin RECORD_LAYOUT F64 FNC_VALUES 1 FLOAT64_IEEE ROW_DIR DIRECT /end RECORD_LAYOUT
/begin RECORD_LAYOUT A_F64 AXIS_PTS_X 1 FLOAT64_IEEE INDEX_INCR DIRECT /end RECORD_LAYOUT
/begin TYPEDEF_MEASUREMENT M_F64 "" FLOAT64_IEEE NO_COMPU_METHOD 0 0 -1e+12 1e+12 /end TYPEDEF_MEASUREMENT
/begin TYPEDEF_CHARACTERISTIC C_F64 "" VALUE F64 0 NO_COMPU_METHOD -1e+12 1e+12 /end TYPEDEF_CHARACTERISTIC
/* Groups */
/begin GROUP params "Calibration Segment" ROOT
 /begin REF_CHARACTERISTIC params.counter_max params.delay_us params.run params.test_byte1 params.test_byte2 /end REF_CHARACTERISTIC
/end GROUP
/begin GROUP task_1 "Measurement event group"
 /begin REF_MEASUREMENT task_1.counter task_1.counter8 task_1.counter16 task_1.counter32 task_1.counter64 task_1.array /end REF_MEASUREMENT
/end GROUP
/begin GROUP task_14 "Measurement event group"
 /begin REF_MEASUREMENT task_14.counter task_14.counter8 task_14.counter16 task_14.counter32 task_14.counter64 task_14.array /end REF_MEASUREMENT
/end GROUP
/begin GROUP task_3 "Measurement event group"
 /begin REF_MEASUREMENT task_3.counter task_3.counter8 task_3.counter16 task_3.counter32 task_3.counter64 task_3.array /end REF_MEASUREMENT
/end GROUP
/begin GROUP task_4 "Measurement event group"
 /begin REF_MEASUREMENT task_4.counter task_4.counter8 task_4.counter16 task_4.counter32 task_4.counter64 task_4.array /end REF_MEASUREMENT
/end GROUP
/begin GROUP task_5 "Measurement event group"
 /begin REF_MEASUREMENT task_5.counter task_5.counter8 task_5.counter16 task_5.counter32 task_5.counter64 task_5.array /end REF_MEASUREMENT
/end GROUP
/begin GROUP task_6 "Measurement event group"
 /begin REF_MEASUREMENT task_6.counter task_6.counter8 task_6.counter16 task_6.counter32 task_6.counter64 task_6.array /end REF_MEASUREMENT
/end GROUP
/begin GROUP task_7 "Measurement event group"
 /begin REF_MEASUREMENT task_7.counter task_7.counter8 task_7.counter16 task_7.counter32 task_7.counter64 task_7.array /end REF_MEASUREMENT
/end GROUP
/begin GROUP task_8 "Measurement event group"
 /begin REF_MEASUREMENT task_8.counter task_8.counter8 task_8.counter16 task_8.counter32 task_8.counter64 task_8.array /end REF_MEASUREMENT
/end GROUP
/begin GROUP task_9 "Measurement event group"
 /begin REF_MEASUREMENT task_9.counter task_9.counter8 task_9.counter16 task_9.counter32 task_9.counter64 task_9.array /end REF_MEASUREMENT
/end GROUP
/begin GROUP task_10 "Measurement event group"
 /begin REF_MEASUREMENT task_10.counter task_10.counter8 task_10.counter16 task_10.counter32 task_10.counter64 task_10.array /end REF_MEASUREMENT
/end GROUP
/begin GROUP task_11 "Measurement event group"
 /begin REF_MEASUREMENT task_11.counter task_11.counter8 task_11.counter16 task_11.counter32 task_11.counter64 task_11.array /end REF_MEASUREMENT
/end GROUP
/begin GROUP task_12 "Measurement event group"
 /begin REF_MEASUREMENT task_12.counter task_12.counter8 task_12.counter16 task_12.counter32 task_12.counter64 task_12.array /end REF_MEASUREMENT
/end GROUP
/begin GROUP task_13 "Measurement event group"
 /begin REF_MEASUREMENT task_13.counter task_13.counter8 task_13.counter16 task_13.counter32 task_13.counter64 task_13.array /end REF_MEASUREMENT
/end GROUP
/begin GROUP task_2 "Measurement event group"
 /begin REF_MEASUREMENT task_2.counter task_2.counter8 task_2.counter16 task_2.counter32 task_2.counter64 task_2.array /end REF_MEASUREMENT
/end GROUP
/begin GROUP task_15 "Measurement event group"
 /begin REF_MEASUREMENT task_15.counter task_15.counter8 task_15.counter16 task_15.counter32 task_15.counter64 task_15.array /end REF_MEASUREMENT
/end GROUP
/begin GROUP task_16 "Measurement event group"
 /begin REF_MEASUREMENT task_16.counter task_16.counter8 task_16.counter16 task_16.counter32 task_16.counter64 task_16.array /end REF_MEASUREMENT
/end GROUP
/begin GROUP task_17 "Measurement event group"
 /begin REF_MEASUREMENT task_17.counter task_17.counter8 task_17.counter16 task_17.counter32 task_17.counter64 task_17.array /end REF_MEASUREMENT
/end GROUP
/begin GROUP task_18 "Measurement event group"
 /begin REF_MEASUREMENT task_18.counter task_18.counter8 task_18.counter16 task_18.counter32 task_18.counter64 task_18.array /end REF_MEASUREMENT
/end GROUP
/begin GROUP mainloop "Measurement event group" /begin REF_MEASUREMENT counter /end REF_MEASUREMENT /end GROUP
/begin GROUP task_19 "Measurement event group"
 /begin REF_MEASUREMENT task_19.counter task_19.counter8 task_19.counter16 task_19.counter32 task_19.counter64 task_19.array /end REF_MEASUREMENT
/end GROUP
/begin GROUP task_20 "Measurement event group"
 /begin REF_MEASUREMENT task_20.counter task_20.counter8 task_20.counter16 task_20.counter32 task_20.counter64 task_20.array /end REF_MEASUREMENT
/end GROUP
/begin GROUP task_21 "Measurement event group"
 /begin REF_MEASUREMENT task_21.counter task_21.counter8 task_21.counter16 task_21.counter32 task_21.counter64 task_21.array /end REF_MEASUREMENT
/end GROUP
/begin GROUP task_22 "Measurement event group"
 /begin REF_MEASUREMENT task_22.counter task_22.counter8 task_22.counter16 task_22.counter32 task_22.counter64 task_22.array /end REF_MEASUREMENT
/end GROUP
/begin GROUP task_23 "Measurement event group"
 /begin REF_MEASUREMENT task_23.counter task_23.counter8 task_23.counter16 task_23.counter32 task_23.counter64 task_23.array /end REF_MEASUREMENT
/end GROUP
/begin GROUP task_24 "Measurement event group"
 /begin REF_MEASUREMENT task_24.counter task_24.counter8 task_24.counter16 task_24.counter32 task_24.counter64 task_24.array /end REF_MEASUREMENT
/end GROUP
/begin GROUP task_25 "Measurement event group"
 /begin REF_MEASUREMENT task_25.counter task_25.counter8 task_25.counter16 task_25.counter32 task_25.counter64 task_25.array /end REF_MEASUREMENT
/end GROUP
/begin GROUP task_26 "Measurement event group"
 /begin REF_MEASUREMENT task_26.counter task_26.counter8 task_26.counter16 task_26.counter32 task_26.counter64 task_26.array /end REF_MEASUREMENT
/end GROUP
/begin GROUP task_27 "Measurement event group"
 /begin REF_MEASUREMENT task_27.counter task_27.counter8 task_27.counter16 task_27.counter32 task_27.counter64 task_27.array /end REF_MEASUREMENT
/end GROUP
/begin GROUP task_28 "Measurement event group"
 /begin REF_MEASUREMENT task_28.counter task_28.counter8 task_28.counter16 task_28.counter32 task_28.counter64 task_28.array /end REF_MEASUREMENT
/end GROUP
/begin GROUP task_29 "Measurement event group"
 /begin REF_MEASUREMENT task_29.counter task_29.counter8 task_29.counter16 task_29.counter32 task_29.counter64 task_29.array /end REF_MEASUREMENT
/end GROUP
/begin GROUP task_30 "Measurement event group"
 /begin REF_MEASUREMENT task_30.counter task_30.counter8 task_30.counter16 task_30.counter32 task_30.counter64 task_30.array /end REF_MEASUREMENT
/end GROUP
/begin GROUP task_31 "Measurement event group"
 /begin REF_MEASUREMENT task_31.counter task_31.counter8 task_31.counter16 task_31.counter32 task_31.counter64 task_31.array /end REF_MEASUREMENT
/end GROUP
/begin GROUP task_32 "Measurement event group"
 /begin REF_MEASUREMENT task_32.counter task_32.counter8 task_32.counter16 task_32.counter32 task_32.counter64 task_32.array /end REF_MEASUREMENT
/end GROUP
/begin GROUP Events "Events" ROOT
 /begin SUB_GROUP task_1 task_2 task_3 task_4 task_5 task_6 task_7 task_8 task_9 task_10 task_11 task_12 task_13 task_14 task_15 task_16 task_17 task_18 task_19 task_20 task_21 task_22 task_23 task_24 task_25 task_26 task_27 task_28 task_29 task_30 task_31 task_32 mainloop /end SUB_GROUP
/end GROUP
/* Conversions */
/begin COMPU_METHOD conv.bool "" TAB_VERB "%.0" "" COMPU_TAB_REF conv.bool.table /end COMPU_METHOD
/begin COMPU_VTAB conv.bool.table "" TAB_VERB 2 0 "false" 1 "true" /end COMPU_VTAB
/begin COMPU_METHOD conv.events "" TAB_VERB "%.0 " "" COMPU_TAB_REF conv.events.table /end COMPU_METHOD
/begin COMPU_VTAB conv.events.table "" TAB_VERB 33 0 "task_1" 1 "task_2" 2 "task_3" 3 "task_4" 4 "task_5" 5 "task_6" 6 "task_7" 7 "task_8" 8 "task_9" 9 "task_10" 10 "task_11" 11 "task_12" 12 "task_13" 13 "task_14" 14 "task_15" 15 "task_16" 16 "task_17" 17 "task_18" 18 "task_19" 19 "task_20" 20 "task_21" 21 "task_22" 22 "task_23" 23 "task_24" 24 "task_25" 25 "task_26" 26 "task_27" 27 "task_28" 28 "task_29" 29 "task_30" 30 "task_31" 31 "task_32" 32 "mainloop" /end COMPU_VTAB
/begin MOD_PAR "" EPK "18_58_26" ADDR_EPK 0x80000000
 /begin MEMORY_SEGMENT epk "" DATA FLASH INTERN 0x80000000 8 -1 -1 -1 -1 -1
  /begin IF_DATA XCP
   /begin SEGMENT 0 2 0 0 0 /begin CHECKSUM XCP_CRC_16_CITT MAX_BLOCK_SIZE 0xFFFF EXTERNAL_FUNCTION "" /end CHECKSUM
    /begin PAGE 0 ECU_ACCESS_DONT_CARE XCP_READ_ACCESS_DONT_CARE XCP_WRITE_ACCESS_DONT_CARE /end PAGE
    /begin PAGE 1 ECU_ACCESS_DONT_CARE XCP_READ_ACCESS_DONT_CARE XCP_WRITE_ACCESS_NOT_ALLOWED /end PAGE
   /end SEGMENT
  /end IF_DATA
 /end MEMORY_SEGMENT
 /begin MEMORY_SEGMENT params "" DATA FLASH INTERN 0x80010000 12 -1 -1 -1 -1 -1
  /begin IF_DATA XCP
   /begin SEGMENT 1 2 0 0 0 /begin CHECKSUM XCP_CRC_16_CITT MAX_BLOCK_SIZE 0xFFFF EXTERNAL_FUNCTION "" /end CHECKSUM
    /begin PAGE 0 ECU_ACCESS_DONT_CARE XCP_READ_ACCESS_DONT_CARE XCP_WRITE_ACCESS_DONT_CARE /end PAGE
    /begin PAGE 1 ECU_ACCESS_DONT_CARE XCP_READ_ACCESS_DONT_CARE XCP_WRITE_ACCESS_NOT_ALLOWED /end PAGE
   /end SEGMENT
  /end IF_DATA
 /end MEMORY_SEGMENT
/end MOD_PAR
/begin IF_DATA XCP
 /begin PROTOCOL_LAYER 0x104 1000 2000 0 0 0 0 0 248 248 BYTE_ORDER_MSB_LAST ADDRESS_GRANULARITY_BYTE OPTIONAL_CMD GET_COMM_MODE_INFO OPTIONAL_CMD GET_ID OPTIONAL_CMD SET_REQUEST OPTIONAL_CMD SET_MTA OPTIONAL_CMD UPLOAD OPTIONAL_CMD SHORT_UPLOAD OPTIONAL_CMD DOWNLOAD OPTIONAL_CMD SHORT_DOWNLOAD OPTIONAL_CMD GET_CAL_PAGE OPTIONAL_CMD SET_CAL_PAGE OPTIONAL_CMD COPY_CAL_PAGE OPTIONAL_CMD GET_PAG_PROCESSOR_INFO OPTIONAL_CMD GET_SEGMENT_INFO OPTIONAL_CMD GET_PAGE_INFO OPTIONAL_CMD GET_SEGMENT_MODE OPTIONAL_CMD SET_SEGMENT_MODE OPTIONAL_CMD BUILD_CHECKSUM OPTIONAL_CMD USER_CMD OPTIONAL_CMD GET_DAQ_RESOLUTION_INFO OPTIONAL_CMD GET_DAQ_PROCESSOR_INFO OPTIONAL_CMD GET_DAQ_EVENT_INFO OPTIONAL_CMD FREE_DAQ OPTIONAL_CMD ALLOC_DAQ OPTIONAL_CMD ALLOC_ODT OPTIONAL_CMD ALLOC_ODT_ENTRY OPTIONAL_CMD SET_DAQ_PTR OPTIONAL_CMD WRITE_DAQ OPTIONAL_CMD GET_DAQ_LIST_MODE OPTIONAL_CMD SET_DAQ_LIST_MODE OPTIONAL_CMD START_STOP_SYNCH OPTIONAL_CMD START_STOP_DAQ_LIST OPTIONAL_CMD GET_DAQ_CLOCK OPTIONAL_CMD WRITE_DAQ_MULTIPLE OPTIONAL_CMD TIME_CORRELATION_PROPERTIES OPTIONAL_LEVEL1_CMD GET_VERSION /end PROTOCOL_LAYER
 /begin DAQ DYNAMIC 0 33 0 OPTIMISATION_TYPE_DEFAULT ADDRESS_EXTENSION_FREE IDENTIFICATION_FIELD_TYPE_RELATIVE_BYTE GRANULARITY_ODT_ENTRY_SIZE_DAQ_BYTE 0xF8 OVERLOAD_INDICATION_PID /begin TIMESTAMP_SUPPORTED 0x1 SIZE_DWORD UNIT_1NS TIMESTAMP_FIXED /end TIMESTAMP_SUPPORTED /begin EVENT "task_1" "task_1" 0x0 DAQ 0xFF 0 0 0 CONSISTENCY EVENT /end EVENT /begin EVENT "task_2" "task_2" 0x1 DAQ 0xFF 0 0 0 CONSISTENCY EVENT /end EVENT /begin EVENT "task_3" "task_3" 0x2 DAQ 0xFF 0 0 0 CONSISTENCY EVENT /end EVENT /begin EVENT "task_4" "task_4" 0x3 DAQ 0xFF 0 0 0 CONSISTENCY EVENT /end EVENT /begin EVENT "task_5" "task_5" 0x4 DAQ 0xFF 0 0 0 CONSISTENCY EVENT /end EVENT /begin EVENT "task_6" "task_6" 0x5 DAQ 0xFF 0 0 0 CONSISTENCY EVENT /end EVENT /begin EVENT "task_7" "task_7" 0x6 DAQ 0xFF 0 0 0 CONSISTENCY EVENT /end EVENT /begin EVENT "task_8" "task_8" 0x7 DAQ 0xFF 0 0 0 CONSISTENCY EVENT /end EVENT /begin EVENT "task_9" "task_9" 0x8 DAQ 0xFF 0 0 0 CONSISTENCY EVENT /end EVENT /begin EVENT "task_10" "task_10" 0x9 DAQ 0xFF 0 0 0 CONSISTENCY EVENT /end EVENT /begin EVENT "task_11" "task_11" 0xA DAQ 0xFF 0 0 0 CONSISTENCY EVENT /end EVENT /begin EVENT "task_12" "task_12" 0xB DAQ 0xFF 0 0 0 CONSISTENCY EVENT /end EVENT /begin EVENT "task_13" "task_13" 0xC DAQ 0xFF 0 0 0 CONSISTENCY EVENT /end EVENT /begin EVENT "task_14" "task_14" 0xD DAQ 0xFF 0 0 0 CONSISTENCY EVENT /end EVENT /begin EVENT "task_15" "task_15" 0xE DAQ 0xFF 0 0 0 CONSISTENCY EVENT /end EVENT /begin EVENT "task_16" "task_16" 0xF DAQ 0xFF 0 0 0 CONSISTENCY EVENT /end EVENT /begin EVENT "task_17" "task_17" 0x10 DAQ 0xFF 0 0 0 CONSISTENCY EVENT /end EVENT /begin EVENT "task_18" "task_18" 0x11 DAQ 0xFF 0 0 0 CONSISTENCY EVENT /end EVENT /begin EVENT "task_19" "task_19" 0x12 DAQ 0xFF 0 0 0 CONSISTENCY EVENT /end EVENT /begin EVENT "task_20" "task_20" 0x13 DAQ 0xFF 0 0 0 CONSISTENCY EVENT /end EVENT /begin EVENT "task_21" "task_21" 0x14 DAQ 0xFF 0 0 0 CONSISTENCY EVENT /end EVENT /begin EVENT "task_22" "task_22" 0x15 DAQ 0xFF 0 0 0 CONSISTENCY EVENT /end EVENT /begin EVENT "task_23" "task_23" 0x16 DAQ 0xFF 0 0 0 CONSISTENCY EVENT /end EVENT /begin EVENT "task_24" "task_24" 0x17 DAQ 0xFF 0 0 0 CONSISTENCY EVENT /end EVENT /begin EVENT "task_25" "task_25" 0x18 DAQ 0xFF 0 0 0 CONSISTENCY EVENT /end EVENT /begin EVENT "task_26" "task_26" 0x19 DAQ 0xFF 0 0 0 CONSISTENCY EVENT /end EVENT /begin EVENT "task_27" "task_27" 0x1A DAQ 0xFF 0 0 0 CONSISTENCY EVENT /end EVENT /begin EVENT "task_28" "task_28" 0x1B DAQ 0xFF 0 0 0 CONSISTENCY EVENT /end EVENT /begin EVENT "task_29" "task_29" 0x1C DAQ 0xFF 0 0 0 CONSISTENCY EVENT /end EVENT /begin EVENT "task_30" "task_30" 0x1D DAQ 0xFF 0 0 0 CONSISTENCY EVENT /end EVENT /begin EVENT "task_31" "task_31" 0x1E DAQ 0xFF 0 0 0 CONSISTENCY EVENT /end EVENT /begin EVENT "task_32" "task_32" 0x1F DAQ 0xFF 0 0 0 CONSISTENCY EVENT /end EVENT
  /begin EVENT "mainloop" "mainloop" 0x20 DAQ 0xFF 0 0 0 CONSISTENCY EVENT /end EVENT
 /end DAQ
/end IF_DATA
/end MODULE
/end PROJECT
