ASAP2_VERSION 1 71
/begin PROJECT daq_test ""
/begin HEADER "" VERSION "1.0" PROJECT_NO XCPLITE__CASDD /end HEADER
/begin MODULE daq_test ""
/include "XCP_104.aml"
/begin MOD_COMMON "" BYTE_ORDER MSB_LAST ALIGNMENT_BYTE 1 ALIGNMENT_WORD 1 ALIGNMENT_LONG 1 ALIGNMENT_FLOAT16_IEEE 1 ALIGNMENT_FLOAT32_IEEE 1 ALIGNMENT_FLOAT64_IEEE 1 ALIGNMENT_INT64 1 /end MOD_COMMON
/begin CHARACTERISTIC params.counter_max "Max counter value, wrap around" VALUE 0x80010000 U16 0 NO_COMPU_METHOD 0 65535 /end CHARACTERISTIC
/begin CHARACTERISTIC params.delay_us "task delay time in us" VALUE 0x80010004 U32 0 NO_COMPU_METHOD 0 1e+06 PHYS_UNIT "us" /end CHARACTERISTIC
/begin CHARACTERISTIC params.run "stop task" VALUE 0x80010008 U8 0 NO_COMPU_METHOD 0 1 /end CHARACTERISTIC
/begin CHARACTERISTIC params.test_byte1 "Test byte for calibration consistency test" VALUE 0x80010009 I8 0 NO_COMPU_METHOD -128 127 /end CHARACTERISTIC
/begin CHARACTERISTIC params.test_byte2 "Test byte for calibration consistency test" VALUE 0x8001000A I8 0 NO_COMPU_METHOD -128 127 /end CHARACTERISTIC
/begin MEASUREMENT task_1.counter "Taskloop counter" UWORD NO_COMPU_METHOD 0 0 0 65535 ECU_ADDRESS 0x3FFEC6 ECU_ADDRESS_EXTENSION 2 READ_WRITE
 /begin IF_DATA XCP
  /begin DAQ_EVENT FIXED_EVENT_LIST EVENT 0x0 /end DAQ_EVENT
 /end IF_DATA
/end MEASUREMENT
/begin CHARACTERISTIC task_1.array "task array (to increase measurement workload)" VAL_BLK 0x3FFEE8 U32 0 NO_COMPU_METHOD 0 4.29497e+09 MATRIX_DIM 64 1 ECU_ADDRESS_EXTENSION 2
 /begin IF_DATA XCP
  /begin DAQ_EVENT FIXED_EVENT_LIST EVENT 0x0 /end DAQ_EVENT
 /end IF_DATA
/end CHARACTERISTIC
/begin MEASUREMENT task_2.counter "Taskloop counter" UWORD NO_COMPU_METHOD 0 0 0 65535 ECU_ADDRESS 0x7FFEC6 ECU_ADDRESS_EXTENSION 2 READ_WRITE
 /begin IF_DATA XCP
  /begin DAQ_EVENT FIXED_EVENT_LIST EVENT 0x1 /end DAQ_EVENT
 /end IF_DATA
/end MEASUREMENT
/begin CHARACTERISTIC task_2.array "task array (to increase measurement workload)" VAL_BLK 0x7FFEE8 U32 0 NO_COMPU_METHOD 0 4.29497e+09 MATRIX_DIM 64 1 ECU_ADDRESS_EXTENSION 2
 /begin IF_DATA XCP
  /begin DAQ_EVENT FIXED_EVENT_LIST EVENT 0x1 /end DAQ_EVENT
 /end IF_DATA
/end CHARACTERISTIC
/begin MEASUREMENT task_4.counter "Taskloop counter" UWORD NO_COMPU_METHOD 0 0 0 65535 ECU_ADDRESS 0xFFFEC6 ECU_ADDRESS_EXTENSION 2 READ_WRITE
 /begin IF_DATA XCP
  /begin DAQ_EVENT FIXED_EVENT_LIST EVENT 0x3 /end DAQ_EVENT
 /end IF_DATA
/end MEASUREMENT
/begin CHARACTERISTIC task_4.array "task array (to increase measurement workload)" VAL_BLK 0xFFFEE8 U32 0 NO_COMPU_METHOD 0 4.29497e+09 MATRIX_DIM 64 1 ECU_ADDRESS_EXTENSION 2
 /begin IF_DATA XCP
  /begin DAQ_EVENT FIXED_EVENT_LIST EVENT 0x3 /end DAQ_EVENT
 /end IF_DATA
/end CHARACTERISTIC
/begin MEASUREMENT task_3.counter "Taskloop counter" UWORD NO_COMPU_METHOD 0 0 0 65535 ECU_ADDRESS 0xBFFEC6 ECU_ADDRESS_EXTENSION 2 READ_WRITE
 /begin IF_DATA XCP
  /begin DAQ_EVENT FIXED_EVENT_LIST EVENT 0x2 /end DAQ_EVENT
 /end IF_DATA
/end MEASUREMENT
/begin CHARACTERISTIC task_3.array "task array (to increase measurement workload)" VAL_BLK 0xBFFEE8 U32 0 NO_COMPU_METHOD 0 4.29497e+09 MATRIX_DIM 64 1 ECU_ADDRESS_EXTENSION 2
 /begin IF_DATA XCP
  /begin DAQ_EVENT FIXED_EVENT_LIST EVENT 0x2 /end DAQ_EVENT
 /end IF_DATA
/end CHARACTERISTIC
/begin MEASUREMENT counter "Main loop counter" UWORD NO_COMPU_METHOD 0 0 0 65535 ECU_ADDRESS 0x23FFFAA ECU_ADDRESS_EXTENSION 2 READ_WRITE
 /begin IF_DATA XCP
  /begin DAQ_EVENT FIXED_EVENT_LIST EVENT 0x8 /end DAQ_EVENT
 /end IF_DATA
/end MEASUREMENT
/begin MEASUREMENT task_5.counter "Taskloop counter" UWORD NO_COMPU_METHOD 0 0 0 65535 ECU_ADDRESS 0x13FFEC6 ECU_ADDRESS_EXTENSION 2 READ_WRITE
 /begin IF_DATA XCP
  /begin DAQ_EVENT FIXED_EVENT_LIST EVENT 0x4 /end DAQ_EVENT
 /end IF_DATA
/end MEASUREMENT
/begin CHARACTERISTIC task_5.array "task array (to increase measurement workload)" VAL_BLK 0x13FFEE8 U32 0 NO_COMPU_METHOD 0 4.29497e+09 MATRIX_DIM 64 1 ECU_ADDRESS_EXTENSION 2
 /begin IF_DATA XCP
  /begin DAQ_EVENT FIXED_EVENT_LIST EVENT 0x4 /end DAQ_EVENT
 /end IF_DATA
/end CHARACTERISTIC
/begin MEASUREMENT task_6.counter "Taskloop counter" UWORD NO_COMPU_METHOD 0 0 0 65535 ECU_ADDRESS 0x17FFEC6 ECU_ADDRESS_EXTENSION 2 READ_WRITE
 /begin IF_DATA XCP
  /begin DAQ_EVENT FIXED_EVENT_LIST EVENT 0x5 /end DAQ_EVENT
 /end IF_DATA
/end MEASUREMENT
/begin CHARACTERISTIC task_6.array "task array (to increase measurement workload)" VAL_BLK 0x17FFEE8 U32 0 NO_COMPU_METHOD 0 4.29497e+09 MATRIX_DIM 64 1 ECU_ADDRESS_EXTENSION 2
 /begin IF_DATA XCP
  /begin DAQ_EVENT FIXED_EVENT_LIST EVENT 0x5 /end DAQ_EVENT
 /end IF_DATA
/end CHARACTERISTIC
/begin MEASUREMENT task_7.counter "Taskloop counter" UWORD NO_COMPU_METHOD 0 0 0 65535 ECU_ADDRESS 0x1BFFEC6 ECU_ADDRESS_EXTENSION 2 READ_WRITE
 /begin IF_DATA XCP
  /begin DAQ_EVENT FIXED_EVENT_LIST EVENT 0x6 /end DAQ_EVENT
 /end IF_DATA
/end MEASUREMENT
/begin CHARACTERISTIC task_7.array "task array (to increase measurement workload)" VAL_BLK 0x1BFFEE8 U32 0 NO_COMPU_METHOD 0 4.29497e+09 MATRIX_DIM 64 1 ECU_ADDRESS_EXTENSION 2
 /begin IF_DATA XCP
  /begin DAQ_EVENT FIXED_EVENT_LIST EVENT 0x6 /end DAQ_EVENT
 /end IF_DATA
/end CHARACTERISTIC
/begin MEASUREMENT task_8.counter "Taskloop counter" UWORD NO_COMPU_METHOD 0 0 0 65535 ECU_ADDRESS 0x1FFFEC6 ECU_ADDRESS_EXTENSION 2 READ_WRITE
 /begin IF_DATA XCP
  /begin DAQ_EVENT FIXED_EVENT_LIST EVENT 0x7 /end DAQ_EVENT
 /end IF_DATA
/end MEASUREMENT
/begin CHARACTERISTIC task_8.array "task array (to increase measurement workload)" VAL_BLK 0x1FFFEE8 U32 0 NO_COMPU_METHOD 0 4.29497e+09 MATRIX_DIM 64 1 ECU_ADDRESS_EXTENSION 2
 /begin IF_DATA XCP
  /begin DAQ_EVENT FIXED_EVENT_LIST EVENT 0x7 /end DAQ_EVENT
 /end IF_DATA
/end CHARACTERISTIC
/* Typedefs */
/begin RECORD_LAYOUT U8 FNC_VALUES 1 UBYTE ROW_DIR DIRECT /end RECORD_LAYOUT
/begin RECORD_LAYOUT A_U8 AXIS_PTS_X 1 UBYTE INDEX_INCR DIRECT /end RECORD_LAYOUT
/begin TYPEDEF_MEASUREMENT M_U8 "" UBYTE NO_COMPU_METHOD 0 0 0 255 /end TYPEDEF_MEASUREMENT
/begin TYPEDEF_CHARACTERISTIC C_U8 "" VALUE U8 0 NO_COMPU_METHOD 0 255 /end TYPEDEF_CHARACTERISTIC
/begin RECORD_LAYOUT U16 FNC_VALUES 1 UWORD ROW_DIR DIRECT /end RECORD_LAYOUT
/begin RECORD_LAYOUT A_U16 AXIS_PTS_X 1 UWORD INDEX_INCR DIRECT /end RECORD_LAYOUT
/begin TYPEDEF_MEASUREMENT M_U16 "" UWORD NO_COMPU_METHOD 0 0 0 65535 /end TYPEDEF_MEASUREMENT
/begin TYPEDEF_CHARACTERISTIC C_U16 "" VALUE U16 0 NO_COMPU_METHOD 0 65535 /end TYPEDEF_CHARACTERISTIC
/begin RECORD_LAYOUT U32 FNC_VALUES 1 ULONG ROW_DIR DIRECT /end RECORD_LAYOUT
/begin RECORD_LAYOUT A_U32 AXIS_PTS_X 1 ULONG INDEX_INCR DIRECT /end RECORD_LAYOUT
/begin TYPEDEF_MEASUREMENT M_U32 "" ULONG NO_COMPU_METHOD 0 0 0 4294967295 /end TYPEDEF_MEASUREMENT
/begin TYPEDEF_CHARACTERISTIC C_U32 "" VALUE U32 0 NO_COMPU_METHOD 0 4.29497e+09 /end TYPEDEF_CHARACTERISTIC
/begin RECORD_LAYOUT U64 FNC_VALUES 1 A_UINT64 ROW_DIR DIRECT /end RECORD_LAYOUT
/begin RECORD_LAYOUT A_U64 AXIS_PTS_X 1 A_UINT64 INDEX_INCR DIRECT /end RECORD_LAYOUT
/begin TYPEDEF_MEASUREMENT M_U64 "" A_UINT64 NO_COMPU_METHOD 0 0 0 1000000000000 /end TYPEDEF_MEASUREMENT
/begin TYPEDEF_CHARACTERISTIC C_U64 "" VALUE U64 0 NO_COMPU_METHOD 0 1e+12 /end TYPEDEF_CHARACTERISTIC
/begin RECORD_LAYOUT I8 FNC_VALUES 1 SBYTE ROW_DIR DIRECT /end RECORD_LAYOUT
/begin RECORD_LAYOUT A_I8 AXIS_PTS_X 1 SBYTE INDEX_INCR DIRECT /end RECORD_LAYOUT
/begin TYPEDEF_MEASUREMENT M_I8 "" SBYTE NO_COMPU_METHOD 0 0 -128 127 /end TYPEDEF_MEASUREMENT
/begin TYPEDEF_CHARACTERISTIC C_I8 "" VALUE I8 0 NO_COMPU_METHOD -128 127 /end TYPEDEF_CHARACTERISTIC
/begin RECORD_LAYOUT I16 FNC_VALUES 1 SWORD ROW_DIR DIRECT /end RECORD_LAYOUT
/begin RECORD_LAYOUT A_I16 AXIS_PTS_X 1 SWORD INDEX_INCR DIRECT /end RECORD_LAYOUT
/begin TYPEDEF_MEASUREMENT M_I16 "" SWORD NO_COMPU_METHOD 0 0 -32768 32767 /end TYPEDEF_MEASUREMENT
/begin TYPEDEF_CHARACTERISTIC C_I16 "" VALUE I16 0 NO_COMPU_METHOD -32768 32767 /end TYPEDEF_CHARACTERISTIC
/begin RECORD_LAYOUT I32 FNC_VALUES 1 SLONG ROW_DIR DIRECT /end RECORD_LAYOUT
/begin RECORD_LAYOUT A_I32 AXIS_PTS_X 1 SLONG INDEX_INCR DIRECT /end RECORD_LAYOUT
/begin TYPEDEF_MEASUREMENT M_I32 "" SLONG NO_COMPU_METHOD 0 0 -2147483648 2147483647 /end TYPEDEF_MEASUREMENT
/begin TYPEDEF_CHARACTERISTIC C_I32 "" VALUE I32 0 NO_COMPU_METHOD -2.14748e+09 2.14748e+09 /end TYPEDEF_CHARACTERISTIC
/begin RECORD_LAYOUT I64 FNC_VALUES 1 A_INT64 ROW_DIR DIRECT /end RECORD_LAYOUT
/begin RECORD_LAYOUT A_I64 AXIS_PTS_X 1 A_INT64 INDEX_INCR DIRECT /end RECORD_LAYOUT
/begin TYPEDEF_MEASUREMENT M_I64 "" A_INT64 NO_COMPU_METHOD 0 0 -1000000000000 1000000000000 /end TYPEDEF_MEASUREMENT
/begin TYPEDEF_CHARACTERISTIC C_I64 "" VALUE I64 0 NO_COMPU_METHOD -1e+12 1e+12 /end TYPEDEF_CHARACTERISTIC
/begin RECORD_LAYOUT F32 FNC_VALUES 1 FLOAT32_IEEE ROW_DIR DIRECT /end RECORD_LAYOUT
/begin RECORD_LAYOUT A_F32 AXIS_PTS_X 1 FLOAT32_IEEE INDEX_INCR DIRECT /end RECORD_LAYOUT
/begin TYPEDEF_MEASUREMENT M_F32 "" FLOAT32_IEEE NO_COMPU_METHOD 0 0 -1e+12 1e+12 /end TYPEDEF_MEASUREMENT
/begin TYPEDEF_CHARACTERISTIC C_F32 "" VALUE F32 0 NO_COMPU_METHOD -1e+12 1e+12 /end TYPEDEF_CHARACTERISTIC
/begin RECORD_LAYOUT F64 FNC_VALUES 1 FLOAT64_IEEE ROW_DIR DIRECT /end RECORD_LAYOUT
/begin RECORD_LAYOUT A_F64 AXIS_PTS_X 1 FLOAT64_IEEE INDEX_INCR DIRECT /end RECORD_LAYOUT
/begin TYPEDEF_MEASUREMENT M_F64 "" FLOAT64_IEEE NO_COMPU_METHOD 0 0 -1e+12 1e+12 /end TYPEDEF_MEASUREMENT
/begin TYPEDEF_CHARACTERISTIC C_F64 "" VALUE F64 0 NO_COMPU_METHOD -1e+12 1e+12 /end TYPEDEF_CHARACTERISTIC
/* Groups */
/begin GROUP params "Calibration Segment" ROOT
 /begin REF_CHARACTERISTIC params.counter_max params.delay_us params.run params.test_byte1 params.test_byte2 /end REF_CHARACTERISTIC
/end GROUP
/begin GROUP task_1 "Measurement event group" /begin REF_MEASUREMENT task_1.counter task_1.array /end REF_MEASUREMENT /end GROUP
/begin GROUP task_2 "Measurement event group" /begin REF_MEASUREMENT task_2.counter task_2.array /end REF_MEASUREMENT /end GROUP
/begin GROUP task_4 "Measurement event group" /begin REF_MEASUREMENT task_4.counter task_4.array /end REF_MEASUREMENT /end GROUP
/begin GROUP task_3 "Measurement event group" /begin REF_MEASUREMENT task_3.counter task_3.array /end REF_MEASUREMENT /end GROUP
/begin GROUP mainloop "Measurement event group" /begin REF_MEASUREMENT counter /end REF_MEASUREMENT /end GROUP
/begin GROUP task_5 "Measurement event group" /begin REF_MEASUREMENT task_5.counter task_5.array /end REF_MEASUREMENT /end GROUP
/begin GROUP task_6 "Measurement event group" /begin REF_MEASUREMENT task_6.counter task_6.array /end REF_MEASUREMENT /end GROUP
/begin GROUP task_7 "Measurement event group" /begin REF_MEASUREMENT task_7.counter task_7.array /end REF_MEASUREMENT /end GROUP
/begin GROUP task_8 "Measurement event group" /begin REF_MEASUREMENT task_8.counter task_8.array /end REF_MEASUREMENT /end GROUP
/begin GROUP Events "Events" ROOT
 /begin SUB_GROUP task_1 task_2 task_3 task_4 task_5 task_6 task_7 task_8 mainloop /end SUB_GROUP
/end GROUP
/* Conversions */
/begin COMPU_METHOD conv.bool "" TAB_VERB "%.0" "" COMPU_TAB_REF conv.bool.table /end COMPU_METHOD
/begin COMPU_VTAB conv.bool.table "" TAB_VERB 2 0 "false" 1 "true" /end COMPU_VTAB
/begin COMPU_METHOD conv.events "" TAB_VERB "%.0 " "" COMPU_TAB_REF conv.events.table /end COMPU_METHOD
/begin COMPU_VTAB conv.events.table "" TAB_VERB 9 0 "task_1" 1 "task_2" 2 "task_3" 3 "task_4" 4 "task_5" 5 "task_6" 6 "task_7" 7 "task_8" 8 "mainloop" /end COMPU_VTAB
/begin MOD_PAR "" EPK "22_26_28" ADDR_EPK 0x80000000
 /begin MEMORY_SEGMENT epk "" DATA FLASH INTERN 0x80000000 8 -1 -1 -1 -1 -1
  /begin IF_DATA XCP
   /begin SEGMENT 0 2 0 0 0 /begin CHECKSUM XCP_CRC_16_CITT MAX_BLOCK_SIZE 0xFFFF EXTERNAL_FUNCTION "" /end CHECKSUM
    /begin PAGE 0 ECU_ACCESS_DONT_CARE XCP_READ_ACCESS_DONT_CARE XCP_WRITE_ACCESS_DONT_CARE /end PAGE
    /begin PAGE 1 ECU_ACCESS_DONT_CARE XCP_READ_ACCESS_DONT_CARE XCP_WRITE_ACCESS_NOT_ALLOWED /end PAGE
   /end SEGMENT
  /end IF_DATA
 /end MEMORY_SEGMENT
 /begin MEMORY_SEGMENT params "" DATA FLASH INTERN 0x80010000 12 -1 -1 -1 -1 -1
  /begin IF_DATA XCP
   /begin SEGMENT 1 2 0 0 0 /begin CHECKSUM XCP_CRC_16_CITT MAX_BLOCK_SIZE 0xFFFF EXTERNAL_FUNCTION "" /end CHECKSUM
    /begin PAGE 0 ECU_ACCESS_DONT_CARE XCP_READ_ACCESS_DONT_CARE XCP_WRITE_ACCESS_DONT_CARE /end PAGE
    /begin PAGE 1 ECU_ACCESS_DONT_CARE XCP_READ_ACCESS_DONT_CARE XCP_WRITE_ACCESS_NOT_ALLOWED /end PAGE
   /end SEGMENT
  /end IF_DATA
 /end MEMORY_SEGMENT
/end MOD_PAR
/begin IF_DATA XCP
 /begin PROTOCOL_LAYER 0x104 1000 2000 0 0 0 0 0 248 248 BYTE_ORDER_MSB_LAST ADDRESS_GRANULARITY_BYTE OPTIONAL_CMD GET_COMM_MODE_INFO OPTIONAL_CMD GET_ID OPTIONAL_CMD SET_REQUEST OPTIONAL_CMD SET_MTA OPTIONAL_CMD UPLOAD OPTIONAL_CMD SHORT_UPLOAD OPTIONAL_CMD DOWNLOAD OPTIONAL_CMD SHORT_DOWNLOAD OPTIONAL_CMD GET_CAL_PAGE OPTIONAL_CMD SET_CAL_PAGE OPTIONAL_CMD COPY_CAL_PAGE OPTIONAL_CMD GET_PAG_PROCESSOR_INFO OPTIONAL_CMD GET_SEGMENT_INFO OPTIONAL_CMD GET_PAGE_INFO OPTIONAL_CMD GET_SEGMENT_MODE OPTIONAL_CMD SET_SEGMENT_MODE OPTIONAL_CMD BUILD_CHECKSUM OPTIONAL_CMD USER_CMD OPTIONAL_CMD GET_DAQ_RESOLUTION_INFO OPTIONAL_CMD GET_DAQ_PROCESSOR_INFO OPTIONAL_CMD GET_DAQ_EVENT_INFO OPTIONAL_CMD FREE_DAQ OPTIONAL_CMD ALLOC_DAQ OPTIONAL_CMD ALLOC_ODT OPTIONAL_CMD ALLOC_ODT_ENTRY OPTIONAL_CMD SET_DAQ_PTR OPTIONAL_CMD WRITE_DAQ OPTIONAL_CMD GET_DAQ_LIST_MODE OPTIONAL_CMD SET_DAQ_LIST_MODE OPTIONAL_CMD START_STOP_SYNCH OPTIONAL_CMD START_STOP_DAQ_LIST OPTIONAL_CMD GET_DAQ_CLOCK OPTIONAL_CMD WRITE_DAQ_MULTIPLE OPTIONAL_CMD TIME_CORRELATION_PROPERTIES OPTIONAL_LEVEL1_CMD GET_VERSION /end PROTOCOL_LAYER
 /begin DAQ DYNAMIC 0 9 0 OPTIMISATION_TYPE_DEFAULT ADDRESS_EXTENSION_FREE IDENTIFICATION_FIELD_TYPE_RELATIVE_BYTE GRANULARITY_ODT_ENTRY_SIZE_DAQ_BYTE 0xF8 OVERLOAD_INDICATION_PID /begin TIMESTAMP_SUPPORTED 0x1 SIZE_DWORD UNIT_1NS TIMESTAMP_FIXED /end TIMESTAMP_SUPPORTED /begin EVENT "task_1" "task_1" 0x0 DAQ 0xFF 0 0 0 CONSISTENCY EVENT /end EVENT /begin EVENT "task_2" "task_2" 0x1 DAQ 0xFF 0 0 0 CONSISTENCY EVENT /end EVENT /begin EVENT "task_3" "task_3" 0x2 DAQ 0xFF 0 0 0 CONSISTENCY EVENT /end EVENT /begin EVENT "task_4" "task_4" 0x3 DAQ 0xFF 0 0 0 CONSISTENCY EVENT /end EVENT /begin EVENT "task_5" "task_5" 0x4 DAQ 0xFF 0 0 0 CONSISTENCY EVENT /end EVENT /begin EVENT "task_6" "task_6" 0x5 DAQ 0xFF 0 0 0 CONSISTENCY EVENT /end EVENT /begin EVENT "task_7" "task_7" 0x6 DAQ 0xFF 0 0 0 CONSISTENCY EVENT /end EVENT /begin EVENT "task_8" "task_8" 0x7 DAQ 0xFF 0 0 0 CONSISTENCY EVENT /end EVENT /begin EVENT "mainloop" "mainloop" 0x8 DAQ 0xFF 0 0 0 CONSISTENCY EVENT /end EVENT /end DAQ
/end IF_DATA
/end MODULE
/end PROJECT
