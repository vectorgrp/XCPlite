ASAP2_VERSION 1 71
/begin PROJECT a2l_test ""
/begin HEADER "" VERSION "1.0" PROJECT_NO VECTOR /end HEADER
/begin MODULE a2l_test ""
/include "XCP_104.aml"
/begin MOD_COMMON "" BYTE_ORDER MSB_LAST ALIGNMENT_BYTE 1 ALIGNMENT_WORD 1 ALIGNMENT_LONG 1 ALIGNMENT_FLOAT16_IEEE 1 ALIGNMENT_FLOAT32_IEEE 1 ALIGNMENT_FLOAT64_IEEE 1 ALIGNMENT_INT64 1 /end MOD_COMMON
/begin CHARACTERISTIC static_counter_max "Test period in ms (default 10s)" VALUE 0xFC58 U32 0 NO_COMPU_METHOD 0 10000 PHYS_UNIT "ms" ECU_ADDRESS_EXTENSION 2
 /begin IF_DATA XCP
  /begin DAQ_EVENT FIXED_EVENT_LIST EVENT 0x0 /end DAQ_EVENT
 /end IF_DATA
/end CHARACTERISTIC
/begin CHARACTERISTIC static_uint8 "Global memory parameter" VALUE 0x0 U8 0 NO_COMPU_METHOD 0 255 PHYS_UNIT "unit" ECU_ADDRESS_EXTENSION 2
 /begin IF_DATA XCP
  /begin DAQ_EVENT FIXED_EVENT_LIST EVENT 0x0 /end DAQ_EVENT
 /end IF_DATA
/end CHARACTERISTIC
/begin CHARACTERISTIC static_uint16 "Global memory parameter" VALUE 0xFC5C U16 0 NO_COMPU_METHOD 0 65535 PHYS_UNIT "unit" ECU_ADDRESS_EXTENSION 2
 /begin IF_DATA XCP
  /begin DAQ_EVENT FIXED_EVENT_LIST EVENT 0x0 /end DAQ_EVENT
 /end IF_DATA
/end CHARACTERISTIC
/begin CHARACTERISTIC static_uint32 "Global memory parameter" VALUE 0xFC60 U32 0 NO_COMPU_METHOD 0 4.29497e+09 PHYS_UNIT "unit" ECU_ADDRESS_EXTENSION 2
 /begin IF_DATA XCP
  /begin DAQ_EVENT FIXED_EVENT_LIST EVENT 0x0 /end DAQ_EVENT
 /end IF_DATA
/end CHARACTERISTIC
/begin CHARACTERISTIC static_uint64 "Global memory parameter" VALUE 0xFC68 U64 0 NO_COMPU_METHOD 0 1.84467e+19 PHYS_UNIT "unit" ECU_ADDRESS_EXTENSION 2
 /begin IF_DATA XCP
  /begin DAQ_EVENT FIXED_EVENT_LIST EVENT 0x0 /end DAQ_EVENT
 /end IF_DATA
/end CHARACTERISTIC
/begin CHARACTERISTIC static_int8 "Global memory parameter" VALUE 0xFC70 I8 0 NO_COMPU_METHOD -128 127 PHYS_UNIT "unit" ECU_ADDRESS_EXTENSION 2
 /begin IF_DATA XCP
  /begin DAQ_EVENT FIXED_EVENT_LIST EVENT 0x0 /end DAQ_EVENT
 /end IF_DATA
/end CHARACTERISTIC
/begin CHARACTERISTIC static_int16 "Global memory parameter" VALUE 0xFC72 I16 0 NO_COMPU_METHOD -32768 32767 PHYS_UNIT "unit" ECU_ADDRESS_EXTENSION 2
 /begin IF_DATA XCP
  /begin DAQ_EVENT FIXED_EVENT_LIST EVENT 0x0 /end DAQ_EVENT
 /end IF_DATA
/end CHARACTERISTIC
/begin CHARACTERISTIC static_int32 "Global memory parameter" VALUE 0xFC74 I32 0 NO_COMPU_METHOD -2.14748e+09 2.14748e+09 PHYS_UNIT "unit" ECU_ADDRESS_EXTENSION 2
 /begin IF_DATA XCP
  /begin DAQ_EVENT FIXED_EVENT_LIST EVENT 0x0 /end DAQ_EVENT
 /end IF_DATA
/end CHARACTERISTIC
/begin CHARACTERISTIC static_float4 "Global memory parameter" VALUE 0xFC78 F32 0 NO_COMPU_METHOD -1000 1000 PHYS_UNIT "unit" ECU_ADDRESS_EXTENSION 2
 /begin IF_DATA XCP
  /begin DAQ_EVENT FIXED_EVENT_LIST EVENT 0x0 /end DAQ_EVENT
 /end IF_DATA
/end CHARACTERISTIC
/begin CHARACTERISTIC static_double8 "Global memory parameter" VALUE 0xFC80 F64 0 NO_COMPU_METHOD -1000 1000 PHYS_UNIT "unit" ECU_ADDRESS_EXTENSION 2
 /begin IF_DATA XCP
  /begin DAQ_EVENT FIXED_EVENT_LIST EVENT 0x0 /end DAQ_EVENT
 /end IF_DATA
/end CHARACTERISTIC
/begin CHARACTERISTIC static_curve1 "Global memory parameter field" CURVE 0xFA40 I16 0 NO_COMPU_METHOD -20 20
 /begin AXIS_DESCR FIX_AXIS NO_INPUT_QUANTITY NO_COMPU_METHOD 8 0 7 FIX_AXIS_PAR_DIST 0 1 8 /end AXIS_DESCR
 PHYS_UNIT "unit" ECU_ADDRESS_EXTENSION 2
 /begin IF_DATA XCP
  /begin DAQ_EVENT FIXED_EVENT_LIST EVENT 0x0 /end DAQ_EVENT
 /end IF_DATA
/end CHARACTERISTIC
/begin CHARACTERISTIC static_curve2 "Global memory parameter" CURVE 0xFA60 F64 0 NO_COMPU_METHOD 0 1000
 /begin AXIS_DESCR COM_AXIS NO_INPUT_QUANTITY NO_COMPU_METHOD 8 0.0 0.0 AXIS_PTS_REF static_curve2_axis /end AXIS_DESCR
 PHYS_UNIT "unit" ECU_ADDRESS_EXTENSION 2
 /begin IF_DATA XCP
  /begin DAQ_EVENT FIXED_EVENT_LIST EVENT 0x0 /end DAQ_EVENT
 /end IF_DATA
/end CHARACTERISTIC
/begin AXIS_PTS static_curve2_axis "Global memory parameter" 0xFAA0 NO_INPUT_QUANTITY A_F32 0 NO_COMPU_METHOD 8 0 20 PHYS_UNIT "unit" ECU_ADDRESS_EXTENSION 2
 /begin IF_DATA XCP
  /begin DAQ_EVENT FIXED_EVENT_LIST EVENT 0x0 /end DAQ_EVENT
 /end IF_DATA
/end AXIS_PTS
/begin CHARACTERISTIC static_map1 "Global memory parameter" MAP 0xFAC0 I8 0 NO_COMPU_METHOD -128 127
 /begin AXIS_DESCR FIX_AXIS NO_INPUT_QUANTITY NO_COMPU_METHOD 8 0 7 FIX_AXIS_PAR_DIST 0 1 8 /end AXIS_DESCR
 /begin AXIS_DESCR FIX_AXIS NO_INPUT_QUANTITY NO_COMPU_METHOD 8 0 7 FIX_AXIS_PAR_DIST 0 1 8 /end AXIS_DESCR
 ECU_ADDRESS_EXTENSION 2
 /begin IF_DATA XCP
  /begin DAQ_EVENT FIXED_EVENT_LIST EVENT 0x0 /end DAQ_EVENT
 /end IF_DATA
/end CHARACTERISTIC
/begin CHARACTERISTIC static_map2 "Global memory parameter" MAP 0xFB00 I32 0 NO_COMPU_METHOD -128 127
 /begin AXIS_DESCR COM_AXIS NO_INPUT_QUANTITY NO_COMPU_METHOD 8 0.0 0.0 AXIS_PTS_REF static_map2_x_axis /end AXIS_DESCR
 /begin AXIS_DESCR COM_AXIS NO_INPUT_QUANTITY NO_COMPU_METHOD 4 0.0 0.0 AXIS_PTS_REF static_map2_y_axis /end AXIS_DESCR
 ECU_ADDRESS_EXTENSION 2
 /begin IF_DATA XCP
  /begin DAQ_EVENT FIXED_EVENT_LIST EVENT 0x0 /end DAQ_EVENT
 /end IF_DATA
/end CHARACTERISTIC
/begin AXIS_PTS static_map2_x_axis "Global memory parameter" 0xFB80 NO_INPUT_QUANTITY A_I16 0 NO_COMPU_METHOD 8 0 1000 PHYS_UNIT "unit" ECU_ADDRESS_EXTENSION 2
 /begin IF_DATA XCP
  /begin DAQ_EVENT FIXED_EVENT_LIST EVENT 0x0 /end DAQ_EVENT
 /end IF_DATA
/end AXIS_PTS
/begin AXIS_PTS static_map2_y_axis "Global memory parameter" 0xFB90 NO_INPUT_QUANTITY A_U16 0 NO_COMPU_METHOD 4 0 500 PHYS_UNIT "unit" ECU_ADDRESS_EXTENSION 2
 /begin IF_DATA XCP
  /begin DAQ_EVENT FIXED_EVENT_LIST EVENT 0x0 /end DAQ_EVENT
 /end IF_DATA
/end AXIS_PTS
/begin CHARACTERISTIC static_map3 "Global memory parameter" MAP 0xFB98 U64 0 NO_COMPU_METHOD -128 127
 /begin AXIS_DESCR COM_AXIS NO_INPUT_QUANTITY NO_COMPU_METHOD 8 0.0 0.0 AXIS_PTS_REF static_map3_x_axis /end AXIS_DESCR
 /begin AXIS_DESCR FIX_AXIS NO_INPUT_QUANTITY NO_COMPU_METHOD 4 0 3 FIX_AXIS_PAR_DIST 0 1 4 /end AXIS_DESCR
 ECU_ADDRESS_EXTENSION 2
 /begin IF_DATA XCP
  /begin DAQ_EVENT FIXED_EVENT_LIST EVENT 0x0 /end DAQ_EVENT
 /end IF_DATA
/end CHARACTERISTIC
/begin AXIS_PTS static_map3_x_axis "Global memory parameter" 0xFC18 NO_INPUT_QUANTITY A_I64 0 NO_COMPU_METHOD 8 0 1000 PHYS_UNIT "unit" ECU_ADDRESS_EXTENSION 2
 /begin IF_DATA XCP
  /begin DAQ_EVENT FIXED_EVENT_LIST EVENT 0x0 /end DAQ_EVENT
 /end IF_DATA
/end AXIS_PTS
/begin CHARACTERISTIC static_params.uint8 "Global memory parameter struct field" VALUE 0xFC88 U8 0 NO_COMPU_METHOD 0 255 PHYS_UNIT "unit" ECU_ADDRESS_EXTENSION 2
 /begin IF_DATA XCP
  /begin DAQ_EVENT FIXED_EVENT_LIST EVENT 0x0 /end DAQ_EVENT
 /end IF_DATA
/end CHARACTERISTIC
/begin CHARACTERISTIC static_params.uint16 "Global memory parameter struct field" VALUE 0xFC8A U16 0 NO_COMPU_METHOD 0 65535 PHYS_UNIT "unit" ECU_ADDRESS_EXTENSION 2
 /begin IF_DATA XCP
  /begin DAQ_EVENT FIXED_EVENT_LIST EVENT 0x0 /end DAQ_EVENT
 /end IF_DATA
/end CHARACTERISTIC
/begin CHARACTERISTIC static_params.uint32 "Global memory parameter struct field" VALUE 0xFC8C U32 0 NO_COMPU_METHOD 0 4.29497e+09 PHYS_UNIT "unit" ECU_ADDRESS_EXTENSION 2
 /begin IF_DATA XCP
  /begin DAQ_EVENT FIXED_EVENT_LIST EVENT 0x0 /end DAQ_EVENT
 /end IF_DATA
/end CHARACTERISTIC
/begin CHARACTERISTIC static_params.uint_64 "Global memory parameter struct field" VALUE 0xFC90 U64 0 NO_COMPU_METHOD 0 1.84467e+19 PHYS_UNIT "unit" ECU_ADDRESS_EXTENSION 2
 /begin IF_DATA XCP
  /begin DAQ_EVENT FIXED_EVENT_LIST EVENT 0x0 /end DAQ_EVENT
 /end IF_DATA
/end CHARACTERISTIC
/begin CHARACTERISTIC static_params.int8 "Global memory parameter struct field" VALUE 0xFC98 I8 0 NO_COMPU_METHOD -128 127 PHYS_UNIT "unit" ECU_ADDRESS_EXTENSION 2
 /begin IF_DATA XCP
  /begin DAQ_EVENT FIXED_EVENT_LIST EVENT 0x0 /end DAQ_EVENT
 /end IF_DATA
/end CHARACTERISTIC
/begin CHARACTERISTIC static_params.int16 "Global memory parameter struct field" VALUE 0xFC9A I16 0 NO_COMPU_METHOD -32768 32767 PHYS_UNIT "unit" ECU_ADDRESS_EXTENSION 2
 /begin IF_DATA XCP
  /begin DAQ_EVENT FIXED_EVENT_LIST EVENT 0x0 /end DAQ_EVENT
 /end IF_DATA
/end CHARACTERISTIC
/begin CHARACTERISTIC static_params.int32 "Global memory parameter struct field" VALUE 0xFC9C I32 0 NO_COMPU_METHOD -2.14748e+09 2.14748e+09 PHYS_UNIT "unit" ECU_ADDRESS_EXTENSION 2
 /begin IF_DATA XCP
  /begin DAQ_EVENT FIXED_EVENT_LIST EVENT 0x0 /end DAQ_EVENT
 /end IF_DATA
/end CHARACTERISTIC
/begin CHARACTERISTIC static_params.int_64 "Global memory parameter struct field" VALUE 0xFCA0 I64 0 NO_COMPU_METHOD -9.22337e+18 9.22337e+18 PHYS_UNIT "unit" ECU_ADDRESS_EXTENSION 2
 /begin IF_DATA XCP
  /begin DAQ_EVENT FIXED_EVENT_LIST EVENT 0x0 /end DAQ_EVENT
 /end IF_DATA
/end CHARACTERISTIC
/begin CHARACTERISTIC static_params.float4 "Global memory parameter struct field" VALUE 0xFCA8 F32 0 NO_COMPU_METHOD -1000 1000 PHYS_UNIT "unit" ECU_ADDRESS_EXTENSION 2
 /begin IF_DATA XCP
  /begin DAQ_EVENT FIXED_EVENT_LIST EVENT 0x0 /end DAQ_EVENT
 /end IF_DATA
/end CHARACTERISTIC
/begin CHARACTERISTIC static_params.double8 "Global memory parameter struct field" VALUE 0xFCB0 F64 0 NO_COMPU_METHOD -1000 1000 PHYS_UNIT "unit" ECU_ADDRESS_EXTENSION 2
 /begin IF_DATA XCP
  /begin DAQ_EVENT FIXED_EVENT_LIST EVENT 0x0 /end DAQ_EVENT
 /end IF_DATA
/end CHARACTERISTIC
/begin CHARACTERISTIC static_params.curve1 "Global memory parameter struct field" CURVE 0xFCB8 I16 0 NO_COMPU_METHOD -20 20
 /begin AXIS_DESCR FIX_AXIS NO_INPUT_QUANTITY NO_COMPU_METHOD 8 0 7 FIX_AXIS_PAR_DIST 0 1 8 /end AXIS_DESCR
 PHYS_UNIT "unit" ECU_ADDRESS_EXTENSION 2
 /begin IF_DATA XCP
  /begin DAQ_EVENT FIXED_EVENT_LIST EVENT 0x0 /end DAQ_EVENT
 /end IF_DATA
/end CHARACTERISTIC
/begin CHARACTERISTIC static_params.curve2 "Global memory parameter struct field" CURVE 0xFCD8 F64 0 NO_COMPU_METHOD 0 1000
 /begin AXIS_DESCR COM_AXIS NO_INPUT_QUANTITY NO_COMPU_METHOD 8 0.0 0.0 AXIS_PTS_REF static_params.curve2_axis /end AXIS_DESCR
 PHYS_UNIT "unit" ECU_ADDRESS_EXTENSION 2
 /begin IF_DATA XCP
  /begin DAQ_EVENT FIXED_EVENT_LIST EVENT 0x0 /end DAQ_EVENT
 /end IF_DATA
/end CHARACTERISTIC
/begin AXIS_PTS static_params.curve2_axis "Global memory parameter struct field" 0xFD18 NO_INPUT_QUANTITY A_F32 0 NO_COMPU_METHOD 8 0 20 PHYS_UNIT "unit" ECU_ADDRESS_EXTENSION 2
 /begin IF_DATA XCP
  /begin DAQ_EVENT FIXED_EVENT_LIST EVENT 0x0 /end DAQ_EVENT
 /end IF_DATA
/end AXIS_PTS
/begin CHARACTERISTIC static_params.map1 "Global memory parameter struct field" MAP 0xFD38 I8 0 NO_COMPU_METHOD -128 127
 /begin AXIS_DESCR FIX_AXIS NO_INPUT_QUANTITY NO_COMPU_METHOD 8 0 7 FIX_AXIS_PAR_DIST 0 1 8 /end AXIS_DESCR
 /begin AXIS_DESCR FIX_AXIS NO_INPUT_QUANTITY NO_COMPU_METHOD 8 0 7 FIX_AXIS_PAR_DIST 0 1 8 /end AXIS_DESCR
 ECU_ADDRESS_EXTENSION 2
 /begin IF_DATA XCP
  /begin DAQ_EVENT FIXED_EVENT_LIST EVENT 0x0 /end DAQ_EVENT
 /end IF_DATA
/end CHARACTERISTIC
/begin CHARACTERISTIC static_params.map2 "Global memory parameter struct field" MAP 0xFD78 I32 0 NO_COMPU_METHOD -128 127
 /begin AXIS_DESCR COM_AXIS NO_INPUT_QUANTITY NO_COMPU_METHOD 8 0.0 0.0 AXIS_PTS_REF static_params.map2_x_axis /end AXIS_DESCR
 /begin AXIS_DESCR COM_AXIS NO_INPUT_QUANTITY NO_COMPU_METHOD 4 0.0 0.0 AXIS_PTS_REF static_params.map2_y_axis /end AXIS_DESCR
 ECU_ADDRESS_EXTENSION 2
 /begin IF_DATA XCP
  /begin DAQ_EVENT FIXED_EVENT_LIST EVENT 0x0 /end DAQ_EVENT
 /end IF_DATA
/end CHARACTERISTIC
/begin AXIS_PTS static_params.map2_x_axis "Global memory parameter struct field" 0xFDF8 NO_INPUT_QUANTITY A_I16 0 NO_COMPU_METHOD 8 0 1000 PHYS_UNIT "unit" ECU_ADDRESS_EXTENSION 2
 /begin IF_DATA XCP
  /begin DAQ_EVENT FIXED_EVENT_LIST EVENT 0x0 /end DAQ_EVENT
 /end IF_DATA
/end AXIS_PTS
/begin AXIS_PTS static_params.map2_y_axis "Global memory parameter struct field" 0xFE08 NO_INPUT_QUANTITY A_U16 0 NO_COMPU_METHOD 4 0 500 PHYS_UNIT "unit" ECU_ADDRESS_EXTENSION 2
 /begin IF_DATA XCP
  /begin DAQ_EVENT FIXED_EVENT_LIST EVENT 0x0 /end DAQ_EVENT
 /end IF_DATA
/end AXIS_PTS
/begin CHARACTERISTIC static_params.map3 "Global memory parameter struct field" MAP 0xFE10 U64 0 NO_COMPU_METHOD -128 127
 /begin AXIS_DESCR COM_AXIS NO_INPUT_QUANTITY NO_COMPU_METHOD 8 0.0 0.0 AXIS_PTS_REF static_params.map3_x_axis /end AXIS_DESCR
 /begin AXIS_DESCR FIX_AXIS NO_INPUT_QUANTITY NO_COMPU_METHOD 4 0 3 FIX_AXIS_PAR_DIST 0 1 4 /end AXIS_DESCR
 ECU_ADDRESS_EXTENSION 2
 /begin IF_DATA XCP
  /begin DAQ_EVENT FIXED_EVENT_LIST EVENT 0x0 /end DAQ_EVENT
 /end IF_DATA
/end CHARACTERISTIC
/begin AXIS_PTS static_params.map3_x_axis "Global memory parameter struct field" 0xFE90 NO_INPUT_QUANTITY A_I64 0 NO_COMPU_METHOD 8 0 1000 PHYS_UNIT "unit" ECU_ADDRESS_EXTENSION 2
 /begin IF_DATA XCP
  /begin DAQ_EVENT FIXED_EVENT_LIST EVENT 0x0 /end DAQ_EVENT
 /end IF_DATA
/end AXIS_PTS
/begin TYPEDEF_STRUCTURE params_t "comment" 0x248 /begin STRUCTURE_COMPONENT uint8 C_uint8 0x0 /end STRUCTURE_COMPONENT /begin STRUCTURE_COMPONENT uint16 C_uint16 0x2 /end STRUCTURE_COMPONENT /begin STRUCTURE_COMPONENT uint32 C_uint32 0x4 /end STRUCTURE_COMPONENT /begin STRUCTURE_COMPONENT uint_64 C_uint_64 0x8 /end STRUCTURE_COMPONENT /begin STRUCTURE_COMPONENT int8 C_int8 0x10 /end STRUCTURE_COMPONENT /begin STRUCTURE_COMPONENT int16 C_int16 0x12 /end STRUCTURE_COMPONENT /begin STRUCTURE_COMPONENT int32 C_int32 0x14 /end STRUCTURE_COMPONENT /begin STRUCTURE_COMPONENT int_64 C_int_64 0x18 /end STRUCTURE_COMPONENT /begin STRUCTURE_COMPONENT float4 C_float4 0x20 /end STRUCTURE_COMPONENT /begin STRUCTURE_COMPONENT double8 C_double8 0x28 /end STRUCTURE_COMPONENT /begin STRUCTURE_COMPONENT curve1 C_curve1 0x30 /end STRUCTURE_COMPONENT /begin STRUCTURE_COMPONENT curve2 C_curve2 0x50 /end STRUCTURE_COMPONENT /begin STRUCTURE_COMPONENT curve2_axis A_curve2_axis 0x90 /end STRUCTURE_COMPONENT /begin STRUCTURE_COMPONENT map1 C_map1 0xB0 /end STRUCTURE_COMPONENT /begin STRUCTURE_COMPONENT map2 C_map2 0xF0 /end STRUCTURE_COMPONENT /begin STRUCTURE_COMPONENT map2_x_axis A_map2_x_axis 0x170 /end STRUCTURE_COMPONENT /begin STRUCTURE_COMPONENT map2_y_axis A_map2_y_axis 0x180 /end STRUCTURE_COMPONENT /begin STRUCTURE_COMPONENT map3 C_map3 0x188 /end STRUCTURE_COMPONENT /begin STRUCTURE_COMPONENT map3_x_axis A_map3_x_axis 0x208 /end STRUCTURE_COMPONENT /end TYPEDEF_STRUCTURE
/* Segment relative addressing mode: calseg=params */
/begin INSTANCE params "Parameter typedef instance in calibration segment" params_t 0x80010000 /end INSTANCE
/* Segment relative addressing mode: calseg=params2 */
/begin CHARACTERISTIC params.uint8 "Parameter in calibration segment" VALUE 0x80020000 U8 0 NO_COMPU_METHOD 0 255 PHYS_UNIT "unit" /end CHARACTERISTIC
/begin CHARACTERISTIC params.uint16 "Parameter in calibration segment" VALUE 0x80020002 U16 0 NO_COMPU_METHOD 0 65535 PHYS_UNIT "unit" /end CHARACTERISTIC
/begin CHARACTERISTIC params.uint32 "Parameter in calibration segment" VALUE 0x80020004 U32 0 NO_COMPU_METHOD 0 4.29497e+09 PHYS_UNIT "unit" /end CHARACTERISTIC
/begin CHARACTERISTIC params.uint_64 "Parameter in calibration segment" VALUE 0x80020008 U64 0 NO_COMPU_METHOD 0 1.84467e+19 PHYS_UNIT "unit" /end CHARACTERISTIC
/begin CHARACTERISTIC params.int8 "Parameter in calibration segment" VALUE 0x80020010 I8 0 NO_COMPU_METHOD -128 127 PHYS_UNIT "unit" /end CHARACTERISTIC
/begin CHARACTERISTIC params.int16 "Parameter in calibration segment" VALUE 0x80020012 I16 0 NO_COMPU_METHOD -32768 32767 PHYS_UNIT "unit" /end CHARACTERISTIC
/begin CHARACTERISTIC params.int32 "Parameter in calibration segment" VALUE 0x80020014 I32 0 NO_COMPU_METHOD -2.14748e+09 2.14748e+09 PHYS_UNIT "unit" /end CHARACTERISTIC
/begin CHARACTERISTIC params.int_64 "Parameter in calibration segment" VALUE 0x80020018 I64 0 NO_COMPU_METHOD -9.22337e+18 9.22337e+18 PHYS_UNIT "unit" /end CHARACTERISTIC
/begin CHARACTERISTIC params.float4 "Parameter in calibration segment" VALUE 0x80020020 F32 0 NO_COMPU_METHOD -1000 1000 PHYS_UNIT "unit" /end CHARACTERISTIC
/begin CHARACTERISTIC params.double8 "Parameter in calibration segment" VALUE 0x80020028 F64 0 NO_COMPU_METHOD -1000 1000 PHYS_UNIT "unit" /end CHARACTERISTIC
/begin CHARACTERISTIC params.curve1 "Parameter in calibration segment" CURVE 0x80020030 I16 0 NO_COMPU_METHOD -20 20
 /begin AXIS_DESCR FIX_AXIS NO_INPUT_QUANTITY NO_COMPU_METHOD 8 0 7 FIX_AXIS_PAR_DIST 0 1 8 /end AXIS_DESCR
 PHYS_UNIT "unit" /end CHARACTERISTIC
/begin CHARACTERISTIC params.map1 "Parameter in calibration segment" MAP 0x800200B0 I8 0 NO_COMPU_METHOD -128 127
 /begin AXIS_DESCR FIX_AXIS NO_INPUT_QUANTITY NO_COMPU_METHOD 8 0 7 FIX_AXIS_PAR_DIST 0 1 8 /end AXIS_DESCR
 /begin AXIS_DESCR FIX_AXIS NO_INPUT_QUANTITY NO_COMPU_METHOD 8 0 7 FIX_AXIS_PAR_DIST 0 1 8 /end AXIS_DESCR
 PHYS_UNIT "unit" /end CHARACTERISTIC
/begin AXIS_PTS params.curve2_axis "Comment" 0x80020090 NO_INPUT_QUANTITY A_F32 0 NO_COMPU_METHOD 8 0 20 PHYS_UNIT "unit" /end AXIS_PTS
/begin AXIS_PTS params.map2_x_axis "Comment" 0x80020170 NO_INPUT_QUANTITY A_I16 0 NO_COMPU_METHOD 8 0 1000 PHYS_UNIT "unit" /end AXIS_PTS
/begin AXIS_PTS params.map2_y_axis "Comment" 0x80020180 NO_INPUT_QUANTITY A_U16 0 NO_COMPU_METHOD 4 0 500 PHYS_UNIT "unit" /end AXIS_PTS
/begin AXIS_PTS params.map3_x_axis "Comment" 0x80020208 NO_INPUT_QUANTITY A_I64 0 NO_COMPU_METHOD 8 0 1000 PHYS_UNIT "unit" /end AXIS_PTS
/begin CHARACTERISTIC params.curve2 "Comment" CURVE 0x80020050 F64 0 NO_COMPU_METHOD 0 1000
 /begin AXIS_DESCR COM_AXIS NO_INPUT_QUANTITY NO_COMPU_METHOD 8 0.0 0.0 AXIS_PTS_REF params.curve2_axis /end AXIS_DESCR
 PHYS_UNIT "unit" /end CHARACTERISTIC
/begin CHARACTERISTIC params.map2 "Comment" MAP 0x800200F0 I32 0 NO_COMPU_METHOD -128 127
 /begin AXIS_DESCR COM_AXIS NO_INPUT_QUANTITY NO_COMPU_METHOD 8 0.0 0.0 AXIS_PTS_REF params.map2_x_axis /end AXIS_DESCR
 /begin AXIS_DESCR COM_AXIS NO_INPUT_QUANTITY NO_COMPU_METHOD 4 0.0 0.0 AXIS_PTS_REF params.map2_y_axis /end AXIS_DESCR
/end CHARACTERISTIC
/begin CHARACTERISTIC params.map3 "Comment" MAP 0x80020188 U64 0 NO_COMPU_METHOD -128 127
 /begin AXIS_DESCR COM_AXIS NO_INPUT_QUANTITY NO_COMPU_METHOD 8 0.0 0.0 AXIS_PTS_REF params.map3_x_axis /end AXIS_DESCR
 /begin AXIS_DESCR FIX_AXIS NO_INPUT_QUANTITY NO_COMPU_METHOD 4 0 3 FIX_AXIS_PAR_DIST 0 1 4 /end AXIS_DESCR
/end CHARACTERISTIC
/* Absolute addressing mode: default_event=event (1), addr_ext=1 */
/begin MEASUREMENT uint8 "Enumeration type value uint8_t" UBYTE conv.enum_conversion 0 0 0 4 ECU_ADDRESS 0x245C1 ECU_ADDRESS_EXTENSION 1 READ_WRITE
 /begin IF_DATA XCP
  /begin DAQ_EVENT VARIABLE /begin DEFAULT_EVENT_LIST EVENT 0x1 /end DEFAULT_EVENT_LIST /end DAQ_EVENT
 /end IF_DATA
/end MEASUREMENT
/begin MEASUREMENT uint16 "uint16_t value with linear conversion" UWORD conv.linear_conversion 0 0 -50 300 ECU_ADDRESS 0x24490 ECU_ADDRESS_EXTENSION 1 READ_WRITE
 /begin IF_DATA XCP
  /begin DAQ_EVENT VARIABLE /begin DEFAULT_EVENT_LIST EVENT 0x1 /end DEFAULT_EVENT_LIST /end DAQ_EVENT
 /end IF_DATA
/end MEASUREMENT
/begin MEASUREMENT uint32 "uint32_t" ULONG NO_COMPU_METHOD 0 0 0 4.29497e+09 ECU_ADDRESS 0x24494 ECU_ADDRESS_EXTENSION 1 PHYS_UNIT "unit" READ_WRITE
 /begin IF_DATA XCP
  /begin DAQ_EVENT VARIABLE /begin DEFAULT_EVENT_LIST EVENT 0x1 /end DEFAULT_EVENT_LIST /end DAQ_EVENT
 /end IF_DATA
/end MEASUREMENT
/begin MEASUREMENT uint_64 "uint64_t" A_UINT64 NO_COMPU_METHOD 0 0 0 1.84467e+19 ECU_ADDRESS 0x24498 ECU_ADDRESS_EXTENSION 1 PHYS_UNIT "unit" READ_WRITE
 /begin IF_DATA XCP
  /begin DAQ_EVENT VARIABLE /begin DEFAULT_EVENT_LIST EVENT 0x1 /end DEFAULT_EVENT_LIST /end DAQ_EVENT
 /end IF_DATA
/end MEASUREMENT
/begin MEASUREMENT int8 "int8_t" SBYTE NO_COMPU_METHOD 0 0 -128 127 ECU_ADDRESS 0x244A0 ECU_ADDRESS_EXTENSION 1 PHYS_UNIT "unit" READ_WRITE
 /begin IF_DATA XCP
  /begin DAQ_EVENT VARIABLE /begin DEFAULT_EVENT_LIST EVENT 0x1 /end DEFAULT_EVENT_LIST /end DAQ_EVENT
 /end IF_DATA
/end MEASUREMENT
/begin MEASUREMENT int16 "int16_t" SWORD NO_COMPU_METHOD 0 0 -32768 32767 ECU_ADDRESS 0x244A2 ECU_ADDRESS_EXTENSION 1 PHYS_UNIT "unit" READ_WRITE
 /begin IF_DATA XCP
  /begin DAQ_EVENT VARIABLE /begin DEFAULT_EVENT_LIST EVENT 0x1 /end DEFAULT_EVENT_LIST /end DAQ_EVENT
 /end IF_DATA
/end MEASUREMENT
/begin MEASUREMENT int32 "int32_t" SLONG NO_COMPU_METHOD 0 0 -2.14748e+09 2.14748e+09 ECU_ADDRESS 0x244A4 ECU_ADDRESS_EXTENSION 1 PHYS_UNIT "unit" READ_WRITE
 /begin IF_DATA XCP
  /begin DAQ_EVENT VARIABLE /begin DEFAULT_EVENT_LIST EVENT 0x1 /end DEFAULT_EVENT_LIST /end DAQ_EVENT
 /end IF_DATA
/end MEASUREMENT
/begin MEASUREMENT int_64 "int64_t" A_INT64 NO_COMPU_METHOD 0 0 -9.22337e+18 9.22337e+18 ECU_ADDRESS 0x244A8 ECU_ADDRESS_EXTENSION 1 PHYS_UNIT "unit" READ_WRITE
 /begin IF_DATA XCP
  /begin DAQ_EVENT VARIABLE /begin DEFAULT_EVENT_LIST EVENT 0x1 /end DEFAULT_EVENT_LIST /end DAQ_EVENT
 /end IF_DATA
/end MEASUREMENT
/begin MEASUREMENT float4 "float4" FLOAT32_IEEE NO_COMPU_METHOD 0 0 -1000 1000 ECU_ADDRESS 0x244B0 ECU_ADDRESS_EXTENSION 1 PHYS_UNIT "unit" READ_WRITE
 /begin IF_DATA XCP
  /begin DAQ_EVENT VARIABLE /begin DEFAULT_EVENT_LIST EVENT 0x1 /end DEFAULT_EVENT_LIST /end DAQ_EVENT
 /end IF_DATA
/end MEASUREMENT
/begin MEASUREMENT double8 "double8" FLOAT64_IEEE NO_COMPU_METHOD 0 0 -1000 1000 ECU_ADDRESS 0x244B8 ECU_ADDRESS_EXTENSION 1 PHYS_UNIT "unit" READ_WRITE
 /begin IF_DATA XCP
  /begin DAQ_EVENT VARIABLE /begin DEFAULT_EVENT_LIST EVENT 0x1 /end DEFAULT_EVENT_LIST /end DAQ_EVENT
 /end IF_DATA
/end MEASUREMENT
/begin CHARACTERISTIC array "int16_t array" VAL_BLK 0x244C0 I16 0 NO_COMPU_METHOD -32768 32767 MATRIX_DIM 16 1 ECU_ADDRESS_EXTENSION 1
 /begin IF_DATA XCP
  /begin DAQ_EVENT VARIABLE /begin DEFAULT_EVENT_LIST EVENT 0x1 /end DEFAULT_EVENT_LIST /end DAQ_EVENT
 /end IF_DATA
/end CHARACTERISTIC
/begin CHARACTERISTIC matrix "double matrix" VAL_BLK 0x244E0 F64 0 NO_COMPU_METHOD -1e+12 1e+12 MATRIX_DIM 2 2 ECU_ADDRESS_EXTENSION 1
 /begin IF_DATA XCP
  /begin DAQ_EVENT VARIABLE /begin DEFAULT_EVENT_LIST EVENT 0x1 /end DEFAULT_EVENT_LIST /end DAQ_EVENT
 /end IF_DATA
/end CHARACTERISTIC
/* Stack frame relative addressing mode: event=event (1), addr_ext=3 */
/begin MEASUREMENT local_uint8 "Boolean value" UBYTE conv.bool 0 0 0 1 ECU_ADDRESS 0xFFFFD3BF ECU_ADDRESS_EXTENSION 3
 /begin IF_DATA XCP
  /begin DAQ_EVENT FIXED_EVENT_LIST EVENT 0x1 /end DAQ_EVENT
 /end IF_DATA
/end MEASUREMENT
/begin MEASUREMENT local_uint16 "Integer value" UWORD NO_COMPU_METHOD 0 0 0 65535 ECU_ADDRESS 0xFFFFD3BC ECU_ADDRESS_EXTENSION 3
 /begin IF_DATA XCP
  /begin DAQ_EVENT FIXED_EVENT_LIST EVENT 0x1 /end DAQ_EVENT
 /end IF_DATA
/end MEASUREMENT
/begin MEASUREMENT local_uint32 "Integer value" ULONG NO_COMPU_METHOD 0 0 0 4.29497e+09 ECU_ADDRESS 0xFFFFD3B8 ECU_ADDRESS_EXTENSION 3
 /begin IF_DATA XCP
  /begin DAQ_EVENT FIXED_EVENT_LIST EVENT 0x1 /end DAQ_EVENT
 /end IF_DATA
/end MEASUREMENT
/begin MEASUREMENT local_uint64 "Integer value" A_UINT64 NO_COMPU_METHOD 0 0 0 1e+12 ECU_ADDRESS 0xFFFFD3B0 ECU_ADDRESS_EXTENSION 3
 /begin IF_DATA XCP
  /begin DAQ_EVENT FIXED_EVENT_LIST EVENT 0x1 /end DAQ_EVENT
 /end IF_DATA
/end MEASUREMENT
/begin MEASUREMENT local_int8 "Integer value" SBYTE NO_COMPU_METHOD 0 0 -128 127 ECU_ADDRESS 0xFFFFD3AF ECU_ADDRESS_EXTENSION 3
 /begin IF_DATA XCP
  /begin DAQ_EVENT FIXED_EVENT_LIST EVENT 0x1 /end DAQ_EVENT
 /end IF_DATA
/end MEASUREMENT
/begin MEASUREMENT local_int16 "Integer value" SWORD NO_COMPU_METHOD 0 0 -32768 32767 ECU_ADDRESS 0xFFFFD3AC ECU_ADDRESS_EXTENSION 3
 /begin IF_DATA XCP
  /begin DAQ_EVENT FIXED_EVENT_LIST EVENT 0x1 /end DAQ_EVENT
 /end IF_DATA
/end MEASUREMENT
/begin MEASUREMENT local_int32 "Integer value" SLONG NO_COMPU_METHOD 0 0 -2.14748e+09 2.14748e+09 ECU_ADDRESS 0xFFFFD3A8 ECU_ADDRESS_EXTENSION 3
 /begin IF_DATA XCP
  /begin DAQ_EVENT FIXED_EVENT_LIST EVENT 0x1 /end DAQ_EVENT
 /end IF_DATA
/end MEASUREMENT
/begin MEASUREMENT local_int64 "Integer value" A_INT64 NO_COMPU_METHOD 0 0 -1e+12 1e+12 ECU_ADDRESS 0xFFFFD3A0 ECU_ADDRESS_EXTENSION 3
 /begin IF_DATA XCP
  /begin DAQ_EVENT FIXED_EVENT_LIST EVENT 0x1 /end DAQ_EVENT
 /end IF_DATA
/end MEASUREMENT
/begin MEASUREMENT local_float4 "float4" FLOAT32_IEEE conv.linear_conversion 0 0 -1000 1000 ECU_ADDRESS 0xFFFFD39C ECU_ADDRESS_EXTENSION 3
 /begin IF_DATA XCP
  /begin DAQ_EVENT FIXED_EVENT_LIST EVENT 0x1 /end DAQ_EVENT
 /end IF_DATA
/end MEASUREMENT
/begin MEASUREMENT local_double8 "double8" FLOAT64_IEEE conv.linear_conversion 0 0 -1000 1000 ECU_ADDRESS 0xFFFFD390 ECU_ADDRESS_EXTENSION 3
 /begin IF_DATA XCP
  /begin DAQ_EVENT FIXED_EVENT_LIST EVENT 0x1 /end DAQ_EVENT
 /end IF_DATA
/end MEASUREMENT
/begin CHARACTERISTIC local_array "int16_t array" VAL_BLK 0xFFFFFFC0 I16 0 NO_COMPU_METHOD -32768 32767 MATRIX_DIM 16 1 ECU_ADDRESS_EXTENSION 3
 /begin IF_DATA XCP
  /begin DAQ_EVENT FIXED_EVENT_LIST EVENT 0x1 /end DAQ_EVENT
 /end IF_DATA
/end CHARACTERISTIC
/begin CHARACTERISTIC local_matrix "double matrix" VAL_BLK 0xFFFFFFA0 F64 0 conv.linear_conversion 0 10 MATRIX_DIM 2 2 ECU_ADDRESS_EXTENSION 3
 /begin IF_DATA XCP
  /begin DAQ_EVENT FIXED_EVENT_LIST EVENT 0x1 /end DAQ_EVENT
 /end IF_DATA
/end CHARACTERISTIC
/begin TYPEDEF_STRUCTURE struct2_t "A2L typedef for struct2_t" 0x4 /begin STRUCTURE_COMPONENT byte_field M_U8 0x0 /end STRUCTURE_COMPONENT /begin STRUCTURE_COMPONENT word_field M_I16 0x2 /end STRUCTURE_COMPONENT /end TYPEDEF_STRUCTURE
/begin TYPEDEF_STRUCTURE struct1_t "A2L typedef for struct1_t" 0xC /begin STRUCTURE_COMPONENT byte_field M_U8 0x0 /end STRUCTURE_COMPONENT /begin STRUCTURE_COMPONENT word_field M_I16 0x2 /end STRUCTURE_COMPONENT /begin STRUCTURE_COMPONENT array_field M_U8 0x4 MATRIX_DIM 4 /end STRUCTURE_COMPONENT /begin STRUCTURE_COMPONENT struct_field struct2_t 0x8 /end STRUCTURE_COMPONENT /end TYPEDEF_STRUCTURE
/* Stack frame relative addressing mode: event=event (1), addr_ext=3 */
/begin INSTANCE local_struct2 "Instance of test_struct2_t" struct2_t 0xFFFFD338 ECU_ADDRESS_EXTENSION 3
 /begin IF_DATA XCP
  /begin DAQ_EVENT FIXED_EVENT_LIST EVENT 0x1 /end DAQ_EVENT
 /end IF_DATA
/end INSTANCE
/begin INSTANCE local_struct1 "Instance of test_struct1_t" struct1_t 0xFFFFD328 ECU_ADDRESS_EXTENSION 3
 /begin IF_DATA XCP
  /begin DAQ_EVENT FIXED_EVENT_LIST EVENT 0x1 /end DAQ_EVENT
 /end IF_DATA
/end INSTANCE
/begin INSTANCE local_struct1_array "Array [10] of struct1_t" struct1_t 0xFFFFFF40 ECU_ADDRESS_EXTENSION 3 MATRIX_DIM 8
 /begin IF_DATA XCP
  /begin DAQ_EVENT FIXED_EVENT_LIST EVENT 0x1 /end DAQ_EVENT
 /end IF_DATA
/end INSTANCE
/* Absolute addressing mode: default_event=event (1), addr_ext=1 */
/begin INSTANCE struct2 "Instance of test_struct2_t" struct2_t 0x24500 ECU_ADDRESS_EXTENSION 1
 /begin IF_DATA XCP
  /begin DAQ_EVENT VARIABLE /begin DEFAULT_EVENT_LIST EVENT 0x1 /end DEFAULT_EVENT_LIST /end DAQ_EVENT
 /end IF_DATA
/end INSTANCE
/begin INSTANCE struct1 "Instance of test_struct1_t" struct1_t 0x24504 ECU_ADDRESS_EXTENSION 1
 /begin IF_DATA XCP
  /begin DAQ_EVENT VARIABLE /begin DEFAULT_EVENT_LIST EVENT 0x1 /end DEFAULT_EVENT_LIST /end DAQ_EVENT
 /end IF_DATA
/end INSTANCE
/begin INSTANCE struct1_array "Array [10] of struct1_t" struct1_t 0x245C2 ECU_ADDRESS_EXTENSION 1 MATRIX_DIM 8
 /begin IF_DATA XCP
  /begin DAQ_EVENT VARIABLE /begin DEFAULT_EVENT_LIST EVENT 0x1 /end DEFAULT_EVENT_LIST /end DAQ_EVENT
 /end IF_DATA
/end INSTANCE
/* Relative addressing mode: event=event_heap (2), addr_ext=2 */
/begin INSTANCE heap_struct1 "Pointer to struct1_t on heap" struct1_t 0x20000 ECU_ADDRESS_EXTENSION 2
 /begin IF_DATA XCP
  /begin DAQ_EVENT FIXED_EVENT_LIST EVENT 0x2 /end DAQ_EVENT
 /end IF_DATA
/end INSTANCE
/* Typedefs */
/begin RECORD_LAYOUT U8 FNC_VALUES 1 UBYTE ROW_DIR DIRECT /end RECORD_LAYOUT
/begin RECORD_LAYOUT A_U8 AXIS_PTS_X 1 UBYTE INDEX_INCR DIRECT /end RECORD_LAYOUT
/begin TYPEDEF_MEASUREMENT M_U8 "" UBYTE NO_COMPU_METHOD 0 0 0 255 /end TYPEDEF_MEASUREMENT
/begin TYPEDEF_CHARACTERISTIC C_U8 "" VALUE U8 0 NO_COMPU_METHOD 0 255 /end TYPEDEF_CHARACTERISTIC
/begin RECORD_LAYOUT U16 FNC_VALUES 1 UWORD ROW_DIR DIRECT /end RECORD_LAYOUT
/begin RECORD_LAYOUT A_U16 AXIS_PTS_X 1 UWORD INDEX_INCR DIRECT /end RECORD_LAYOUT
/begin TYPEDEF_MEASUREMENT M_U16 "" UWORD NO_COMPU_METHOD 0 0 0 65535 /end TYPEDEF_MEASUREMENT
/begin TYPEDEF_CHARACTERISTIC C_U16 "" VALUE U16 0 NO_COMPU_METHOD 0 65535 /end TYPEDEF_CHARACTERISTIC
/begin RECORD_LAYOUT U32 FNC_VALUES 1 ULONG ROW_DIR DIRECT /end RECORD_LAYOUT
/begin RECORD_LAYOUT A_U32 AXIS_PTS_X 1 ULONG INDEX_INCR DIRECT /end RECORD_LAYOUT
/begin TYPEDEF_MEASUREMENT M_U32 "" ULONG NO_COMPU_METHOD 0 0 0 4.29497e+09 /end TYPEDEF_MEASUREMENT
/begin TYPEDEF_CHARACTERISTIC C_U32 "" VALUE U32 0 NO_COMPU_METHOD 0 4.29497e+09 /end TYPEDEF_CHARACTERISTIC
/begin RECORD_LAYOUT U64 FNC_VALUES 1 A_UINT64 ROW_DIR DIRECT /end RECORD_LAYOUT
/begin RECORD_LAYOUT A_U64 AXIS_PTS_X 1 A_UINT64 INDEX_INCR DIRECT /end RECORD_LAYOUT
/begin TYPEDEF_MEASUREMENT M_U64 "" A_UINT64 NO_COMPU_METHOD 0 0 0 1e+12 /end TYPEDEF_MEASUREMENT
/begin TYPEDEF_CHARACTERISTIC C_U64 "" VALUE U64 0 NO_COMPU_METHOD 0 1e+12 /end TYPEDEF_CHARACTERISTIC
/begin RECORD_LAYOUT I8 FNC_VALUES 1 SBYTE ROW_DIR DIRECT /end RECORD_LAYOUT
/begin RECORD_LAYOUT A_I8 AXIS_PTS_X 1 SBYTE INDEX_INCR DIRECT /end RECORD_LAYOUT
/begin TYPEDEF_MEASUREMENT M_I8 "" SBYTE NO_COMPU_METHOD 0 0 -128 127 /end TYPEDEF_MEASUREMENT
/begin TYPEDEF_CHARACTERISTIC C_I8 "" VALUE I8 0 NO_COMPU_METHOD -128 127 /end TYPEDEF_CHARACTERISTIC
/begin RECORD_LAYOUT I16 FNC_VALUES 1 SWORD ROW_DIR DIRECT /end RECORD_LAYOUT
/begin RECORD_LAYOUT A_I16 AXIS_PTS_X 1 SWORD INDEX_INCR DIRECT /end RECORD_LAYOUT
/begin TYPEDEF_MEASUREMENT M_I16 "" SWORD NO_COMPU_METHOD 0 0 -32768 32767 /end TYPEDEF_MEASUREMENT
/begin TYPEDEF_CHARACTERISTIC C_I16 "" VALUE I16 0 NO_COMPU_METHOD -32768 32767 /end TYPEDEF_CHARACTERISTIC
/begin RECORD_LAYOUT I32 FNC_VALUES 1 SLONG ROW_DIR DIRECT /end RECORD_LAYOUT
/begin RECORD_LAYOUT A_I32 AXIS_PTS_X 1 SLONG INDEX_INCR DIRECT /end RECORD_LAYOUT
/begin TYPEDEF_MEASUREMENT M_I32 "" SLONG NO_COMPU_METHOD 0 0 -2.14748e+09 2.14748e+09 /end TYPEDEF_MEASUREMENT
/begin TYPEDEF_CHARACTERISTIC C_I32 "" VALUE I32 0 NO_COMPU_METHOD -2.14748e+09 2.14748e+09 /end TYPEDEF_CHARACTERISTIC
/begin RECORD_LAYOUT I64 FNC_VALUES 1 A_INT64 ROW_DIR DIRECT /end RECORD_LAYOUT
/begin RECORD_LAYOUT A_I64 AXIS_PTS_X 1 A_INT64 INDEX_INCR DIRECT /end RECORD_LAYOUT
/begin TYPEDEF_MEASUREMENT M_I64 "" A_INT64 NO_COMPU_METHOD 0 0 -1e+12 1e+12 /end TYPEDEF_MEASUREMENT
/begin TYPEDEF_CHARACTERISTIC C_I64 "" VALUE I64 0 NO_COMPU_METHOD -1e+12 1e+12 /end TYPEDEF_CHARACTERISTIC
/begin RECORD_LAYOUT F32 FNC_VALUES 1 FLOAT32_IEEE ROW_DIR DIRECT /end RECORD_LAYOUT
/begin RECORD_LAYOUT A_F32 AXIS_PTS_X 1 FLOAT32_IEEE INDEX_INCR DIRECT /end RECORD_LAYOUT
/begin TYPEDEF_MEASUREMENT M_F32 "" FLOAT32_IEEE NO_COMPU_METHOD 0 0 -1e+12 1e+12 /end TYPEDEF_MEASUREMENT
/begin TYPEDEF_CHARACTERISTIC C_F32 "" VALUE F32 0 NO_COMPU_METHOD -1e+12 1e+12 /end TYPEDEF_CHARACTERISTIC
/begin RECORD_LAYOUT F64 FNC_VALUES 1 FLOAT64_IEEE ROW_DIR DIRECT /end RECORD_LAYOUT
/begin RECORD_LAYOUT A_F64 AXIS_PTS_X 1 FLOAT64_IEEE INDEX_INCR DIRECT /end RECORD_LAYOUT
/begin TYPEDEF_MEASUREMENT M_F64 "" FLOAT64_IEEE NO_COMPU_METHOD 0 0 -1e+12 1e+12 /end TYPEDEF_MEASUREMENT
/begin TYPEDEF_CHARACTERISTIC C_F64 "" VALUE F64 0 NO_COMPU_METHOD -1e+12 1e+12 /end TYPEDEF_CHARACTERISTIC
/begin TYPEDEF_CHARACTERISTIC C_uint8 "Parameter typedef field" VALUE U8 0 NO_COMPU_METHOD 0 255 PHYS_UNIT "unit" /end TYPEDEF_CHARACTERISTIC
/begin TYPEDEF_CHARACTERISTIC C_uint16 "Parameter typedef field" VALUE U16 0 NO_COMPU_METHOD 0 65535 PHYS_UNIT "unit" /end TYPEDEF_CHARACTERISTIC
/begin TYPEDEF_CHARACTERISTIC C_uint32 "Parameter typedef field" VALUE U32 0 NO_COMPU_METHOD 0 4.29497e+09 PHYS_UNIT "unit" /end TYPEDEF_CHARACTERISTIC
/begin TYPEDEF_CHARACTERISTIC C_uint_64 "Parameter typedef field" VALUE U64 0 NO_COMPU_METHOD 0 1.84467e+19 PHYS_UNIT "unit" /end TYPEDEF_CHARACTERISTIC
/begin TYPEDEF_CHARACTERISTIC C_int8 "Parameter typedef field" VALUE I8 0 NO_COMPU_METHOD -128 127 PHYS_UNIT "unit" /end TYPEDEF_CHARACTERISTIC
/begin TYPEDEF_CHARACTERISTIC C_int16 "Parameter typedef field" VALUE I16 0 NO_COMPU_METHOD -32768 32767 PHYS_UNIT "unit" /end TYPEDEF_CHARACTERISTIC
/begin TYPEDEF_CHARACTERISTIC C_int32 "Parameter typedef field" VALUE I32 0 NO_COMPU_METHOD -2.14748e+09 2.14748e+09 PHYS_UNIT "unit" /end TYPEDEF_CHARACTERISTIC
/begin TYPEDEF_CHARACTERISTIC C_int_64 "Parameter typedef field" VALUE I64 0 NO_COMPU_METHOD -9.22337e+18 9.22337e+18 PHYS_UNIT "unit" /end TYPEDEF_CHARACTERISTIC
/begin TYPEDEF_CHARACTERISTIC C_float4 "Parameter typedef field" VALUE F32 0 NO_COMPU_METHOD -1000 1000 PHYS_UNIT "unit" /end TYPEDEF_CHARACTERISTIC
/begin TYPEDEF_CHARACTERISTIC C_double8 "Parameter typedef field" VALUE F64 0 NO_COMPU_METHOD -1000 1000 PHYS_UNIT "unit" /end TYPEDEF_CHARACTERISTIC
/begin TYPEDEF_CHARACTERISTIC C_curve1 "Parameter typedef field" CURVE I16 0 NO_COMPU_METHOD -20 20
 /begin AXIS_DESCR FIX_AXIS NO_INPUT_QUANTITY NO_COMPU_METHOD 8 0 7 FIX_AXIS_PAR_DIST 0 1 8 /end AXIS_DESCR
 PHYS_UNIT "unit" /end TYPEDEF_CHARACTERISTIC
/begin TYPEDEF_CHARACTERISTIC C_curve2 "Parameter typedef field" CURVE F64 0 NO_COMPU_METHOD 0 1000
 /begin AXIS_DESCR COM_AXIS NO_INPUT_QUANTITY NO_COMPU_METHOD 8 0.0 0.0 AXIS_PTS_REF THIS.curve2_axis /end AXIS_DESCR
 PHYS_UNIT "unit" /end TYPEDEF_CHARACTERISTIC
/begin TYPEDEF_AXIS A_curve2_axis "Parameter typedef field" NO_INPUT_QUANTITY A_F32 0 NO_COMPU_METHOD 8 0 20 PHYS_UNIT "unit" /end TYPEDEF_AXIS
/begin TYPEDEF_CHARACTERISTIC C_map1 "Parameter typedef field" MAP I8 0 NO_COMPU_METHOD -128 127
 /begin AXIS_DESCR FIX_AXIS NO_INPUT_QUANTITY NO_COMPU_METHOD 8 0 7 FIX_AXIS_PAR_DIST 0 1 8 /end AXIS_DESCR
 /begin AXIS_DESCR FIX_AXIS NO_INPUT_QUANTITY NO_COMPU_METHOD 8 0 7 FIX_AXIS_PAR_DIST 0 1 8 /end AXIS_DESCR
/end TYPEDEF_CHARACTERISTIC
/begin TYPEDEF_CHARACTERISTIC C_map2 "Parameter typedef field" MAP I32 0 NO_COMPU_METHOD -128 127
 /begin AXIS_DESCR COM_AXIS NO_INPUT_QUANTITY NO_COMPU_METHOD 8 0.0 0.0 AXIS_PTS_REF THIS.map2_x_axis /end AXIS_DESCR
 /begin AXIS_DESCR COM_AXIS NO_INPUT_QUANTITY NO_COMPU_METHOD 4 0.0 0.0 AXIS_PTS_REF THIS.map2_y_axis /end AXIS_DESCR
/end TYPEDEF_CHARACTERISTIC
/begin TYPEDEF_AXIS A_map2_x_axis "Parameter typedef field" NO_INPUT_QUANTITY A_I16 0 NO_COMPU_METHOD 8 0 1000 PHYS_UNIT "unit" /end TYPEDEF_AXIS
/begin TYPEDEF_AXIS A_map2_y_axis "Parameter typedef field" NO_INPUT_QUANTITY A_U16 0 NO_COMPU_METHOD 4 0 500 PHYS_UNIT "unit" /end TYPEDEF_AXIS
/begin TYPEDEF_CHARACTERISTIC C_map3 "Parameter typedef field" MAP U64 0 NO_COMPU_METHOD -128 127
 /begin AXIS_DESCR COM_AXIS NO_INPUT_QUANTITY NO_COMPU_METHOD 8 0.0 0.0 AXIS_PTS_REF THIS.map3_x_axis /end AXIS_DESCR
 /begin AXIS_DESCR FIX_AXIS NO_INPUT_QUANTITY NO_COMPU_METHOD 4 0 3 FIX_AXIS_PAR_DIST 0 1 4 /end AXIS_DESCR
/end TYPEDEF_CHARACTERISTIC
/begin TYPEDEF_AXIS A_map3_x_axis "Parameter typedef field" NO_INPUT_QUANTITY A_I64 0 NO_COMPU_METHOD 8 0 1000 PHYS_UNIT "unit" /end TYPEDEF_AXIS
/* Groups */
/begin GROUP Global "Parameters in global memory"
 /begin REF_CHARACTERISTIC static_counter_max static_uint8 static_uint16 static_uint32 static_uint64 static_int8 static_int16 static_int32 static_float4 static_double8 static_curve1 static_curve2 static_curve2_axis static_map1 static_map2 static_map2_x_axis static_map2_y_axis static_map3 static_map3_x_axis static_params.uint8 static_params.uint16 static_params.uint32 static_params.uint_64 static_params.int8 static_params.int16 static_params.int32 static_params.int_64 static_params.float4 static_params.double8 static_params.curve1 static_params.curve2 static_params.curve2_axis static_params.map1 static_params.map2 static_params.map2_x_axis static_params.map2_y_axis static_params.map3 static_params.map3_x_axis /end REF_CHARACTERISTIC
/end GROUP
/begin GROUP params "Calibration Segment" /begin REF_CHARACTERISTIC params /end REF_CHARACTERISTIC /end GROUP
/begin GROUP params2 "Calibration Segment"
 /begin REF_CHARACTERISTIC params.uint8 params.uint16 params.uint32 params.uint_64 params.int8 params.int16 params.int32 params.int_64 params.float4 params.double8 params.curve1 params.map1 params.curve2_axis params.map2_x_axis params.map2_y_axis params.map3_x_axis params.curve2 params.map2 params.map3 /end REF_CHARACTERISTIC
/end GROUP
/begin GROUP event "Measurement event group"
 /begin REF_MEASUREMENT uint8 uint16 uint32 uint_64 int8 int16 int32 int_64 float4 double8 array matrix local_uint8 local_uint16 local_uint32 local_uint64 local_int8 local_int16 local_int32 local_int64 local_float4 local_double8 local_array local_matrix local_struct2 local_struct1 local_struct1_array struct2 struct1 struct1_array /end REF_MEASUREMENT
/end GROUP
/begin GROUP event_heap "Measurement event group" /begin REF_MEASUREMENT heap_struct1 /end REF_MEASUREMENT /end GROUP
/begin GROUP Events "Events" ROOT /begin SUB_GROUP sync event event_heap /end SUB_GROUP /end GROUP
/* Conversions */
/begin COMPU_METHOD conv.bool "" TAB_VERB "%.0" "" COMPU_TAB_REF conv.bool.table /end COMPU_METHOD
/begin COMPU_VTAB conv.bool.table "" TAB_VERB 2 0 "false" 1 "true" /end COMPU_VTAB
/begin COMPU_METHOD conv.enum_conversion "" TAB_VERB "%.0 " "" COMPU_TAB_REF conv.enum_conversion.table /end COMPU_METHOD
/begin COMPU_VTAB conv.enum_conversion.table "" TAB_VERB 5 0 "SINE" 1 "SQUARE" 2 "TRIANGLE" 3 "SAWTOOTH" 4 "ARBITRARY" /end COMPU_VTAB
/begin COMPU_METHOD conv.linear_conversion "Temperature as uint8*2-50" LINEAR "%6.3" "°C" COEFFS_LINEAR 2 -50 /end COMPU_METHOD
/begin COMPU_METHOD conv.events "" TAB_VERB "%.0 " "" COMPU_TAB_REF conv.events.table /end COMPU_METHOD
/begin COMPU_VTAB conv.events.table "" TAB_VERB 3 0 "sync" 1 "event" 2 "event_heap" /end COMPU_VTAB
/begin MOD_PAR "" EPK "_Jul_22_202520:06:20" ADDR_EPK 0x80000000
 /begin MEMORY_SEGMENT epk "" DATA FLASH INTERN 0x80000000 20 -1 -1 -1 -1 -1
  /begin IF_DATA XCP
   /begin SEGMENT 0 2 0 0 0 /begin CHECKSUM XCP_CRC_16_CITT MAX_BLOCK_SIZE 0xFFFF EXTERNAL_FUNCTION "" /end CHECKSUM
    /begin PAGE 0 ECU_ACCESS_DONT_CARE XCP_READ_ACCESS_DONT_CARE XCP_WRITE_ACCESS_DONT_CARE /end PAGE
    /begin PAGE 1 ECU_ACCESS_DONT_CARE XCP_READ_ACCESS_DONT_CARE XCP_WRITE_ACCESS_NOT_ALLOWED /end PAGE
   /end SEGMENT
  /end IF_DATA
 /end MEMORY_SEGMENT
 /begin MEMORY_SEGMENT params "" DATA FLASH INTERN 0x80010000 0x248 -1 -1 -1 -1 -1
  /begin IF_DATA XCP
   /begin SEGMENT 1 2 0 0 0 /begin CHECKSUM XCP_CRC_16_CITT MAX_BLOCK_SIZE 0xFFFF EXTERNAL_FUNCTION "" /end CHECKSUM
    /begin PAGE 0 ECU_ACCESS_DONT_CARE XCP_READ_ACCESS_DONT_CARE XCP_WRITE_ACCESS_DONT_CARE /end PAGE
    /begin PAGE 1 ECU_ACCESS_DONT_CARE XCP_READ_ACCESS_DONT_CARE XCP_WRITE_ACCESS_NOT_ALLOWED /end PAGE
   /end SEGMENT
  /end IF_DATA
 /end MEMORY_SEGMENT
 /begin MEMORY_SEGMENT params2 "" DATA FLASH INTERN 0x80020000 0x248 -1 -1 -1 -1 -1
  /begin IF_DATA XCP
   /begin SEGMENT 2 2 0 0 0 /begin CHECKSUM XCP_CRC_16_CITT MAX_BLOCK_SIZE 0xFFFF EXTERNAL_FUNCTION "" /end CHECKSUM
    /begin PAGE 0 ECU_ACCESS_DONT_CARE XCP_READ_ACCESS_DONT_CARE XCP_WRITE_ACCESS_DONT_CARE /end PAGE
    /begin PAGE 1 ECU_ACCESS_DONT_CARE XCP_READ_ACCESS_DONT_CARE XCP_WRITE_ACCESS_NOT_ALLOWED /end PAGE
   /end SEGMENT
  /end IF_DATA
 /end MEMORY_SEGMENT
/end MOD_PAR
/begin IF_DATA XCP
 /begin PROTOCOL_LAYER 0x104 1000 2000 0 0 0 0 0 248 1024 BYTE_ORDER_MSB_LAST ADDRESS_GRANULARITY_BYTE OPTIONAL_CMD GET_COMM_MODE_INFO OPTIONAL_CMD GET_ID OPTIONAL_CMD SET_REQUEST OPTIONAL_CMD SET_MTA OPTIONAL_CMD UPLOAD OPTIONAL_CMD SHORT_UPLOAD OPTIONAL_CMD DOWNLOAD OPTIONAL_CMD SHORT_DOWNLOAD OPTIONAL_CMD GET_CAL_PAGE OPTIONAL_CMD SET_CAL_PAGE OPTIONAL_CMD COPY_CAL_PAGE OPTIONAL_CMD GET_PAG_PROCESSOR_INFO OPTIONAL_CMD GET_SEGMENT_MODE OPTIONAL_CMD SET_SEGMENT_MODE OPTIONAL_CMD BUILD_CHECKSUM OPTIONAL_CMD USER_CMD OPTIONAL_CMD GET_DAQ_RESOLUTION_INFO OPTIONAL_CMD GET_DAQ_PROCESSOR_INFO OPTIONAL_CMD FREE_DAQ OPTIONAL_CMD ALLOC_DAQ OPTIONAL_CMD ALLOC_ODT OPTIONAL_CMD ALLOC_ODT_ENTRY OPTIONAL_CMD SET_DAQ_PTR OPTIONAL_CMD WRITE_DAQ OPTIONAL_CMD GET_DAQ_LIST_MODE OPTIONAL_CMD SET_DAQ_LIST_MODE OPTIONAL_CMD START_STOP_SYNCH OPTIONAL_CMD START_STOP_DAQ_LIST OPTIONAL_CMD GET_DAQ_CLOCK OPTIONAL_CMD WRITE_DAQ_MULTIPLE OPTIONAL_CMD TIME_CORRELATION_PROPERTIES OPTIONAL_LEVEL1_CMD GET_VERSION /end PROTOCOL_LAYER
 /begin DAQ DYNAMIC 0 3 0 OPTIMISATION_TYPE_DEFAULT ADDRESS_EXTENSION_FREE IDENTIFICATION_FIELD_TYPE_RELATIVE_BYTE GRANULARITY_ODT_ENTRY_SIZE_DAQ_BYTE 0xF8 OVERLOAD_INDICATION_PID /begin TIMESTAMP_SUPPORTED 0x1 SIZE_DWORD UNIT_1NS TIMESTAMP_FIXED /end TIMESTAMP_SUPPORTED /begin EVENT "sync" "sync" 0x0 DAQ 0xFF 0 0 0 CONSISTENCY EVENT /end EVENT /begin EVENT "event" "event" 0x1 DAQ 0xFF 0 0 0 CONSISTENCY EVENT /end EVENT
  /begin EVENT "event_heap" "event_heap" 0x2 DAQ 0xFF 0 0 0 CONSISTENCY EVENT /end EVENT
 /end DAQ
 /begin XCP_ON_UDP_IP 0x104 5555 ADDRESS "192.168.0.128" /end XCP_ON_UDP_IP
/end IF_DATA
/end MODULE
/end PROJECT
