ASAP2_VERSION 1 71
/begin PROJECT a2l_test ""
/begin HEADER "" VERSION "1.0" PROJECT_NO VECTOR /end HEADER
/begin MODULE a2l_test ""
/include "XCP_104.aml"
/begin MOD_COMMON "" BYTE_ORDER MSB_LAST ALIGNMENT_BYTE 1 ALIGNMENT_WORD 1 ALIGNMENT_LONG 1 ALIGNMENT_FLOAT16_IEEE 1 ALIGNMENT_FLOAT32_IEEE 1 ALIGNMENT_FLOAT64_IEEE 1 ALIGNMENT_INT64 1 /end MOD_COMMON
/begin TYPEDEF_STRUCTURE params_t "comment" 0x248 /begin STRUCTURE_COMPONENT uint8 C_uint8 0x0 /end STRUCTURE_COMPONENT /begin STRUCTURE_COMPONENT uint16 C_uint16 0x2 /end STRUCTURE_COMPONENT /begin STRUCTURE_COMPONENT uint32 C_uint32 0x4 /end STRUCTURE_COMPONENT /begin STRUCTURE_COMPONENT uint64 C_uint64 0x8 /end STRUCTURE_COMPONENT /begin STRUCTURE_COMPONENT int8 C_int8 0x10 /end STRUCTURE_COMPONENT /begin STRUCTURE_COMPONENT int16 C_int16 0x12 /end STRUCTURE_COMPONENT /begin STRUCTURE_COMPONENT int32 C_int32 0x14 /end STRUCTURE_COMPONENT /begin STRUCTURE_COMPONENT int64 C_int64 0x18 /end STRUCTURE_COMPONENT /begin STRUCTURE_COMPONENT float4 C_float4 0x20 /end STRUCTURE_COMPONENT /begin STRUCTURE_COMPONENT double8 C_double8 0x28 /end STRUCTURE_COMPONENT /begin STRUCTURE_COMPONENT curve1 C_curve1 0x30 /end STRUCTURE_COMPONENT /begin STRUCTURE_COMPONENT curve2 C_curve2 0x50 /end STRUCTURE_COMPONENT /begin STRUCTURE_COMPONENT curve2_axis A_curve2_axis 0x90 /end STRUCTURE_COMPONENT /begin STRUCTURE_COMPONENT map1 C_map1 0xB0 /end STRUCTURE_COMPONENT /begin STRUCTURE_COMPONENT map2 C_map2 0xF0 /end STRUCTURE_COMPONENT /begin STRUCTURE_COMPONENT map2_x_axis A_map2_x_axis 0x170 /end STRUCTURE_COMPONENT /begin STRUCTURE_COMPONENT map2_y_axis A_map2_y_axis 0x180 /end STRUCTURE_COMPONENT /begin STRUCTURE_COMPONENT map3 C_map3 0x188 /end STRUCTURE_COMPONENT /begin STRUCTURE_COMPONENT map3_x_axis A_map3_x_axis 0x208 /end STRUCTURE_COMPONENT /end TYPEDEF_STRUCTURE
/* Segment relative addressing mode: calseg=segment_1 */
/begin INSTANCE params "comment" params_t 0x80010000 /end INSTANCE
/* Segment relative addressing mode: calseg=segment_2 */
/begin CHARACTERISTIC params.uint8 "Comment" VALUE 0x80020000 U16 0 NO_COMPU_METHOD 0 255 PHYS_UNIT "unit" /end CHARACTERISTIC
/begin CHARACTERISTIC params.uint16 "Comment" VALUE 0x80020002 U16 0 NO_COMPU_METHOD 0 65535 PHYS_UNIT "unit" /end CHARACTERISTIC
/begin CHARACTERISTIC params.uint32 "Comment" VALUE 0x80020004 U32 0 NO_COMPU_METHOD 0 4.29497e+09 PHYS_UNIT "unit" /end CHARACTERISTIC
/begin CHARACTERISTIC params.uint64 "Comment" VALUE 0x80020008 U64 0 NO_COMPU_METHOD 0 1.84467e+19 PHYS_UNIT "unit" /end CHARACTERISTIC
/begin CHARACTERISTIC params.int8 "Comment" VALUE 0x80020010 I8 0 NO_COMPU_METHOD -128 127 PHYS_UNIT "unit" /end CHARACTERISTIC
/begin CHARACTERISTIC params.int16 "Comment" VALUE 0x80020012 I16 0 NO_COMPU_METHOD -32768 32767 PHYS_UNIT "unit" /end CHARACTERISTIC
/begin CHARACTERISTIC params.int32 "Comment" VALUE 0x80020014 I32 0 NO_COMPU_METHOD -2.14748e+09 2.14748e+09 PHYS_UNIT "unit" /end CHARACTERISTIC
/begin CHARACTERISTIC params.float4 "Comment" VALUE 0x80020020 F32 0 NO_COMPU_METHOD -1000 1000 PHYS_UNIT "unit" /end CHARACTERISTIC
/begin CHARACTERISTIC params.double8 "Comment" VALUE 0x80020028 F64 0 NO_COMPU_METHOD -1000 1000 PHYS_UNIT "unit" /end CHARACTERISTIC
/begin CHARACTERISTIC params.curve1 "Comment" CURVE 0x80020030 I16 0 NO_COMPU_METHOD -20 20
 /begin AXIS_DESCR FIX_AXIS NO_INPUT_QUANTITY NO_COMPU_METHOD 8 0 7 FIX_AXIS_PAR_DIST 0 1 8 /end AXIS_DESCR
 PHYS_UNIT "unit" /end CHARACTERISTIC
/begin CHARACTERISTIC params.map1 "Comment" MAP 0x800200B0 I8 0 NO_COMPU_METHOD -128 127
 /begin AXIS_DESCR FIX_AXIS NO_INPUT_QUANTITY NO_COMPU_METHOD 8 0 7 FIX_AXIS_PAR_DIST 0 1 8 /end AXIS_DESCR
 /begin AXIS_DESCR FIX_AXIS NO_INPUT_QUANTITY NO_COMPU_METHOD 8 0 7 FIX_AXIS_PAR_DIST 0 1 8 /end AXIS_DESCR
 PHYS_UNIT "" /end CHARACTERISTIC
/* Absolute addressing mode: event=event (0), addr_ext=1 */
/begin MEASUREMENT uint8 "uint8_t" UBYTE conv.linear_conversion 0 0 -50 200 ECU_ADDRESS 0x242E0 ECU_ADDRESS_EXTENSION 1 READ_WRITE
 /begin IF_DATA XCP
  /begin DAQ_EVENT VARIABLE /begin DEFAULT_EVENT_LIST EVENT 0x0 /end DEFAULT_EVENT_LIST /end DAQ_EVENT
 /end IF_DATA
/end MEASUREMENT
/begin MEASUREMENT uint16 "uint16_t" UWORD NO_COMPU_METHOD 0 0 0 65535 ECU_ADDRESS 0x24000 ECU_ADDRESS_EXTENSION 1 PHYS_UNIT "unit" READ_WRITE
 /begin IF_DATA XCP
  /begin DAQ_EVENT VARIABLE /begin DEFAULT_EVENT_LIST EVENT 0x0 /end DEFAULT_EVENT_LIST /end DAQ_EVENT
 /end IF_DATA
/end MEASUREMENT
/begin MEASUREMENT uint32 "uint32_t" ULONG NO_COMPU_METHOD 0 0 0 4.29497e+09 ECU_ADDRESS 0x24004 ECU_ADDRESS_EXTENSION 1 PHYS_UNIT "unit" READ_WRITE
 /begin IF_DATA XCP
  /begin DAQ_EVENT VARIABLE /begin DEFAULT_EVENT_LIST EVENT 0x0 /end DEFAULT_EVENT_LIST /end DAQ_EVENT
 /end IF_DATA
/end MEASUREMENT
/begin MEASUREMENT uint64 "uint64_t" A_UINT64 NO_COMPU_METHOD 0 0 0 1.84467e+19 ECU_ADDRESS 0x24008 ECU_ADDRESS_EXTENSION 1 PHYS_UNIT "unit" READ_WRITE
 /begin IF_DATA XCP
  /begin DAQ_EVENT VARIABLE /begin DEFAULT_EVENT_LIST EVENT 0x0 /end DEFAULT_EVENT_LIST /end DAQ_EVENT
 /end IF_DATA
/end MEASUREMENT
/begin MEASUREMENT int8 "int8_t" SBYTE NO_COMPU_METHOD 0 0 -128 127 ECU_ADDRESS 0x24010 ECU_ADDRESS_EXTENSION 1 PHYS_UNIT "unit" READ_WRITE
 /begin IF_DATA XCP
  /begin DAQ_EVENT VARIABLE /begin DEFAULT_EVENT_LIST EVENT 0x0 /end DEFAULT_EVENT_LIST /end DAQ_EVENT
 /end IF_DATA
/end MEASUREMENT
/begin MEASUREMENT int16 "int16_t" SWORD NO_COMPU_METHOD 0 0 -32768 32767 ECU_ADDRESS 0x24012 ECU_ADDRESS_EXTENSION 1 PHYS_UNIT "unit" READ_WRITE
 /begin IF_DATA XCP
  /begin DAQ_EVENT VARIABLE /begin DEFAULT_EVENT_LIST EVENT 0x0 /end DEFAULT_EVENT_LIST /end DAQ_EVENT
 /end IF_DATA
/end MEASUREMENT
/begin MEASUREMENT int32 "int32_t" SLONG NO_COMPU_METHOD 0 0 -2.14748e+09 2.14748e+09 ECU_ADDRESS 0x24014 ECU_ADDRESS_EXTENSION 1 PHYS_UNIT "unit" READ_WRITE
 /begin IF_DATA XCP
  /begin DAQ_EVENT VARIABLE /begin DEFAULT_EVENT_LIST EVENT 0x0 /end DEFAULT_EVENT_LIST /end DAQ_EVENT
 /end IF_DATA
/end MEASUREMENT
/begin MEASUREMENT int64 "int64_t" A_INT64 NO_COMPU_METHOD 0 0 -9.22337e+18 9.22337e+18 ECU_ADDRESS 0x24018 ECU_ADDRESS_EXTENSION 1 PHYS_UNIT "unit" READ_WRITE
 /begin IF_DATA XCP
  /begin DAQ_EVENT VARIABLE /begin DEFAULT_EVENT_LIST EVENT 0x0 /end DEFAULT_EVENT_LIST /end DAQ_EVENT
 /end IF_DATA
/end MEASUREMENT
/begin MEASUREMENT float4 "float4" FLOAT32_IEEE NO_COMPU_METHOD 0 0 -1000 1000 ECU_ADDRESS 0x24020 ECU_ADDRESS_EXTENSION 1 PHYS_UNIT "unit" READ_WRITE
 /begin IF_DATA XCP
  /begin DAQ_EVENT VARIABLE /begin DEFAULT_EVENT_LIST EVENT 0x0 /end DEFAULT_EVENT_LIST /end DAQ_EVENT
 /end IF_DATA
/end MEASUREMENT
/begin MEASUREMENT double8 "double8" FLOAT64_IEEE NO_COMPU_METHOD 0 0 -1000 1000 ECU_ADDRESS 0x24028 ECU_ADDRESS_EXTENSION 1 PHYS_UNIT "unit" READ_WRITE
 /begin IF_DATA XCP
  /begin DAQ_EVENT VARIABLE /begin DEFAULT_EVENT_LIST EVENT 0x0 /end DEFAULT_EVENT_LIST /end DAQ_EVENT
 /end IF_DATA
/end MEASUREMENT
/* Typedefs */
/begin RECORD_LAYOUT U8 FNC_VALUES 1 UBYTE ROW_DIR DIRECT /end RECORD_LAYOUT
/begin RECORD_LAYOUT A_U8 AXIS_PTS_X 1 UBYTE INDEX_INCR DIRECT /end RECORD_LAYOUT
/begin TYPEDEF_MEASUREMENT M_U8 "" UBYTE NO_COMPU_METHOD 0 0 0 255 /end TYPEDEF_MEASUREMENT
/begin TYPEDEF_CHARACTERISTIC C_U8 "" VALUE U8 0 NO_COMPU_METHOD 0 255 /end TYPEDEF_CHARACTERISTIC
/begin RECORD_LAYOUT U16 FNC_VALUES 1 UWORD ROW_DIR DIRECT /end RECORD_LAYOUT
/begin RECORD_LAYOUT A_U16 AXIS_PTS_X 1 UWORD INDEX_INCR DIRECT /end RECORD_LAYOUT
/begin TYPEDEF_MEASUREMENT M_U16 "" UWORD NO_COMPU_METHOD 0 0 0 65535 /end TYPEDEF_MEASUREMENT
/begin TYPEDEF_CHARACTERISTIC C_U16 "" VALUE U16 0 NO_COMPU_METHOD 0 65535 /end TYPEDEF_CHARACTERISTIC
/begin RECORD_LAYOUT U32 FNC_VALUES 1 ULONG ROW_DIR DIRECT /end RECORD_LAYOUT
/begin RECORD_LAYOUT A_U32 AXIS_PTS_X 1 ULONG INDEX_INCR DIRECT /end RECORD_LAYOUT
/begin TYPEDEF_MEASUREMENT M_U32 "" ULONG NO_COMPU_METHOD 0 0 0 4.29497e+09 /end TYPEDEF_MEASUREMENT
/begin TYPEDEF_CHARACTERISTIC C_U32 "" VALUE U32 0 NO_COMPU_METHOD 0 4.29497e+09 /end TYPEDEF_CHARACTERISTIC
/begin RECORD_LAYOUT U64 FNC_VALUES 1 A_UINT64 ROW_DIR DIRECT /end RECORD_LAYOUT
/begin RECORD_LAYOUT A_U64 AXIS_PTS_X 1 A_UINT64 INDEX_INCR DIRECT /end RECORD_LAYOUT
/begin TYPEDEF_MEASUREMENT M_U64 "" A_UINT64 NO_COMPU_METHOD 0 0 0 1e+12 /end TYPEDEF_MEASUREMENT
/begin TYPEDEF_CHARACTERISTIC C_U64 "" VALUE U64 0 NO_COMPU_METHOD 0 1e+12 /end TYPEDEF_CHARACTERISTIC
/begin RECORD_LAYOUT I8 FNC_VALUES 1 SBYTE ROW_DIR DIRECT /end RECORD_LAYOUT
/begin RECORD_LAYOUT A_I8 AXIS_PTS_X 1 SBYTE INDEX_INCR DIRECT /end RECORD_LAYOUT
/begin TYPEDEF_MEASUREMENT M_I8 "" SBYTE NO_COMPU_METHOD 0 0 -128 127 /end TYPEDEF_MEASUREMENT
/begin TYPEDEF_CHARACTERISTIC C_I8 "" VALUE I8 0 NO_COMPU_METHOD -128 127 /end TYPEDEF_CHARACTERISTIC
/begin RECORD_LAYOUT I16 FNC_VALUES 1 SWORD ROW_DIR DIRECT /end RECORD_LAYOUT
/begin RECORD_LAYOUT A_I16 AXIS_PTS_X 1 SWORD INDEX_INCR DIRECT /end RECORD_LAYOUT
/begin TYPEDEF_MEASUREMENT M_I16 "" SWORD NO_COMPU_METHOD 0 0 -32768 32767 /end TYPEDEF_MEASUREMENT
/begin TYPEDEF_CHARACTERISTIC C_I16 "" VALUE I16 0 NO_COMPU_METHOD -32768 32767 /end TYPEDEF_CHARACTERISTIC
/begin RECORD_LAYOUT I32 FNC_VALUES 1 SLONG ROW_DIR DIRECT /end RECORD_LAYOUT
/begin RECORD_LAYOUT A_I32 AXIS_PTS_X 1 SLONG INDEX_INCR DIRECT /end RECORD_LAYOUT
/begin TYPEDEF_MEASUREMENT M_I32 "" SLONG NO_COMPU_METHOD 0 0 -2.14748e+09 2.14748e+09 /end TYPEDEF_MEASUREMENT
/begin TYPEDEF_CHARACTERISTIC C_I32 "" VALUE I32 0 NO_COMPU_METHOD -2.14748e+09 2.14748e+09 /end TYPEDEF_CHARACTERISTIC
/begin RECORD_LAYOUT I64 FNC_VALUES 1 A_INT64 ROW_DIR DIRECT /end RECORD_LAYOUT
/begin RECORD_LAYOUT A_I64 AXIS_PTS_X 1 A_INT64 INDEX_INCR DIRECT /end RECORD_LAYOUT
/begin TYPEDEF_MEASUREMENT M_I64 "" A_INT64 NO_COMPU_METHOD 0 0 -1e+12 1e+12 /end TYPEDEF_MEASUREMENT
/begin TYPEDEF_CHARACTERISTIC C_I64 "" VALUE I64 0 NO_COMPU_METHOD -1e+12 1e+12 /end TYPEDEF_CHARACTERISTIC
/begin RECORD_LAYOUT F32 FNC_VALUES 1 FLOAT32_IEEE ROW_DIR DIRECT /end RECORD_LAYOUT
/begin RECORD_LAYOUT A_F32 AXIS_PTS_X 1 FLOAT32_IEEE INDEX_INCR DIRECT /end RECORD_LAYOUT
/begin TYPEDEF_MEASUREMENT M_F32 "" FLOAT32_IEEE NO_COMPU_METHOD 0 0 -1e+12 1e+12 /end TYPEDEF_MEASUREMENT
/begin TYPEDEF_CHARACTERISTIC C_F32 "" VALUE F32 0 NO_COMPU_METHOD -1e+12 1e+12 /end TYPEDEF_CHARACTERISTIC
/begin RECORD_LAYOUT F64 FNC_VALUES 1 FLOAT64_IEEE ROW_DIR DIRECT /end RECORD_LAYOUT
/begin RECORD_LAYOUT A_F64 AXIS_PTS_X 1 FLOAT64_IEEE INDEX_INCR DIRECT /end RECORD_LAYOUT
/begin TYPEDEF_MEASUREMENT M_F64 "" FLOAT64_IEEE NO_COMPU_METHOD 0 0 -1e+12 1e+12 /end TYPEDEF_MEASUREMENT
/begin TYPEDEF_CHARACTERISTIC C_F64 "" VALUE F64 0 NO_COMPU_METHOD -1e+12 1e+12 /end TYPEDEF_CHARACTERISTIC
/begin TYPEDEF_CHARACTERISTIC C_uint8 "comment" VALUE U16 0 NO_COMPU_METHOD 0 255 PHYS_UNIT "unit" /end TYPEDEF_CHARACTERISTIC
/begin TYPEDEF_CHARACTERISTIC C_uint16 "comment" VALUE U16 0 NO_COMPU_METHOD 0 65535 PHYS_UNIT "unit" /end TYPEDEF_CHARACTERISTIC
/begin TYPEDEF_CHARACTERISTIC C_uint32 "comment" VALUE U32 0 NO_COMPU_METHOD 0 4.29497e+09 PHYS_UNIT "unit" /end TYPEDEF_CHARACTERISTIC
/begin TYPEDEF_CHARACTERISTIC C_uint64 "comment" VALUE U64 0 NO_COMPU_METHOD 0 1.84467e+19 PHYS_UNIT "unit" /end TYPEDEF_CHARACTERISTIC
/begin TYPEDEF_CHARACTERISTIC C_int8 "comment" VALUE I8 0 NO_COMPU_METHOD -128 127 PHYS_UNIT "unit" /end TYPEDEF_CHARACTERISTIC
/begin TYPEDEF_CHARACTERISTIC C_int16 "comment" VALUE I16 0 NO_COMPU_METHOD -32768 32767 PHYS_UNIT "unit" /end TYPEDEF_CHARACTERISTIC
/begin TYPEDEF_CHARACTERISTIC C_int32 "comment" VALUE I32 0 NO_COMPU_METHOD -2.14748e+09 2.14748e+09 PHYS_UNIT "unit" /end TYPEDEF_CHARACTERISTIC
/begin TYPEDEF_CHARACTERISTIC C_int64 "comment" VALUE I64 0 NO_COMPU_METHOD -9.22337e+18 9.22337e+18 PHYS_UNIT "unit" /end TYPEDEF_CHARACTERISTIC
/begin TYPEDEF_CHARACTERISTIC C_float4 "comment" VALUE F32 0 NO_COMPU_METHOD -1000 1000 PHYS_UNIT "unit" /end TYPEDEF_CHARACTERISTIC
/begin TYPEDEF_CHARACTERISTIC C_double8 "comment" VALUE F64 0 NO_COMPU_METHOD -1000 1000 PHYS_UNIT "unit" /end TYPEDEF_CHARACTERISTIC
/begin TYPEDEF_CHARACTERISTIC C_curve1 "comment" CURVE I16 0 NO_COMPU_METHOD -20 20
 /begin AXIS_DESCR FIX_AXIS NO_INPUT_QUANTITY NO_COMPU_METHOD 8 0 7 FIX_AXIS_PAR_DIST 0 1 8 /end AXIS_DESCR
 PHYS_UNIT "unit" /end TYPEDEF_CHARACTERISTIC
/begin TYPEDEF_CHARACTERISTIC C_curve2 "comment" CURVE F64 0 NO_COMPU_METHOD 0 1000
 /begin AXIS_DESCR COM_AXIS NO_INPUT_QUANTITY NO_COMPU_METHOD 8 0.0 0.0 AXIS_PTS_REF THIS.curve2_axis /end AXIS_DESCR
 PHYS_UNIT "unit" /end TYPEDEF_CHARACTERISTIC
/begin TYPEDEF_AXIS A_curve2_axis "comment" NO_INPUT_QUANTITY A_F32 0 NO_COMPU_METHOD 8 0 20 PHYS_UNIT "unit" /end TYPEDEF_AXIS
/begin TYPEDEF_CHARACTERISTIC C_map1 "comment" MAP I8 0 NO_COMPU_METHOD -128 127
 /begin AXIS_DESCR FIX_AXIS NO_INPUT_QUANTITY NO_COMPU_METHOD 8 0 7 FIX_AXIS_PAR_DIST 0 1 8 /end AXIS_DESCR
 /begin AXIS_DESCR FIX_AXIS NO_INPUT_QUANTITY NO_COMPU_METHOD 8 0 7 FIX_AXIS_PAR_DIST 0 1 8 /end AXIS_DESCR
 PHYS_UNIT "" /end TYPEDEF_CHARACTERISTIC
/begin TYPEDEF_CHARACTERISTIC C_map2 "comment" MAP I32 0 NO_COMPU_METHOD -128 127
 /begin AXIS_DESCR COM_AXIS NO_INPUT_QUANTITY NO_COMPU_METHOD 8 0.0 0.0 AXIS_PTS_REF THIS.map2_x_axis /end AXIS_DESCR
 /begin AXIS_DESCR COM_AXIS NO_INPUT_QUANTITY NO_COMPU_METHOD 4 0.0 0.0 AXIS_PTS_REF THIS.map2_y_axis /end AXIS_DESCR
 PHYS_UNIT "" /end TYPEDEF_CHARACTERISTIC
/begin TYPEDEF_AXIS A_map2_x_axis "comment" NO_INPUT_QUANTITY A_I16 0 NO_COMPU_METHOD 8 0 1000 PHYS_UNIT "unit" /end TYPEDEF_AXIS
/begin TYPEDEF_AXIS A_map2_y_axis "comment" NO_INPUT_QUANTITY A_U16 0 NO_COMPU_METHOD 4 0 500 PHYS_UNIT "unit" /end TYPEDEF_AXIS
/begin TYPEDEF_CHARACTERISTIC C_map3 "comment" MAP U64 0 NO_COMPU_METHOD -128 127
 /begin AXIS_DESCR COM_AXIS NO_INPUT_QUANTITY NO_COMPU_METHOD 8 0.0 0.0 AXIS_PTS_REF THIS.map3_x_axis /end AXIS_DESCR
 /begin AXIS_DESCR FIX_AXIS NO_INPUT_QUANTITY NO_COMPU_METHOD 4 0 3 FIX_AXIS_PAR_DIST 0 1 4 /end AXIS_DESCR
 PHYS_UNIT "" /end TYPEDEF_CHARACTERISTIC
/begin TYPEDEF_AXIS A_map3_x_axis "comment" NO_INPUT_QUANTITY A_I64 0 NO_COMPU_METHOD 8 0 1000 PHYS_UNIT "unit" /end TYPEDEF_AXIS
/* Groups */
/begin GROUP CalSeg.segment_1 "Calibration Segment" /begin REF_CHARACTERISTIC params /end REF_CHARACTERISTIC /end GROUP
/begin GROUP CalSeg.segment_2 "Calibration Segment"
 /begin REF_CHARACTERISTIC params.uint8 params.uint16 params.uint32 params.uint64 params.int8 params.int16 params.int32 params.float4 params.double8 params.curve1 params.map1 /end REF_CHARACTERISTIC
/end GROUP
/begin GROUP event "Measurement event group"
 /begin REF_MEASUREMENT uint8 uint16 uint32 uint64 int8 int16 int32 int64 float4 double8 /end REF_MEASUREMENT
/end GROUP
/begin GROUP Events "Events" ROOT /begin SUB_GROUP event /end SUB_GROUP /end GROUP
/* Conversions */
/begin COMPU_METHOD conv.bool "" TAB_VERB "%.0" "" COMPU_TAB_REF conv.bool.table /end COMPU_METHOD
/begin COMPU_VTAB conv.bool.table "" TAB_VERB 2 0 "false" 1 "true" /end COMPU_VTAB
/begin COMPU_METHOD conv.linear_conversion "x*2-50" LINEAR "%6.3" "°C" COEFFS_LINEAR 2 -50 /end COMPU_METHOD
/begin COMPU_METHOD conv.events "" TAB_VERB "%.0 " "" COMPU_TAB_REF conv.events.table /end COMPU_METHOD
/begin COMPU_VTAB conv.events.table "" TAB_VERB 1 0 "event" /end COMPU_VTAB
/begin MOD_PAR "" EPK "_" ADDR_EPK 0x80000000
 /begin MEMORY_SEGMENT epk "" DATA FLASH INTERN 0x80000000 1 -1 -1 -1 -1 -1
  /begin IF_DATA XCP
   /begin SEGMENT 0 2 0 0 0 /begin CHECKSUM XCP_ADD_44 MAX_BLOCK_SIZE 0xFFFF EXTERNAL_FUNCTION "" /end CHECKSUM
    /begin PAGE 0 ECU_ACCESS_DONT_CARE XCP_READ_ACCESS_DONT_CARE XCP_WRITE_ACCESS_DONT_CARE /end PAGE
    /begin PAGE 1 ECU_ACCESS_DONT_CARE XCP_READ_ACCESS_DONT_CARE XCP_WRITE_ACCESS_NOT_ALLOWED /end PAGE
   /end SEGMENT
  /end IF_DATA
 /end MEMORY_SEGMENT
 /begin MEMORY_SEGMENT segment_1 "" DATA FLASH INTERN 0x80010000 0x248 -1 -1 -1 -1 -1
  /begin IF_DATA XCP
   /begin SEGMENT 1 2 0 0 0 /begin CHECKSUM XCP_ADD_44 MAX_BLOCK_SIZE 0xFFFF EXTERNAL_FUNCTION "" /end CHECKSUM
    /begin PAGE 0 ECU_ACCESS_DONT_CARE XCP_READ_ACCESS_DONT_CARE XCP_WRITE_ACCESS_DONT_CARE /end PAGE
    /begin PAGE 1 ECU_ACCESS_DONT_CARE XCP_READ_ACCESS_DONT_CARE XCP_WRITE_ACCESS_NOT_ALLOWED /end PAGE
   /end SEGMENT
  /end IF_DATA
 /end MEMORY_SEGMENT
 /begin MEMORY_SEGMENT segment_2 "" DATA FLASH INTERN 0x80020000 0x248 -1 -1 -1 -1 -1
  /begin IF_DATA XCP
   /begin SEGMENT 2 2 0 0 0 /begin CHECKSUM XCP_ADD_44 MAX_BLOCK_SIZE 0xFFFF EXTERNAL_FUNCTION "" /end CHECKSUM
    /begin PAGE 0 ECU_ACCESS_DONT_CARE XCP_READ_ACCESS_DONT_CARE XCP_WRITE_ACCESS_DONT_CARE /end PAGE
    /begin PAGE 1 ECU_ACCESS_DONT_CARE XCP_READ_ACCESS_DONT_CARE XCP_WRITE_ACCESS_NOT_ALLOWED /end PAGE
   /end SEGMENT
  /end IF_DATA
 /end MEMORY_SEGMENT
/end MOD_PAR
/begin IF_DATA XCP
 /begin PROTOCOL_LAYER 0x104 1000 2000 0 0 0 0 0 248 1024 BYTE_ORDER_MSB_LAST ADDRESS_GRANULARITY_BYTE OPTIONAL_CMD GET_COMM_MODE_INFO OPTIONAL_CMD GET_ID OPTIONAL_CMD SET_REQUEST OPTIONAL_CMD SET_MTA OPTIONAL_CMD UPLOAD OPTIONAL_CMD SHORT_UPLOAD OPTIONAL_CMD DOWNLOAD OPTIONAL_CMD SHORT_DOWNLOAD OPTIONAL_CMD GET_CAL_PAGE OPTIONAL_CMD SET_CAL_PAGE OPTIONAL_CMD COPY_CAL_PAGE OPTIONAL_CMD GET_PAG_PROCESSOR_INFO OPTIONAL_CMD GET_SEGMENT_MODE OPTIONAL_CMD SET_SEGMENT_MODE OPTIONAL_CMD BUILD_CHECKSUM OPTIONAL_CMD USER_CMD OPTIONAL_CMD GET_DAQ_RESOLUTION_INFO OPTIONAL_CMD GET_DAQ_PROCESSOR_INFO OPTIONAL_CMD FREE_DAQ OPTIONAL_CMD ALLOC_DAQ OPTIONAL_CMD ALLOC_ODT OPTIONAL_CMD ALLOC_ODT_ENTRY OPTIONAL_CMD SET_DAQ_PTR OPTIONAL_CMD WRITE_DAQ OPTIONAL_CMD GET_DAQ_LIST_MODE OPTIONAL_CMD SET_DAQ_LIST_MODE OPTIONAL_CMD START_STOP_SYNCH OPTIONAL_CMD START_STOP_DAQ_LIST OPTIONAL_CMD GET_DAQ_CLOCK OPTIONAL_CMD WRITE_DAQ_MULTIPLE OPTIONAL_CMD TIME_CORRELATION_PROPERTIES OPTIONAL_LEVEL1_CMD GET_VERSION /end PROTOCOL_LAYER
 /begin DAQ DYNAMIC 0 1 0 OPTIMISATION_TYPE_DEFAULT ADDRESS_EXTENSION_FREE IDENTIFICATION_FIELD_TYPE_RELATIVE_BYTE GRANULARITY_ODT_ENTRY_SIZE_DAQ_BYTE 0xF8 OVERLOAD_INDICATION_PID /begin TIMESTAMP_SUPPORTED 0x1 SIZE_DWORD UNIT_1NS TIMESTAMP_FIXED /end TIMESTAMP_SUPPORTED /begin EVENT "event" "event" 0x0 DAQ 0xFF 0 0 0 CONSISTENCY EVENT /end EVENT /end DAQ
 /begin XCP_ON_UDP_IP 0x104 5555 ADDRESS "127.0.0.1" /end XCP_ON_UDP_IP
/end IF_DATA
/end MODULE
/end PROJECT
