ASAP2_VERSION 1 71
/begin PROJECT XCPlite ""
/begin HEADER "" VERSION "1.0" /end HEADER
/begin MODULE XCPlite ""
/include "XCP_104.aml"
/begin MOD_PAR ""
 /begin MEMORY_SEGMENT CALRAM "" DATA FLASH INTERN 0x9B63F580 0x00000100 - 1 - 1 - 1 - 1 - 1
  /begin IF_DATA XCP
   /begin SEGMENT 0x01 0x02 0x00 0x00 0x00 /begin CHECKSUM XCP_ADD_44 MAX_BLOCK_SIZE 0xFFFF EXTERNAL_FUNCTION "" /end CHECKSUM
    /begin PAGE 0x01 ECU_ACCESS_WITH_XCP_ONLY XCP_READ_ACCESS_WITH_ECU_ONLY XCP_WRITE_ACCESS_NOT_ALLOWED /end PAGE
    /begin PAGE 0x00 ECU_ACCESS_WITH_XCP_ONLY XCP_READ_ACCESS_WITH_ECU_ONLY XCP_WRITE_ACCESS_WITH_ECU_ONLY /end PAGE
   /end SEGMENT
  /end IF_DATA
 /end MEMORY_SEGMENT
/end MOD_PAR
/begin MOD_COMMON "" BYTE_ORDER MSB_LAST ALIGNMENT_BYTE 1 ALIGNMENT_WORD 1 ALIGNMENT_LONG 1 ALIGNMENT_FLOAT16_IEEE 1 ALIGNMENT_FLOAT32_IEEE 1 ALIGNMENT_FLOAT64_IEEE 1 ALIGNMENT_INT64 1 /end MOD_COMMON
/begin IF_DATA XCP
 /begin PROTOCOL_LAYER 0x0104 1000 2000 0 0 0 0 0 250 1396 BYTE_ORDER_MSB_LAST ADDRESS_GRANULARITY_BYTE OPTIONAL_CMD GET_COMM_MODE_INFO OPTIONAL_CMD GET_ID OPTIONAL_CMD SET_MTA OPTIONAL_CMD UPLOAD OPTIONAL_CMD SHORT_UPLOAD OPTIONAL_CMD DOWNLOAD OPTIONAL_CMD SHORT_DOWNLOAD OPTIONAL_CMD GET_CAL_PAGE OPTIONAL_CMD SET_CAL_PAGE OPTIONAL_CMD BUILD_CHECKSUM OPTIONAL_CMD GET_DAQ_RESOLUTION_INFO OPTIONAL_CMD GET_DAQ_PROCESSOR_INFO OPTIONAL_CMD FREE_DAQ OPTIONAL_CMD ALLOC_DAQ OPTIONAL_CMD ALLOC_ODT OPTIONAL_CMD ALLOC_ODT_ENTRY OPTIONAL_CMD SET_DAQ_PTR OPTIONAL_CMD WRITE_DAQ OPTIONAL_CMD GET_DAQ_LIST_MODE OPTIONAL_CMD SET_DAQ_LIST_MODE OPTIONAL_CMD START_STOP_SYNCH OPTIONAL_CMD START_STOP_DAQ_LIST OPTIONAL_CMD GET_DAQ_CLOCK OPTIONAL_CMD WRITE_DAQ_MULTIPLE OPTIONAL_CMD TIME_CORRELATION_PROPERTIES OPTIONAL_LEVEL1_CMD GET_VERSION /end PROTOCOL_LAYER
 /begin DAQ DYNAMIC 0 4 0 OPTIMISATION_TYPE_DEFAULT ADDRESS_EXTENSION_FREE IDENTIFICATION_FIELD_TYPE_RELATIVE_BYTE GRANULARITY_ODT_ENTRY_SIZE_DAQ_BYTE 0xF8 OVERLOAD_INDICATION_PID /begin TIMESTAMP_SUPPORTED 0x01 SIZE_DWORD UNIT_1US TIMESTAMP_FIXED /end TIMESTAMP_SUPPORTED
  /begin EVENT "Cyclic" "Cyclic" 0x0 DAQ 0xFF 0xC8 0x4 0x00 CONSISTENCY DAQ /end EVENT
  /begin EVENT "Task1" "Task1" 0x1 DAQ 0xFF 0xC8 0x4 0x00 CONSISTENCY DAQ /end EVENT
  /begin EVENT "Task2" "Task2" 0x2 DAQ 0xFF 0xC8 0x4 0x00 CONSISTENCY DAQ /end EVENT
  /begin EVENT "TaskAct" "TaskAct" 0x3 DAQ 0xFF 0x0 0x3 0x00 CONSISTENCY DAQ /end EVENT
 /end DAQ
 /begin XCP_ON_UDP_IP 0x0104 5555 ADDRESS "127.0.0.1" /end XCP_ON_UDP_IP
/end IF_DATA
/begin CHARACTERISTIC ecuPar.CALRAM_SIZE "ECU CALRAM size" VALUE 0x9B63F580 _ULONG 0 NO_COMPU_METHOD 0 4294967295 PHYS_UNIT "" /end CHARACTERISTIC
/begin CHARACTERISTIC ecuPar.ampl1 "Amplitude" VALUE 0x9B63F5F0 _FLOAT64_IEEE 0 NO_COMPU_METHOD 0 800 PHYS_UNIT "V" /end CHARACTERISTIC
/begin CHARACTERISTIC ecuPar.offset1 "Offset" VALUE 0x9B63F590 _FLOAT64_IEEE 0 NO_COMPU_METHOD -200 200 PHYS_UNIT "V" /end CHARACTERISTIC
/begin CHARACTERISTIC ecuPar.phase1 "Phase" VALUE 0x9B63F5C0 _FLOAT64_IEEE 0 NO_COMPU_METHOD 0 6.28319 PHYS_UNIT "" /end CHARACTERISTIC
/begin CHARACTERISTIC ecuPar.ampl2 "Amplitude" VALUE 0x9B63F5F8 _FLOAT64_IEEE 0 NO_COMPU_METHOD 0 800 PHYS_UNIT "V" /end CHARACTERISTIC
/begin CHARACTERISTIC ecuPar.offset2 "Offset" VALUE 0x9B63F598 _FLOAT64_IEEE 0 NO_COMPU_METHOD -200 200 PHYS_UNIT "V" /end CHARACTERISTIC
/begin CHARACTERISTIC ecuPar.phase2 "Phase" VALUE 0x9B63F5C8 _FLOAT64_IEEE 0 NO_COMPU_METHOD 0 6.28319 PHYS_UNIT "" /end CHARACTERISTIC
/begin CHARACTERISTIC ecuPar.ampl3 "Amplitude" VALUE 0x9B63F600 _FLOAT64_IEEE 0 NO_COMPU_METHOD 0 800 PHYS_UNIT "V" /end CHARACTERISTIC
/begin CHARACTERISTIC ecuPar.offset3 "Offset" VALUE 0x9B63F5A0 _FLOAT64_IEEE 0 NO_COMPU_METHOD -200 200 PHYS_UNIT "V" /end CHARACTERISTIC
/begin CHARACTERISTIC ecuPar.phase3 "Phase" VALUE 0x9B63F5D0 _FLOAT64_IEEE 0 NO_COMPU_METHOD 0 6.28319 PHYS_UNIT "" /end CHARACTERISTIC
/begin CHARACTERISTIC ecuPar.ampl4 "Amplitude" VALUE 0x9B63F608 _FLOAT64_IEEE 0 NO_COMPU_METHOD 0 800 PHYS_UNIT "A" /end CHARACTERISTIC
/begin CHARACTERISTIC ecuPar.offset4 "Offset" VALUE 0x9B63F5A8 _FLOAT64_IEEE 0 NO_COMPU_METHOD -200 200 PHYS_UNIT "A" /end CHARACTERISTIC
/begin CHARACTERISTIC ecuPar.phase4 "Phase" VALUE 0x9B63F5D8 _FLOAT64_IEEE 0 NO_COMPU_METHOD 0 6.28319 PHYS_UNIT "" /end CHARACTERISTIC
/begin CHARACTERISTIC ecuPar.ampl5 "Amplitude" VALUE 0x9B63F610 _FLOAT64_IEEE 0 NO_COMPU_METHOD 0 800 PHYS_UNIT "A" /end CHARACTERISTIC
/begin CHARACTERISTIC ecuPar.offset5 "Offset" VALUE 0x9B63F5B0 _FLOAT64_IEEE 0 NO_COMPU_METHOD -200 200 PHYS_UNIT "A" /end CHARACTERISTIC
/begin CHARACTERISTIC ecuPar.phase5 "Phase" VALUE 0x9B63F5E0 _FLOAT64_IEEE 0 NO_COMPU_METHOD 0 6.28319 PHYS_UNIT "" /end CHARACTERISTIC
/begin CHARACTERISTIC ecuPar.ampl6 "Amplitude" VALUE 0x9B63F618 _FLOAT64_IEEE 0 NO_COMPU_METHOD 0 800 PHYS_UNIT "A" /end CHARACTERISTIC
/begin CHARACTERISTIC ecuPar.offset6 "Offset" VALUE 0x9B63F5B8 _FLOAT64_IEEE 0 NO_COMPU_METHOD -200 200 PHYS_UNIT "A" /end CHARACTERISTIC
/begin CHARACTERISTIC ecuPar.phase6 "Phase" VALUE 0x9B63F5E8 _FLOAT64_IEEE 0 NO_COMPU_METHOD 0 6.28319 PHYS_UNIT "" /end CHARACTERISTIC
/begin CHARACTERISTIC ecuPar.period "Period" VALUE 0x9B63F588 _FLOAT64_IEEE 0 NO_COMPU_METHOD 0 10 PHYS_UNIT "s" /end CHARACTERISTIC
/begin CHARACTERISTIC ecuPar.map1_8_8 "8*8 byte calibration array" MAP 0x9B63F620 _UBYTE 0 NO_COMPU_METHOD 0 255
 /begin AXIS_DESCR FIX_AXIS NO_INPUT_QUANTITY NO_COMPU_METHOD 8 0 7 FIX_AXIS_PAR_DIST 0 1 8 /end AXIS_DESCR
 /begin AXIS_DESCR FIX_AXIS NO_INPUT_QUANTITY NO_COMPU_METHOD 8 0 7 FIX_AXIS_PAR_DIST 0 1 8 /end AXIS_DESCR
 PHYS_UNIT "" CHARACTERISTIC ecuPar.curve1_32 "32 byte calibration array" MAP 0x9B63F660 _UBYTE 0 NO_COMPU_METHOD 0 255
 /begin AXIS_DESCR FIX_AXIS NO_INPUT_QUANTITY NO_COMPU_METHOD 32 0 31 FIX_AXIS_PAR_DIST 0 1 32 /end AXIS_DESCR
 /begin AXIS_DESCR FIX_AXIS NO_INPUT_QUANTITY NO_COMPU_METHOD 1 0 0 FIX_AXIS_PAR_DIST 0 1 1 /end AXIS_DESCR
 PHYS_UNIT "" CHARACTERISTIC ecuPar.cycleTime "ECU task cycle time" VALUE 0x9B63F584 _ULONG 0 NO_COMPU_METHOD 50 1e+06 PHYS_UNIT "us" /end CHARACTERISTIC
/begin GROUP ecuPar ""
 /begin REF_CHARACTERISTIC ecuPar.CALRAM_SIZE ecuPar.cycleTime ecuPar.map1_8_8 ecuPar.curve1_32 ecuPar.period ecuPar.ampl1 ecuPar.offset1 ecuPar.phase1 ecuPar.ampl2 ecuPar.offset2 ecuPar.phase2 ecuPar.ampl3 ecuPar.offset3 ecuPar.phase3 ecuPar.ampl4 ecuPar.offset4 ecuPar.phase4 ecuPar.ampl5 ecuPar.offset5 ecuPar.phase5 ecuPar.ampl6 ecuPar.offset6 ecuPar.phase6 /end REF_CHARACTERISTIC
/end GROUP
/begin COMPU_METHOD ecuCounter_COMPU_METHOD "" LINEAR "%6.3" "" COEFFS_LINEAR 1 0 /end COMPU_METHOD
/begin MEASUREMENT ecuCounter "" UWORD ecuCounter_COMPU_METHOD 0 0 0 65535 ECU_ADDRESS 0x9ACC6918
 /begin IF_DATA XCP
  /begin DAQ_EVENT FIXED_EVENT_LIST EVENT 0x0 /end DAQ_EVENT
 /end IF_DATA
/end MEASUREMENT
/begin COMPU_METHOD channel1_COMPU_METHOD "" LINEAR "%6.3" "" COEFFS_LINEAR 1 0 /end COMPU_METHOD
/begin MEASUREMENT channel1 "Demo signal 1" FLOAT64_IEEE channel1_COMPU_METHOD 0 0 0 1E12 ECU_ADDRESS 0x9B63F568
 /begin IF_DATA XCP
  /begin DAQ_EVENT FIXED_EVENT_LIST EVENT 0x0 /end DAQ_EVENT
 /end IF_DATA
/end MEASUREMENT
/begin COMPU_METHOD channel2_COMPU_METHOD "" LINEAR "%6.3" "" COEFFS_LINEAR 1 0 /end COMPU_METHOD
/begin MEASUREMENT channel2 "Demo signal 2" FLOAT64_IEEE channel2_COMPU_METHOD 0 0 0 1E12 ECU_ADDRESS 0x9B63F560
 /begin IF_DATA XCP
  /begin DAQ_EVENT FIXED_EVENT_LIST EVENT 0x0 /end DAQ_EVENT
 /end IF_DATA
/end MEASUREMENT
/begin COMPU_METHOD channel3_COMPU_METHOD "" LINEAR "%6.3" "" COEFFS_LINEAR 1 0 /end COMPU_METHOD
/begin MEASUREMENT channel3 "Demo signal 3" FLOAT64_IEEE channel3_COMPU_METHOD 0 0 0 1E12 ECU_ADDRESS 0x9B63F558
 /begin IF_DATA XCP
  /begin DAQ_EVENT FIXED_EVENT_LIST EVENT 0x0 /end DAQ_EVENT
 /end IF_DATA
/end MEASUREMENT
/begin COMPU_METHOD channel4_COMPU_METHOD "" LINEAR "%6.3" "" COEFFS_LINEAR 1 0 /end COMPU_METHOD
/begin MEASUREMENT channel4 "Demo signal 4" FLOAT64_IEEE channel4_COMPU_METHOD 0 0 0 1E12 ECU_ADDRESS 0x9B63F550
 /begin IF_DATA XCP
  /begin DAQ_EVENT FIXED_EVENT_LIST EVENT 0x0 /end DAQ_EVENT
 /end IF_DATA
/end MEASUREMENT
/begin COMPU_METHOD channel5_COMPU_METHOD "" LINEAR "%6.3" "" COEFFS_LINEAR 1 0 /end COMPU_METHOD
/begin MEASUREMENT channel5 "Demo signal 5" FLOAT64_IEEE channel5_COMPU_METHOD 0 0 0 1E12 ECU_ADDRESS 0x9B63F548
 /begin IF_DATA XCP
  /begin DAQ_EVENT FIXED_EVENT_LIST EVENT 0x0 /end DAQ_EVENT
 /end IF_DATA
/end MEASUREMENT
/begin COMPU_METHOD channel6_COMPU_METHOD "" LINEAR "%6.3" "" COEFFS_LINEAR 1 0 /end COMPU_METHOD
/begin MEASUREMENT channel6 "Demo signal 6" FLOAT64_IEEE channel6_COMPU_METHOD 0 0 0 1E12 ECU_ADDRESS 0x9B63F540
 /begin IF_DATA XCP
  /begin DAQ_EVENT FIXED_EVENT_LIST EVENT 0x0 /end DAQ_EVENT
 /end IF_DATA
/end MEASUREMENT
/begin COMPU_METHOD byteCounter_COMPU_METHOD "" LINEAR "%6.3" "" COEFFS_LINEAR 1 0 /end COMPU_METHOD
/begin MEASUREMENT byteCounter "" UBYTE byteCounter_COMPU_METHOD 0 0 0 255 ECU_ADDRESS 0x9B62B53E
 /begin IF_DATA XCP
  /begin DAQ_EVENT FIXED_EVENT_LIST EVENT 0x0 /end DAQ_EVENT
 /end IF_DATA
/end MEASUREMENT
/begin COMPU_METHOD wordCounter_COMPU_METHOD "" LINEAR "%6.3" "" COEFFS_LINEAR 1 0 /end COMPU_METHOD
/begin MEASUREMENT wordCounter "" UWORD wordCounter_COMPU_METHOD 0 0 0 65535 ECU_ADDRESS 0x9B62B53C
 /begin IF_DATA XCP
  /begin DAQ_EVENT FIXED_EVENT_LIST EVENT 0x0 /end DAQ_EVENT
 /end IF_DATA
/end MEASUREMENT
/begin COMPU_METHOD dwordCounter_COMPU_METHOD "" LINEAR "%6.3" "" COEFFS_LINEAR 1 0 /end COMPU_METHOD
/begin MEASUREMENT dwordCounter "" ULONG dwordCounter_COMPU_METHOD 0 0 0 4294967295 ECU_ADDRESS 0x9B62B538
 /begin IF_DATA XCP
  /begin DAQ_EVENT FIXED_EVENT_LIST EVENT 0x0 /end DAQ_EVENT
 /end IF_DATA
/end MEASUREMENT
/begin COMPU_METHOD sbyteCounter_COMPU_METHOD "" LINEAR "%6.3" "" COEFFS_LINEAR 1 0 /end COMPU_METHOD
/begin MEASUREMENT sbyteCounter "" SBYTE sbyteCounter_COMPU_METHOD 0 0 -128 127 ECU_ADDRESS 0x9B62B536
 /begin IF_DATA XCP
  /begin DAQ_EVENT FIXED_EVENT_LIST EVENT 0x0 /end DAQ_EVENT
 /end IF_DATA
/end MEASUREMENT
/begin COMPU_METHOD swordCounter_COMPU_METHOD "" LINEAR "%6.3" "" COEFFS_LINEAR 1 0 /end COMPU_METHOD
/begin MEASUREMENT swordCounter "" SWORD swordCounter_COMPU_METHOD 0 0 -32768 32767 ECU_ADDRESS 0x9B62B534
 /begin IF_DATA XCP
  /begin DAQ_EVENT FIXED_EVENT_LIST EVENT 0x0 /end DAQ_EVENT
 /end IF_DATA
/end MEASUREMENT
/begin COMPU_METHOD sdwordCounter_COMPU_METHOD "" LINEAR "%6.3" "" COEFFS_LINEAR 1 0 /end COMPU_METHOD
/begin MEASUREMENT sdwordCounter "" SLONG sdwordCounter_COMPU_METHOD 0 0 -2147483648 2147483647 ECU_ADDRESS 0x9B6274E8
 /begin IF_DATA XCP
  /begin DAQ_EVENT FIXED_EVENT_LIST EVENT 0x0 /end DAQ_EVENT
 /end IF_DATA
/end MEASUREMENT
/begin GROUP EcuTaskSignals ""
 /begin REF_MEASUREMENT ecuCounter channel1 channel2 channel3 channel4 channel5 channel6 byteCounter wordCounter dwordCounter sbyteCounter swordCounter sdwordCounter /end REF_MEASUREMENT
/end GROUP
/begin CHARACTERISTIC byteArray1 "" VAL_BLK 0x9B63F140 _UBYTE 0 NO_COMPU_METHOD 0 255 MATRIX_DIM 1024
 /begin IF_DATA XCP
  /begin DAQ_EVENT FIXED_EVENT_LIST EVENT 0x0 /end DAQ_EVENT
 /end IF_DATA
/end CHARACTERISTIC
/begin CHARACTERISTIC byteArray2 "" VAL_BLK 0x9B63ED40 _UBYTE 0 NO_COMPU_METHOD 0 255 MATRIX_DIM 1024
 /begin IF_DATA XCP
  /begin DAQ_EVENT FIXED_EVENT_LIST EVENT 0x0 /end DAQ_EVENT
 /end IF_DATA
/end CHARACTERISTIC
/begin CHARACTERISTIC byteArray3 "" VAL_BLK 0x9B63E940 _UBYTE 0 NO_COMPU_METHOD 0 255 MATRIX_DIM 1024
 /begin IF_DATA XCP
  /begin DAQ_EVENT FIXED_EVENT_LIST EVENT 0x0 /end DAQ_EVENT
 /end IF_DATA
/end CHARACTERISTIC
/begin CHARACTERISTIC byteArray4 "" VAL_BLK 0x9B63E540 _UBYTE 0 NO_COMPU_METHOD 0 255 MATRIX_DIM 1024
 /begin IF_DATA XCP
  /begin DAQ_EVENT FIXED_EVENT_LIST EVENT 0x0 /end DAQ_EVENT
 /end IF_DATA
/end CHARACTERISTIC
/begin CHARACTERISTIC byteArray5 "" VAL_BLK 0x9B63E140 _UBYTE 0 NO_COMPU_METHOD 0 255 MATRIX_DIM 1024
 /begin IF_DATA XCP
  /begin DAQ_EVENT FIXED_EVENT_LIST EVENT 0x0 /end DAQ_EVENT
 /end IF_DATA
/end CHARACTERISTIC
/begin CHARACTERISTIC byteArray6 "" VAL_BLK 0x9B63DD40 _UBYTE 0 NO_COMPU_METHOD 0 255 MATRIX_DIM 1024
 /begin IF_DATA XCP
  /begin DAQ_EVENT FIXED_EVENT_LIST EVENT 0x0 /end DAQ_EVENT
 /end IF_DATA
/end CHARACTERISTIC
/begin CHARACTERISTIC byteArray7 "" VAL_BLK 0x9B63D940 _UBYTE 0 NO_COMPU_METHOD 0 255 MATRIX_DIM 1024
 /begin IF_DATA XCP
  /begin DAQ_EVENT FIXED_EVENT_LIST EVENT 0x0 /end DAQ_EVENT
 /end IF_DATA
/end CHARACTERISTIC
/begin CHARACTERISTIC byteArray8 "" VAL_BLK 0x9B63D540 _UBYTE 0 NO_COMPU_METHOD 0 255 MATRIX_DIM 1024
 /begin IF_DATA XCP
  /begin DAQ_EVENT FIXED_EVENT_LIST EVENT 0x0 /end DAQ_EVENT
 /end IF_DATA
/end CHARACTERISTIC
/begin CHARACTERISTIC byteArray9 "" VAL_BLK 0x9B63D140 _UBYTE 0 NO_COMPU_METHOD 0 255 MATRIX_DIM 1024
 /begin IF_DATA XCP
  /begin DAQ_EVENT FIXED_EVENT_LIST EVENT 0x0 /end DAQ_EVENT
 /end IF_DATA
/end CHARACTERISTIC
/begin CHARACTERISTIC byteArray10 "" VAL_BLK 0x9B63CD40 _UBYTE 0 NO_COMPU_METHOD 0 255 MATRIX_DIM 1024
 /begin IF_DATA XCP
  /begin DAQ_EVENT FIXED_EVENT_LIST EVENT 0x0 /end DAQ_EVENT
 /end IF_DATA
/end CHARACTERISTIC
/begin CHARACTERISTIC byteArray11 "" VAL_BLK 0x9B63C940 _UBYTE 0 NO_COMPU_METHOD 0 255 MATRIX_DIM 1024
 /begin IF_DATA XCP
  /begin DAQ_EVENT FIXED_EVENT_LIST EVENT 0x0 /end DAQ_EVENT
 /end IF_DATA
/end CHARACTERISTIC
/begin CHARACTERISTIC byteArray12 "" VAL_BLK 0x9B63C540 _UBYTE 0 NO_COMPU_METHOD 0 255 MATRIX_DIM 1024
 /begin IF_DATA XCP
  /begin DAQ_EVENT FIXED_EVENT_LIST EVENT 0x0 /end DAQ_EVENT
 /end IF_DATA
/end CHARACTERISTIC
/begin CHARACTERISTIC byteArray13 "" VAL_BLK 0x9B63C140 _UBYTE 0 NO_COMPU_METHOD 0 255 MATRIX_DIM 1024
 /begin IF_DATA XCP
  /begin DAQ_EVENT FIXED_EVENT_LIST EVENT 0x0 /end DAQ_EVENT
 /end IF_DATA
/end CHARACTERISTIC
/begin CHARACTERISTIC byteArray14 "" VAL_BLK 0x9B63BD40 _UBYTE 0 NO_COMPU_METHOD 0 255 MATRIX_DIM 1024
 /begin IF_DATA XCP
  /begin DAQ_EVENT FIXED_EVENT_LIST EVENT 0x0 /end DAQ_EVENT
 /end IF_DATA
/end CHARACTERISTIC
/begin CHARACTERISTIC byteArray15 "" VAL_BLK 0x9B63B940 _UBYTE 0 NO_COMPU_METHOD 0 255 MATRIX_DIM 1024
 /begin IF_DATA XCP
  /begin DAQ_EVENT FIXED_EVENT_LIST EVENT 0x0 /end DAQ_EVENT
 /end IF_DATA
/end CHARACTERISTIC
/begin CHARACTERISTIC byteArray16 "" VAL_BLK 0x9B63B540 _UBYTE 0 NO_COMPU_METHOD 0 255 MATRIX_DIM 1024
 /begin IF_DATA XCP
  /begin DAQ_EVENT FIXED_EVENT_LIST EVENT 0x0 /end DAQ_EVENT
 /end IF_DATA
/end CHARACTERISTIC
/begin CHARACTERISTIC longArray1 "" VAL_BLK 0x9B63A540 _ULONG 0 NO_COMPU_METHOD 0 4294967295 MATRIX_DIM 1024
 /begin IF_DATA XCP
  /begin DAQ_EVENT FIXED_EVENT_LIST EVENT 0x0 /end DAQ_EVENT
 /end IF_DATA
/end CHARACTERISTIC
/begin CHARACTERISTIC longArray2 "" VAL_BLK 0x9B639540 _ULONG 0 NO_COMPU_METHOD 0 4294967295 MATRIX_DIM 1024
 /begin IF_DATA XCP
  /begin DAQ_EVENT FIXED_EVENT_LIST EVENT 0x0 /end DAQ_EVENT
 /end IF_DATA
/end CHARACTERISTIC
/begin CHARACTERISTIC longArray3 "" VAL_BLK 0x9B638540 _ULONG 0 NO_COMPU_METHOD 0 4294967295 MATRIX_DIM 1024
 /begin IF_DATA XCP
  /begin DAQ_EVENT FIXED_EVENT_LIST EVENT 0x0 /end DAQ_EVENT
 /end IF_DATA
/end CHARACTERISTIC
/begin CHARACTERISTIC longArray4 "" VAL_BLK 0x9B637540 _ULONG 0 NO_COMPU_METHOD 0 4294967295 MATRIX_DIM 1024
 /begin IF_DATA XCP
  /begin DAQ_EVENT FIXED_EVENT_LIST EVENT 0x0 /end DAQ_EVENT
 /end IF_DATA
/end CHARACTERISTIC
/begin CHARACTERISTIC longArray5 "" VAL_BLK 0x9B636540 _ULONG 0 NO_COMPU_METHOD 0 4294967295 MATRIX_DIM 1024
 /begin IF_DATA XCP
  /begin DAQ_EVENT FIXED_EVENT_LIST EVENT 0x0 /end DAQ_EVENT
 /end IF_DATA
/end CHARACTERISTIC
/begin CHARACTERISTIC longArray6 "" VAL_BLK 0x9B635540 _ULONG 0 NO_COMPU_METHOD 0 4294967295 MATRIX_DIM 1024
 /begin IF_DATA XCP
  /begin DAQ_EVENT FIXED_EVENT_LIST EVENT 0x0 /end DAQ_EVENT
 /end IF_DATA
/end CHARACTERISTIC
/begin CHARACTERISTIC longArray7 "" VAL_BLK 0x9B634540 _ULONG 0 NO_COMPU_METHOD 0 4294967295 MATRIX_DIM 1024
 /begin IF_DATA XCP
  /begin DAQ_EVENT FIXED_EVENT_LIST EVENT 0x0 /end DAQ_EVENT
 /end IF_DATA
/end CHARACTERISTIC
/begin CHARACTERISTIC longArray8 "" VAL_BLK 0x9B633540 _ULONG 0 NO_COMPU_METHOD 0 4294967295 MATRIX_DIM 1024
 /begin IF_DATA XCP
  /begin DAQ_EVENT FIXED_EVENT_LIST EVENT 0x0 /end DAQ_EVENT
 /end IF_DATA
/end CHARACTERISTIC
/begin CHARACTERISTIC longArray9 "" VAL_BLK 0x9B632540 _ULONG 0 NO_COMPU_METHOD 0 4294967295 MATRIX_DIM 1024
 /begin IF_DATA XCP
  /begin DAQ_EVENT FIXED_EVENT_LIST EVENT 0x0 /end DAQ_EVENT
 /end IF_DATA
/end CHARACTERISTIC
/begin CHARACTERISTIC longArray10 "" VAL_BLK 0x9B631540 _ULONG 0 NO_COMPU_METHOD 0 4294967295 MATRIX_DIM 1024
 /begin IF_DATA XCP
  /begin DAQ_EVENT FIXED_EVENT_LIST EVENT 0x0 /end DAQ_EVENT
 /end IF_DATA
/end CHARACTERISTIC
/begin CHARACTERISTIC longArray11 "" VAL_BLK 0x9B630540 _ULONG 0 NO_COMPU_METHOD 0 4294967295 MATRIX_DIM 1024
 /begin IF_DATA XCP
  /begin DAQ_EVENT FIXED_EVENT_LIST EVENT 0x0 /end DAQ_EVENT
 /end IF_DATA
/end CHARACTERISTIC
/begin CHARACTERISTIC longArray12 "" VAL_BLK 0x9B62F540 _ULONG 0 NO_COMPU_METHOD 0 4294967295 MATRIX_DIM 1024
 /begin IF_DATA XCP
  /begin DAQ_EVENT FIXED_EVENT_LIST EVENT 0x0 /end DAQ_EVENT
 /end IF_DATA
/end CHARACTERISTIC
/begin CHARACTERISTIC longArray13 "" VAL_BLK 0x9B62E540 _ULONG 0 NO_COMPU_METHOD 0 4294967295 MATRIX_DIM 1024
 /begin IF_DATA XCP
  /begin DAQ_EVENT FIXED_EVENT_LIST EVENT 0x0 /end DAQ_EVENT
 /end IF_DATA
/end CHARACTERISTIC
/begin CHARACTERISTIC longArray14 "" VAL_BLK 0x9B62D540 _ULONG 0 NO_COMPU_METHOD 0 4294967295 MATRIX_DIM 1024
 /begin IF_DATA XCP
  /begin DAQ_EVENT FIXED_EVENT_LIST EVENT 0x0 /end DAQ_EVENT
 /end IF_DATA
/end CHARACTERISTIC
/begin CHARACTERISTIC longArray15 "" VAL_BLK 0x9B62C540 _ULONG 0 NO_COMPU_METHOD 0 4294967295 MATRIX_DIM 1024
 /begin IF_DATA XCP
  /begin DAQ_EVENT FIXED_EVENT_LIST EVENT 0x0 /end DAQ_EVENT
 /end IF_DATA
/end CHARACTERISTIC
/begin CHARACTERISTIC longArray16 "" VAL_BLK 0x9B62B540 _ULONG 0 NO_COMPU_METHOD 0 4294967295 MATRIX_DIM 1024
 /begin IF_DATA XCP
  /begin DAQ_EVENT FIXED_EVENT_LIST EVENT 0x0 /end DAQ_EVENT
 /end IF_DATA
/end CHARACTERISTIC
/begin GROUP Arrays ""
 /begin REF_CHARACTERISTIC byteArray1 byteArray2 byteArray3 byteArray4 byteArray5 byteArray6 byteArray7 byteArray8 byteArray9 byteArray10 byteArray11 byteArray12 byteArray13 byteArray14 byteArray15 byteArray16 longArray1 longArray2 longArray3 longArray4 longArray5 longArray6 longArray7 longArray8 longArray9 longArray10 longArray11 longArray12 longArray13 longArray14 longArray15 longArray16 /end REF_CHARACTERISTIC
/end GROUP
/begin TYPEDEF_STRUCTURE EcuTask "TYPEDEF for class EcuTask" 0x58 SYMBOL_TYPE_LINK "EcuTask" /begin STRUCTURE_COMPONENT taskId _UWORD 0x0 SYMBOL_TYPE_LINK "taskId" /end STRUCTURE_COMPONENT /begin STRUCTURE_COMPONENT counter _UWORD 0x2 SYMBOL_TYPE_LINK "counter" /end STRUCTURE_COMPONENT /begin STRUCTURE_COMPONENT channel1 _FLOAT64_IEEE 0x10 SYMBOL_TYPE_LINK "channel1" /end STRUCTURE_COMPONENT /begin STRUCTURE_COMPONENT byte _UBYTE 0x38 SYMBOL_TYPE_LINK "byte" /end STRUCTURE_COMPONENT /begin STRUCTURE_COMPONENT word _UWORD 0x3A SYMBOL_TYPE_LINK "word" /end STRUCTURE_COMPONENT /begin STRUCTURE_COMPONENT dword _ULONG 0x3C SYMBOL_TYPE_LINK "dword" /end STRUCTURE_COMPONENT /end TYPEDEF_STRUCTURE
/begin INSTANCE ecuTask1 "ecu task 1" EcuTask 0x0
 /begin IF_DATA XCP
  /begin DAQ_EVENT FIXED_EVENT_LIST EVENT 0x1 /end DAQ_EVENT
 /end IF_DATA
/end INSTANCE
/begin INSTANCE ecuTask2 "ecu task 2" EcuTask 0x0
 /begin IF_DATA XCP
  /begin DAQ_EVENT FIXED_EVENT_LIST EVENT 0x2 /end DAQ_EVENT
 /end IF_DATA
/end INSTANCE
/begin INSTANCE activeEcuTask "" EcuTask 0x0
 /begin IF_DATA XCP
  /begin DAQ_EVENT FIXED_EVENT_LIST EVENT 0x3 /end DAQ_EVENT
 /end IF_DATA
/end INSTANCE
/begin CHARACTERISTIC gActiveEcuTaskId "Active ecu task object id" VALUE 0x9ACC6044 _ULONG 0 NO_COMPU_METHOD 1 2 PHYS_UNIT "" /end CHARACTERISTIC
/begin CHARACTERISTIC gDebugLevel "Console output verbosity" VALUE 0x9ACC6060 _ULONG 0 NO_COMPU_METHOD 0 4 PHYS_UNIT "" /end CHARACTERISTIC
/begin CHARACTERISTIC gFlushCycleMs "DAQ flush cycle time, 0 = off" VALUE 0x9ACC65A4 _ULONG 0 NO_COMPU_METHOD 0 1000 PHYS_UNIT "" /end CHARACTERISTIC
/begin RECORD_LAYOUT _SLONG FNC_VALUES 1 SLONG ROW_DIR DIRECT /end RECORD_LAYOUT
/begin RECORD_LAYOUT _SWORD FNC_VALUES 1 SWORD ROW_DIR DIRECT /end RECORD_LAYOUT
/begin RECORD_LAYOUT _SBYTE FNC_VALUES 1 SBYTE ROW_DIR DIRECT /end RECORD_LAYOUT
/begin RECORD_LAYOUT _UBYTE FNC_VALUES 1 UBYTE ROW_DIR DIRECT /end RECORD_LAYOUT
/begin RECORD_LAYOUT _UWORD FNC_VALUES 1 UWORD ROW_DIR DIRECT /end RECORD_LAYOUT
/begin RECORD_LAYOUT _ULONG FNC_VALUES 1 ULONG ROW_DIR DIRECT /end RECORD_LAYOUT
/begin RECORD_LAYOUT _FLOAT64_IEEE FNC_VALUES 1 FLOAT64_IEEE ROW_DIR DIRECT /end RECORD_LAYOUT
/begin TYPEDEF_MEASUREMENT _SLONG "" SLONG NO_COMPU_METHOD 0 0 -2147483648 2147483647 /end TYPEDEF_MEASUREMENT
/begin TYPEDEF_MEASUREMENT _SWORD "" SWORD NO_COMPU_METHOD 0 0 -32768 32767 /end TYPEDEF_MEASUREMENT
/begin TYPEDEF_MEASUREMENT _SBYTE "" SBYTE NO_COMPU_METHOD 0 0 -128 127 /end TYPEDEF_MEASUREMENT
/begin TYPEDEF_MEASUREMENT _UBYTE "" UBYTE NO_COMPU_METHOD 0 0 0 255 /end TYPEDEF_MEASUREMENT
/begin TYPEDEF_MEASUREMENT _UWORD "" UWORD NO_COMPU_METHOD 0 0 0 65535 /end TYPEDEF_MEASUREMENT
/begin TYPEDEF_MEASUREMENT _ULONG "" ULONG NO_COMPU_METHOD 0 0 0 4294967295 /end TYPEDEF_MEASUREMENT
/begin TYPEDEF_MEASUREMENT _FLOAT64_IEEE "" FLOAT64_IEEE NO_COMPU_METHOD 0 0 0 1E12 /end TYPEDEF_MEASUREMENT
/end MODULE
/end PROJECT
