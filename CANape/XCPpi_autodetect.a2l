/* generated by XCPlite */ ASAP2_VERSION 1 71
/begin PROJECT XCPlite ""
/begin HEADER "" VERSION "1.0" /end HEADER
/begin MODULE XCPlite ""
/include "XCP_104.aml"
/begin MOD_COMMON "" BYTE_ORDER MSB_LAST ALIGNMENT_BYTE 1 ALIGNMENT_WORD 1 ALIGNMENT_LONG 1 ALIGNMENT_FLOAT16_IEEE 1 ALIGNMENT_FLOAT32_IEEE 1 ALIGNMENT_FLOAT64_IEEE 1 ALIGNMENT_INT64 1 /end MOD_COMMON
/begin IF_DATA XCP
 /begin PROTOCOL_LAYER 0x0103 0x03E8 0x2710 0x00 0x00 0x00 0x00 0x00 0xFA 0x0574 BYTE_ORDER_MSB_LAST ADDRESS_GRANULARITY_BYTE OPTIONAL_CMD GET_COMM_MODE_INFO OPTIONAL_CMD GET_ID OPTIONAL_CMD SET_MTA OPTIONAL_CMD UPLOAD OPTIONAL_CMD SHORT_UPLOAD OPTIONAL_CMD DOWNLOAD OPTIONAL_CMD SHORT_UPLOAD OPTIONAL_CMD GET_DAQ_RESOLUTION_INFO OPTIONAL_CMD GET_DAQ_PROCESSOR_INFO OPTIONAL_CMD FREE_DAQ OPTIONAL_CMD ALLOC_DAQ OPTIONAL_CMD ALLOC_ODT OPTIONAL_CMD ALLOC_ODT_ENTRY OPTIONAL_CMD SET_DAQ_PTR OPTIONAL_CMD WRITE_DAQ OPTIONAL_CMD WRITE_DAQ_MULTIPLE OPTIONAL_CMD GET_DAQ_LIST_MODE OPTIONAL_CMD SET_DAQ_LIST_MODE OPTIONAL_CMD START_STOP_SYNCH OPTIONAL_CMD START_STOP_DAQ_LIST OPTIONAL_CMD GET_DAQ_CLOCK OPTIONAL_LEVEL1_CMD GET_VERSION OPTIONAL_LEVEL1_CMD SET_DAQ_PACKED_MODE OPTIONAL_LEVEL1_CMD GET_DAQ_PACKED_MODE /end PROTOCOL_LAYER
 /begin DAQ DYNAMIC 0x00 0x03 0x00 OPTIMISATION_TYPE_DEFAULT ADDRESS_EXTENSION_FREE IDENTIFICATION_FIELD_TYPE_RELATIVE_BYTE GRANULARITY_ODT_ENTRY_SIZE_DAQ_BYTE 0xF8 OVERLOAD_INDICATION_PID /begin TIMESTAMP_SUPPORTED 0x01 SIZE_DWORD UNIT_1US TIMESTAMP_FIXED /end TIMESTAMP_SUPPORTED
  /begin EVENT "EcuCyclic" "EcuCyclic" 0x1 DAQ 0xFF 0xC8 0x4 0x00 CONSISTENCY DAQ /end EVENT
  /begin EVENT "EcuTask1" "EcuTask1" 0x2 DAQ 0xFF 0xC8 0x4 0x00 CONSISTENCY DAQ /end EVENT
  /begin EVENT "EcuTask2" "EcuTask2" 0x3 DAQ 0xFF 0xC8 0x4 0x00 CONSISTENCY DAQ /end EVENT
  /begin EVENT "activeEcuTask" "activeEcuTask" 0x4 DAQ 0xFF 0x0 0x3 0x00 CONSISTENCY DAQ /end EVENT
 /end DAQ
 /begin XCP_ON_UDP_IP 0x0103 5555 ADDRESS "172.31.31.194" /end XCP_ON_UDP_IP
/end IF_DATA
/begin CHARACTERISTIC gFlushCycle "DAQ queue flush cycle time" VALUE 0x28098 _ULONG 0 NO_COMPU_METHOD 0 4294967295 PHYS_UNIT "ms" /end CHARACTERISTIC
/begin CHARACTERISTIC gCmdCycle "XCP command handler cycle time" VALUE 0x2809C _ULONG 0 NO_COMPU_METHOD 0 4294967295 PHYS_UNIT "us" /end CHARACTERISTIC
/begin CHARACTERISTIC gTransmitCycle "DAQ transmit cycle time" VALUE 0x280A0 _ULONG 0 NO_COMPU_METHOD 0 4294967295 PHYS_UNIT "us" /end CHARACTERISTIC
/begin CHARACTERISTIC gServerWaitTimeout "Server thread sleep and wait timeout" VALUE 0x280A4 _ULONG 0 NO_COMPU_METHOD 0 4294967295 PHYS_UNIT "us" /end CHARACTERISTIC
/begin GROUP Server_Parameters "" /begin REF_CHARACTERISTIC gFlushCycle gServerWaitTimeout /end REF_CHARACTERISTIC /end GROUP
/begin TYPEDEF_STRUCTURE EcuTask "TYPEDEF for class EcuTask" 0x58 SYMBOL_TYPE_LINK "EcuTask" /begin STRUCTURE_COMPONENT taskId _ULONG 0x0 SYMBOL_TYPE_LINK "taskId" /end STRUCTURE_COMPONENT /begin STRUCTURE_COMPONENT counter _UWORD 0x4 SYMBOL_TYPE_LINK "counter" /end STRUCTURE_COMPONENT /begin STRUCTURE_COMPONENT channel1 _FLOAT64_IEEE 0x10 SYMBOL_TYPE_LINK "channel1" /end STRUCTURE_COMPONENT /begin STRUCTURE_COMPONENT byte _UBYTE 0x38 SYMBOL_TYPE_LINK "byte" /end STRUCTURE_COMPONENT /begin STRUCTURE_COMPONENT word _UWORD 0x3A SYMBOL_TYPE_LINK "word" /end STRUCTURE_COMPONENT /begin STRUCTURE_COMPONENT dword _ULONG 0x3C SYMBOL_TYPE_LINK "dword" /end STRUCTURE_COMPONENT /end TYPEDEF_STRUCTURE
/begin INSTANCE ecuTask1 "" EcuTask 0x575D0
 /begin IF_DATA XCP
  /begin DAQ_EVENT FIXED_EVENT_LIST EVENT 0x2 /end DAQ_EVENT
 /end IF_DATA
/end INSTANCE
/begin INSTANCE ecuTask2 "" EcuTask 0x57630
 /begin IF_DATA XCP
  /begin DAQ_EVENT FIXED_EVENT_LIST EVENT 0x3 /end DAQ_EVENT
 /end IF_DATA
/end INSTANCE
/begin INSTANCE activeEcuTask "" EcuTask 0x0
 /begin IF_DATA XCP
  /begin DAQ_EVENT FIXED_EVENT_LIST EVENT 0x4 /end DAQ_EVENT
 /end IF_DATA
/end INSTANCE
/begin CHARACTERISTIC ampl "Amplitude" VALUE 0x28008 _FLOAT64_IEEE 0 NO_COMPU_METHOD 0 800 PHYS_UNIT "V" /end CHARACTERISTIC
/begin CHARACTERISTIC offset "Offset of channel 1" VALUE 0x28CC0 _FLOAT64_IEEE 0 NO_COMPU_METHOD -200 200 PHYS_UNIT "V" /end CHARACTERISTIC
/begin CHARACTERISTIC phase "Phase of channel 1" VALUE 0x28010 _FLOAT64_IEEE 0 NO_COMPU_METHOD 0 6.28319 PHYS_UNIT "" /end CHARACTERISTIC
/begin CHARACTERISTIC threshold "Threshold for channel 3" VALUE 0x28CC8 _FLOAT64_IEEE 0 NO_COMPU_METHOD -400 400 PHYS_UNIT "" /end CHARACTERISTIC
/begin CHARACTERISTIC period "Period" VALUE 0x28018 _FLOAT64_IEEE 0 NO_COMPU_METHOD 0.01 10 PHYS_UNIT "" /end CHARACTERISTIC
/begin GROUP Parameters "" /begin REF_CHARACTERISTIC period ampl offset phase threshold /end REF_CHARACTERISTIC /end GROUP
/begin MEASUREMENT ecuCounter "" UWORD NO_COMPU_METHOD 0 0 0 65535 ECU_ADDRESS 0x28CB8
 /begin IF_DATA XCP
  /begin DAQ_EVENT FIXED_EVENT_LIST EVENT 0x1 /end DAQ_EVENT
 /end IF_DATA
/end MEASUREMENT
/begin COMPU_METHOD channel1_COMPU_METHOD "" LINEAR "%6.3" "" COEFFS_LINEAR 1 0 /end COMPU_METHOD
/begin MEASUREMENT channel1 "Demo signal 1" FLOAT64_IEEE channel1_COMPU_METHOD 0 0 -1E12 1E12 ECU_ADDRESS 0x44948
 /begin IF_DATA XCP
  /begin DAQ_EVENT FIXED_EVENT_LIST EVENT 0x1 /end DAQ_EVENT
 /end IF_DATA
/end MEASUREMENT
/begin COMPU_METHOD channel2_COMPU_METHOD "" LINEAR "%6.3" "" COEFFS_LINEAR 1 0 /end COMPU_METHOD
/begin MEASUREMENT channel2 "Demo signal 2" FLOAT64_IEEE channel2_COMPU_METHOD 0 0 -1E12 1E12 ECU_ADDRESS 0x47A38
 /begin IF_DATA XCP
  /begin DAQ_EVENT FIXED_EVENT_LIST EVENT 0x1 /end DAQ_EVENT
 /end IF_DATA
/end MEASUREMENT
/begin COMPU_METHOD channel3_COMPU_METHOD "" LINEAR "%6.3" "" COEFFS_LINEAR 1 0 /end COMPU_METHOD
/begin MEASUREMENT channel3 "Demo signal 3" FLOAT64_IEEE channel3_COMPU_METHOD 0 0 -1E12 1E12 ECU_ADDRESS 0x46F40
 /begin IF_DATA XCP
  /begin DAQ_EVENT FIXED_EVENT_LIST EVENT 0x1 /end DAQ_EVENT
 /end IF_DATA
/end MEASUREMENT
/begin CHARACTERISTIC map1_8_8 "8*8 byte calibration array" MAP 0x28020 _UBYTE 0 NO_COMPU_METHOD 0 255
 /begin AXIS_DESCR FIX_AXIS NO_INPUT_QUANTITY NO_COMPU_METHOD 8 0 7 FIX_AXIS_PAR_DIST 0 1 8 /end AXIS_DESCR
 /begin AXIS_DESCR FIX_AXIS NO_INPUT_QUANTITY NO_COMPU_METHOD 8 0 7 FIX_AXIS_PAR_DIST 0 1 8 /end AXIS_DESCR
 PHYS_UNIT "" CHARACTERISTIC curve1_32 "32 byte calibration array" MAP 0x28060 _UBYTE 0 NO_COMPU_METHOD 0 255
 /begin AXIS_DESCR FIX_AXIS NO_INPUT_QUANTITY NO_COMPU_METHOD 32 0 31 FIX_AXIS_PAR_DIST 0 1 32 /end AXIS_DESCR
 /begin AXIS_DESCR FIX_AXIS NO_INPUT_QUANTITY NO_COMPU_METHOD 1 0 0 FIX_AXIS_PAR_DIST 0 1 1 /end AXIS_DESCR
 PHYS_UNIT "" MEASUREMENT byteCounter "" UBYTE NO_COMPU_METHOD 0 0 0 255 ECU_ADDRESS 0x3ED78
 /begin IF_DATA XCP
  /begin DAQ_EVENT FIXED_EVENT_LIST EVENT 0x1 /end DAQ_EVENT
 /end IF_DATA
 /begin MEASUREMENT wordCounter "" UWORD NO_COMPU_METHOD 0 0 0 65535 ECU_ADDRESS 0x46F38
  /begin IF_DATA XCP
   /begin DAQ_EVENT FIXED_EVENT_LIST EVENT 0x1 /end DAQ_EVENT
  /end IF_DATA
 /end MEASUREMENT
 /begin MEASUREMENT dwordCounter "" ULONG NO_COMPU_METHOD 0 0 0 4294967295 ECU_ADDRESS 0x418D8
  /begin IF_DATA XCP
   /begin DAQ_EVENT FIXED_EVENT_LIST EVENT 0x1 /end DAQ_EVENT
  /end IF_DATA
 /end MEASUREMENT
 /begin MEASUREMENT sbyteCounter "" SBYTE NO_COMPU_METHOD 0 0 -128 127 ECU_ADDRESS 0x47A40
  /begin IF_DATA XCP
   /begin DAQ_EVENT FIXED_EVENT_LIST EVENT 0x1 /end DAQ_EVENT
  /end IF_DATA
 /end MEASUREMENT
 /begin MEASUREMENT swordCounter "" SWORD NO_COMPU_METHOD 0 0 -32768 32767 ECU_ADDRESS 0x3F86C
  /begin IF_DATA XCP
   /begin DAQ_EVENT FIXED_EVENT_LIST EVENT 0x1 /end DAQ_EVENT
  /end IF_DATA
 /end MEASUREMENT
 /begin MEASUREMENT sdwordCounter "" SLONG NO_COMPU_METHOD 0 0 -2147483648 2147483647 ECU_ADDRESS 0x47A44
  /begin IF_DATA XCP
   /begin DAQ_EVENT FIXED_EVENT_LIST EVENT 0x1 /end DAQ_EVENT
  /end IF_DATA
 /end MEASUREMENT
 /begin CHARACTERISTIC byteArray1 "" VAL_BLK 0x40DE8 _UBYTE 0 NO_COMPU_METHOD 0 255 MATRIX_DIM 1400
  /begin IF_DATA XCP
   /begin DAQ_EVENT FIXED_EVENT_LIST EVENT 0x1 /end DAQ_EVENT
  /end IF_DATA
 /end CHARACTERISTIC
 /begin CHARACTERISTIC byteArray2 "" VAL_BLK 0x45EC8 _UBYTE 0 NO_COMPU_METHOD 0 255 MATRIX_DIM 1400
  /begin IF_DATA XCP
   /begin DAQ_EVENT FIXED_EVENT_LIST EVENT 0x1 /end DAQ_EVENT
  /end IF_DATA
 /end CHARACTERISTIC
 /begin CHARACTERISTIC byteArray3 "" VAL_BLK 0x443CC _UBYTE 0 NO_COMPU_METHOD 0 255 MATRIX_DIM 1400
  /begin IF_DATA XCP
   /begin DAQ_EVENT FIXED_EVENT_LIST EVENT 0x1 /end DAQ_EVENT
  /end IF_DATA
 /end CHARACTERISTIC
 /begin CHARACTERISTIC byteArray4 "" VAL_BLK 0x46F48 _UBYTE 0 NO_COMPU_METHOD 0 255 MATRIX_DIM 1400
  /begin IF_DATA XCP
   /begin DAQ_EVENT FIXED_EVENT_LIST EVENT 0x1 /end DAQ_EVENT
  /end IF_DATA
 /end CHARACTERISTIC
 /begin CHARACTERISTIC longArray1 "" VAL_BLK 0x44950 _ULONG 0 NO_COMPU_METHOD 0 4294967295 MATRIX_DIM 1024
  /begin IF_DATA XCP
   /begin DAQ_EVENT FIXED_EVENT_LIST EVENT 0x1 /end DAQ_EVENT
  /end IF_DATA
 /end CHARACTERISTIC
 /begin CHARACTERISTIC longArray2 "" VAL_BLK 0x42E54 _ULONG 0 NO_COMPU_METHOD 0 4294967295 MATRIX_DIM 1024
  /begin IF_DATA XCP
   /begin DAQ_EVENT FIXED_EVENT_LIST EVENT 0x1 /end DAQ_EVENT
  /end IF_DATA
 /end CHARACTERISTIC
 /begin CHARACTERISTIC longArray3 "" VAL_BLK 0x418DC _ULONG 0 NO_COMPU_METHOD 0 4294967295 MATRIX_DIM 1024
  /begin IF_DATA XCP
   /begin DAQ_EVENT FIXED_EVENT_LIST EVENT 0x1 /end DAQ_EVENT
  /end IF_DATA
 /end CHARACTERISTIC
 /begin CHARACTERISTIC longArray4 "" VAL_BLK 0x3F870 _ULONG 0 NO_COMPU_METHOD 0 4294967295 MATRIX_DIM 1024
  /begin IF_DATA XCP
   /begin DAQ_EVENT FIXED_EVENT_LIST EVENT 0x1 /end DAQ_EVENT
  /end IF_DATA
 /end CHARACTERISTIC
 /begin GROUP Arrays ""
  /begin REF_CHARACTERISTIC byteArray1 byteArray2 byteArray3 byteArray4 longArray1 longArray2 longArray3 longArray4 /end REF_CHARACTERISTIC
 /end GROUP
 /begin CHARACTERISTIC gActiveEcuTaskId "Active ecu task object id" VALUE 0x28CD8 _ULONG 0 NO_COMPU_METHOD 2 3 PHYS_UNIT "" /end CHARACTERISTIC
 /begin CHARACTERISTIC gTaskCycleTimerECU "ECU task cycle time" VALUE 0x2808C _ULONG 0 NO_COMPU_METHOD 200 1e+06 PHYS_UNIT "us" /end CHARACTERISTIC
 /begin CHARACTERISTIC gTaskCycleTimerECUpp "ECUpp task cycle time" VALUE 0x28090 _ULONG 0 NO_COMPU_METHOD 200 1e+06 PHYS_UNIT "us" /end CHARACTERISTIC
 /begin CHARACTERISTIC gXcpDebugLevel "Console output verbosity" VALUE 0x28094 _UBYTE 0 NO_COMPU_METHOD 0 4 PHYS_UNIT "us" /end CHARACTERISTIC
 /begin GROUP Demo_Parameters ""
  /begin REF_CHARACTERISTIC gActiveEcuTaskId gTaskCycleTimerECU gTaskCycleTimerECUpp gXcpDebugLevel /end REF_CHARACTERISTIC
 /end GROUP
 /begin RECORD_LAYOUT _SLONG FNC_VALUES 1 SLONG ROW_DIR DIRECT /end RECORD_LAYOUT
 /begin RECORD_LAYOUT _SWORD FNC_VALUES 1 SWORD ROW_DIR DIRECT /end RECORD_LAYOUT
 /begin RECORD_LAYOUT _SBYTE FNC_VALUES 1 SBYTE ROW_DIR DIRECT /end RECORD_LAYOUT
 /begin RECORD_LAYOUT _UBYTE FNC_VALUES 1 UBYTE ROW_DIR DIRECT /end RECORD_LAYOUT
 /begin RECORD_LAYOUT _UWORD FNC_VALUES 1 UWORD ROW_DIR DIRECT /end RECORD_LAYOUT
 /begin RECORD_LAYOUT _ULONG FNC_VALUES 1 ULONG ROW_DIR DIRECT /end RECORD_LAYOUT
 /begin RECORD_LAYOUT _FLOAT64_IEEE FNC_VALUES 1 FLOAT64_IEEE ROW_DIR DIRECT /end RECORD_LAYOUT
 /begin TYPEDEF_MEASUREMENT _SLONG "" SLONG NO_COMPU_METHOD 0 0 -2147483648 2147483647 /end TYPEDEF_MEASUREMENT
 /begin TYPEDEF_MEASUREMENT _SWORD "" SWORD NO_COMPU_METHOD 0 0 -32768 32767 /end TYPEDEF_MEASUREMENT
 /begin TYPEDEF_MEASUREMENT _SBYTE "" SBYTE NO_COMPU_METHOD 0 0 -128 127 /end TYPEDEF_MEASUREMENT
 /begin TYPEDEF_MEASUREMENT _UBYTE "" UBYTE NO_COMPU_METHOD 0 0 0 255 /end TYPEDEF_MEASUREMENT
 /begin TYPEDEF_MEASUREMENT _UWORD "" UWORD NO_COMPU_METHOD 0 0 0 65535 /end TYPEDEF_MEASUREMENT
 /begin TYPEDEF_MEASUREMENT _ULONG "" ULONG NO_COMPU_METHOD 0 0 0 4294967295 /end TYPEDEF_MEASUREMENT
 /begin TYPEDEF_MEASUREMENT _FLOAT64_IEEE "" FLOAT64_IEEE NO_COMPU_METHOD 0 0 -1E12 1E12 /end TYPEDEF_MEASUREMENT
/end CHARACTERISTIC
/end MODULE
/end PROJECT
