ASAP2_VERSION 1 71
/begin PROJECT multi_thread_demo ""
/begin HEADER "" VERSION "1.0" PROJECT_NO VECTOR /end HEADER
/begin MODULE multi_thread_demo ""
/include "XCP_104.aml"
/begin MOD_COMMON "" BYTE_ORDER MSB_LAST ALIGNMENT_BYTE 1 ALIGNMENT_WORD 1 ALIGNMENT_LONG 1 ALIGNMENT_FLOAT16_IEEE 1 ALIGNMENT_FLOAT32_IEEE 1 ALIGNMENT_FLOAT64_IEEE 1 ALIGNMENT_INT64 1 /end MOD_COMMON
/* Segment relative addressing mode: calseg=Parameters */
/begin CHARACTERISTIC params.counter_max "Max counter value, wrap around" VALUE 0x80010000 U16 0 NO_COMPU_METHOD 0 10000 PHYS_UNIT "" /end CHARACTERISTIC
/begin CHARACTERISTIC params.ampl "Amplitude" VALUE 0x80010008 F64 0 NO_COMPU_METHOD 0 100 PHYS_UNIT "Volt" /end CHARACTERISTIC
/begin CHARACTERISTIC params.period "Period" VALUE 0x80010010 F64 0 NO_COMPU_METHOD 0.1 10 PHYS_UNIT "s" /end CHARACTERISTIC
/begin CHARACTERISTIC params.delay_us "task delay time in us" VALUE 0x80010018 U32 0 NO_COMPU_METHOD 0 1e+06 PHYS_UNIT "us" /end CHARACTERISTIC
/begin CHARACTERISTIC params.run "stop task" VALUE 0x8001001C U8 0 NO_COMPU_METHOD 0 1 PHYS_UNIT "" /end CHARACTERISTIC
/* Stack frame relative addressing mode: event=task (0), addr_ext=3 */
/begin MEASUREMENT task_0.counter "task loop counter" UWORD NO_COMPU_METHOD 0 0 0 65535 ECU_ADDRESS 0xFFFFFFBE ECU_ADDRESS_EXTENSION 3 PHYS_UNIT ""
 /begin IF_DATA XCP
  /begin DAQ_EVENT FIXED_EVENT_LIST EVENT 0x0 /end DAQ_EVENT
 /end IF_DATA
/end MEASUREMENT
/begin MEASUREMENT task_0.channel "task sine signal" FLOAT64_IEEE NO_COMPU_METHOD 0 0 -1e+12 1e+12 ECU_ADDRESS 0xFFFFFFB0 ECU_ADDRESS_EXTENSION 3 PHYS_UNIT ""
 /begin IF_DATA XCP
  /begin DAQ_EVENT FIXED_EVENT_LIST EVENT 0x0 /end DAQ_EVENT
 /end IF_DATA
/end MEASUREMENT
/* Stack frame relative addressing mode: event=task (1), addr_ext=3 */
/begin MEASUREMENT task_1.counter "task loop counter" UWORD NO_COMPU_METHOD 0 0 0 65535 ECU_ADDRESS 0xFFFFFFBE ECU_ADDRESS_EXTENSION 3 PHYS_UNIT ""
 /begin IF_DATA XCP
  /begin DAQ_EVENT FIXED_EVENT_LIST EVENT 0x1 /end DAQ_EVENT
 /end IF_DATA
/end MEASUREMENT
/begin MEASUREMENT task_1.channel "task sine signal" FLOAT64_IEEE NO_COMPU_METHOD 0 0 -1e+12 1e+12 ECU_ADDRESS 0xFFFFFFB0 ECU_ADDRESS_EXTENSION 3 PHYS_UNIT ""
 /begin IF_DATA XCP
  /begin DAQ_EVENT FIXED_EVENT_LIST EVENT 0x1 /end DAQ_EVENT
 /end IF_DATA
/end MEASUREMENT
/* Stack frame relative addressing mode: event=task (2), addr_ext=3 */
/begin MEASUREMENT task_2.counter "task loop counter" UWORD NO_COMPU_METHOD 0 0 0 65535 ECU_ADDRESS 0xFFFFFFBE ECU_ADDRESS_EXTENSION 3 PHYS_UNIT ""
 /begin IF_DATA XCP
  /begin DAQ_EVENT FIXED_EVENT_LIST EVENT 0x2 /end DAQ_EVENT
 /end IF_DATA
/end MEASUREMENT
/begin MEASUREMENT task_2.channel "task sine signal" FLOAT64_IEEE NO_COMPU_METHOD 0 0 -1e+12 1e+12 ECU_ADDRESS 0xFFFFFFB0 ECU_ADDRESS_EXTENSION 3 PHYS_UNIT ""
 /begin IF_DATA XCP
  /begin DAQ_EVENT FIXED_EVENT_LIST EVENT 0x2 /end DAQ_EVENT
 /end IF_DATA
/end MEASUREMENT
/* Stack frame relative addressing mode: event=task (3), addr_ext=3 */
/begin MEASUREMENT task_3.counter "task loop counter" UWORD NO_COMPU_METHOD 0 0 0 65535 ECU_ADDRESS 0xFFFFFFBE ECU_ADDRESS_EXTENSION 3 PHYS_UNIT ""
 /begin IF_DATA XCP
  /begin DAQ_EVENT FIXED_EVENT_LIST EVENT 0x3 /end DAQ_EVENT
 /end IF_DATA
/end MEASUREMENT
/begin MEASUREMENT task_3.channel "task sine signal" FLOAT64_IEEE NO_COMPU_METHOD 0 0 -1e+12 1e+12 ECU_ADDRESS 0xFFFFFFB0 ECU_ADDRESS_EXTENSION 3 PHYS_UNIT ""
 /begin IF_DATA XCP
  /begin DAQ_EVENT FIXED_EVENT_LIST EVENT 0x3 /end DAQ_EVENT
 /end IF_DATA
/end MEASUREMENT
/* Stack frame relative addressing mode: event=task (5), addr_ext=3 */
/begin MEASUREMENT task_5.counter "task loop counter" UWORD NO_COMPU_METHOD 0 0 0 65535 ECU_ADDRESS 0xFFFFFFBE ECU_ADDRESS_EXTENSION 3 PHYS_UNIT ""
 /begin IF_DATA XCP
  /begin DAQ_EVENT FIXED_EVENT_LIST EVENT 0x5 /end DAQ_EVENT
 /end IF_DATA
/end MEASUREMENT
/begin MEASUREMENT task_5.channel "task sine signal" FLOAT64_IEEE NO_COMPU_METHOD 0 0 -1e+12 1e+12 ECU_ADDRESS 0xFFFFFFB0 ECU_ADDRESS_EXTENSION 3 PHYS_UNIT ""
 /begin IF_DATA XCP
  /begin DAQ_EVENT FIXED_EVENT_LIST EVENT 0x5 /end DAQ_EVENT
 /end IF_DATA
/end MEASUREMENT
* Stack
/end MODULE
/end PROJECT
