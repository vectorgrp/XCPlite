ASAP2_VERSION 1 71
/begin PROJECT xcpdaemon ""
/begin HEADER "" VERSION "1.0" PROJECT_NO XCPLITE__CXSDD /end HEADER
/begin MODULE xcpdaemon ""
/include "XCP_104.aml"
/begin MOD_COMMON "" BYTE_ORDER MSB_LAST ALIGNMENT_BYTE 1 ALIGNMENT_WORD 1 ALIGNMENT_LONG 1 ALIGNMENT_FLOAT16_IEEE 1 ALIGNMENT_FLOAT32_IEEE 1 ALIGNMENT_FLOAT64_IEEE 1 ALIGNMENT_INT64 1 /end MOD_COMMON
/begin COMPU_METHOD conv.bool "" TAB_VERB "%.0" "" COMPU_TAB_REF conv.bool.table /end COMPU_METHOD
/begin COMPU_VTAB conv.bool.table "" TAB_VERB 2 0 "false" 1 "true" /end COMPU_VTAB
/begin RECORD_LAYOUT U8 FNC_VALUES 1 UBYTE ROW_DIR DIRECT /end RECORD_LAYOUT
/begin RECORD_LAYOUT A_U8 AXIS_PTS_X 1 UBYTE INDEX_INCR DIRECT /end RECORD_LAYOUT
/begin TYPEDEF_MEASUREMENT M_U8 "" UBYTE NO_COMPU_METHOD 0 0 0 255 /end TYPEDEF_MEASUREMENT
/begin TYPEDEF_CHARACTERISTIC C_U8 "" VALUE U8 0 NO_COMPU_METHOD 0 255 /end TYPEDEF_CHARACTERISTIC
/begin RECORD_LAYOUT U16 FNC_VALUES 1 UWORD ROW_DIR DIRECT /end RECORD_LAYOUT
/begin RECORD_LAYOUT A_U16 AXIS_PTS_X 1 UWORD INDEX_INCR DIRECT /end RECORD_LAYOUT
/begin TYPEDEF_MEASUREMENT M_U16 "" UWORD NO_COMPU_METHOD 0 0 0 65535 /end TYPEDEF_MEASUREMENT
/begin TYPEDEF_CHARACTERISTIC C_U16 "" VALUE U16 0 NO_COMPU_METHOD 0 65535 /end TYPEDEF_CHARACTERISTIC
/begin RECORD_LAYOUT U32 FNC_VALUES 1 ULONG ROW_DIR DIRECT /end RECORD_LAYOUT
/begin RECORD_LAYOUT A_U32 AXIS_PTS_X 1 ULONG INDEX_INCR DIRECT /end RECORD_LAYOUT
/begin TYPEDEF_MEASUREMENT M_U32 "" ULONG NO_COMPU_METHOD 0 0 0 4294967295 /end TYPEDEF_MEASUREMENT
/begin TYPEDEF_CHARACTERISTIC C_U32 "" VALUE U32 0 NO_COMPU_METHOD 0 4.29497e+09 /end TYPEDEF_CHARACTERISTIC
/begin RECORD_LAYOUT U64 FNC_VALUES 1 A_UINT64 ROW_DIR DIRECT /end RECORD_LAYOUT
/begin RECORD_LAYOUT A_U64 AXIS_PTS_X 1 A_UINT64 INDEX_INCR DIRECT /end RECORD_LAYOUT
/begin TYPEDEF_MEASUREMENT M_U64 "" A_UINT64 NO_COMPU_METHOD 0 0 0 1000000000000 /end TYPEDEF_MEASUREMENT
/begin TYPEDEF_CHARACTERISTIC C_U64 "" VALUE U64 0 NO_COMPU_METHOD 0 1e+12 /end TYPEDEF_CHARACTERISTIC
/begin RECORD_LAYOUT I8 FNC_VALUES 1 SBYTE ROW_DIR DIRECT /end RECORD_LAYOUT
/begin RECORD_LAYOUT A_I8 AXIS_PTS_X 1 SBYTE INDEX_INCR DIRECT /end RECORD_LAYOUT
/begin TYPEDEF_MEASUREMENT M_I8 "" SBYTE NO_COMPU_METHOD 0 0 -128 127 /end TYPEDEF_MEASUREMENT
/begin TYPEDEF_CHARACTERISTIC C_I8 "" VALUE I8 0 NO_COMPU_METHOD -128 127 /end TYPEDEF_CHARACTERISTIC
/begin RECORD_LAYOUT I16 FNC_VALUES 1 SWORD ROW_DIR DIRECT /end RECORD_LAYOUT
/begin RECORD_LAYOUT A_I16 AXIS_PTS_X 1 SWORD INDEX_INCR DIRECT /end RECORD_LAYOUT
/begin TYPEDEF_MEASUREMENT M_I16 "" SWORD NO_COMPU_METHOD 0 0 -32768 32767 /end TYPEDEF_MEASUREMENT
/begin TYPEDEF_CHARACTERISTIC C_I16 "" VALUE I16 0 NO_COMPU_METHOD -32768 32767 /end TYPEDEF_CHARACTERISTIC
/begin RECORD_LAYOUT I32 FNC_VALUES 1 SLONG ROW_DIR DIRECT /end RECORD_LAYOUT
/begin RECORD_LAYOUT A_I32 AXIS_PTS_X 1 SLONG INDEX_INCR DIRECT /end RECORD_LAYOUT
/begin TYPEDEF_MEASUREMENT M_I32 "" SLONG NO_COMPU_METHOD 0 0 -2147483648 2147483647 /end TYPEDEF_MEASUREMENT
/begin TYPEDEF_CHARACTERISTIC C_I32 "" VALUE I32 0 NO_COMPU_METHOD -2.14748e+09 2.14748e+09 /end TYPEDEF_CHARACTERISTIC
/begin RECORD_LAYOUT I64 FNC_VALUES 1 A_INT64 ROW_DIR DIRECT /end RECORD_LAYOUT
/begin RECORD_LAYOUT A_I64 AXIS_PTS_X 1 A_INT64 INDEX_INCR DIRECT /end RECORD_LAYOUT
/begin TYPEDEF_MEASUREMENT M_I64 "" A_INT64 NO_COMPU_METHOD 0 0 -1000000000000 1000000000000 /end TYPEDEF_MEASUREMENT
/begin TYPEDEF_CHARACTERISTIC C_I64 "" VALUE I64 0 NO_COMPU_METHOD -1e+12 1e+12 /end TYPEDEF_CHARACTERISTIC
/begin RECORD_LAYOUT F32 FNC_VALUES 1 FLOAT32_IEEE ROW_DIR DIRECT /end RECORD_LAYOUT
/begin RECORD_LAYOUT A_F32 AXIS_PTS_X 1 FLOAT32_IEEE INDEX_INCR DIRECT /end RECORD_LAYOUT
/begin TYPEDEF_MEASUREMENT M_F32 "" FLOAT32_IEEE NO_COMPU_METHOD 0 0 -1e+12 1e+12 /end TYPEDEF_MEASUREMENT
/begin TYPEDEF_CHARACTERISTIC C_F32 "" VALUE F32 0 NO_COMPU_METHOD -1e+12 1e+12 /end TYPEDEF_CHARACTERISTIC
/begin RECORD_LAYOUT F64 FNC_VALUES 1 FLOAT64_IEEE ROW_DIR DIRECT /end RECORD_LAYOUT
/begin RECORD_LAYOUT A_F64 AXIS_PTS_X 1 FLOAT64_IEEE INDEX_INCR DIRECT /end RECORD_LAYOUT
/begin TYPEDEF_MEASUREMENT M_F64 "" FLOAT64_IEEE NO_COMPU_METHOD 0 0 -1e+12 1e+12 /end TYPEDEF_MEASUREMENT
/begin TYPEDEF_CHARACTERISTIC C_F64 "" VALUE F64 0 NO_COMPU_METHOD -1e+12 1e+12 /end TYPEDEF_CHARACTERISTIC
/* #include "xcpdaemon.a2l" */
/begin MEASUREMENT xcpdaemon.counter "Mainloop counter" UWORD NO_COMPU_METHOD 0 0 0 65535 ECU_ADDRESS 0x10052 ECU_ADDRESS_EXTENSION 2 READ_WRITE
 /begin IF_DATA XCP
  /begin DAQ_EVENT FIXED_EVENT_LIST EVENT 0x0 /end DAQ_EVENT
 /end IF_DATA
/end MEASUREMENT
/begin CHARACTERISTIC xcpdaemon.delay_ms "Mainloop delay" VALUE 0x10054 U32 0 NO_COMPU_METHOD 1 1000 PHYS_UNIT "ms" ECU_ADDRESS_EXTENSION 2
 /begin IF_DATA XCP
  /begin DAQ_EVENT FIXED_EVENT_LIST EVENT 0x0 /end DAQ_EVENT
 /end IF_DATA
/end CHARACTERISTIC
/begin MEASUREMENT xcpdaemon.gXcpLocalData.daq_start_clock "DAQ start clock" A_UINT64 NO_COMPU_METHOD 0 0 0 1e+12 ECU_ADDRESS 0x50380 ECU_ADDRESS_EXTENSION 128 READ_WRITE
 /begin IF_DATA XCP
  /begin DAQ_EVENT VARIABLE /begin DEFAULT_EVENT_LIST EVENT 0x0 /end DEFAULT_EVENT_LIST /end DAQ_EVENT
 /end IF_DATA
/end MEASUREMENT
/begin MEASUREMENT xcpdaemon.gXcpLocalData.shm_app_id "Application id" UBYTE NO_COMPU_METHOD 0 0 0 255 ECU_ADDRESS 0x50359 ECU_ADDRESS_EXTENSION 128 READ_WRITE
 /begin IF_DATA XCP
  /begin DAQ_EVENT VARIABLE /begin DEFAULT_EVENT_LIST EVENT 0x0 /end DEFAULT_EVENT_LIST /end DAQ_EVENT
 /end IF_DATA
/end MEASUREMENT
/begin MEASUREMENT xcpdaemon.gXcpLocalData.init_mode "Initialization mode" UBYTE NO_COMPU_METHOD 0 0 0 255 ECU_ADDRESS 0x50358 ECU_ADDRESS_EXTENSION 128 READ_WRITE
 /begin IF_DATA XCP
  /begin DAQ_EVENT VARIABLE /begin DEFAULT_EVENT_LIST EVENT 0x0 /end DEFAULT_EVENT_LIST /end DAQ_EVENT
 /end IF_DATA
/end MEASUREMENT
/begin TYPEDEF_STRUCTURE xcpdaemon.tXcpData "XCP shared state typedef" 0x80F8 /begin STRUCTURE_COMPONENT session_status M_session_status 0x0 /end STRUCTURE_COMPONENT /begin STRUCTURE_COMPONENT daq_overflow_count M_daq_overflow_count 0x3254 /end STRUCTURE_COMPONENT /end TYPEDEF_STRUCTURE
/begin INSTANCE xcpdaemon.gXcpData "XCP shared state" xcpdaemon.tXcpData 0x0 ECU_ADDRESS_EXTENSION 3 READ_WRITE
 /begin IF_DATA XCP
  /begin DAQ_EVENT FIXED_EVENT_LIST EVENT 0x0 /end DAQ_EVENT
 /end IF_DATA
/end INSTANCE
/begin TYPEDEF_MEASUREMENT M_session_status "XCP session status" UWORD NO_COMPU_METHOD 0 0 0 65535 /end TYPEDEF_MEASUREMENT
/begin TYPEDEF_MEASUREMENT M_daq_overflow_count "DAQ overflow count" ULONG NO_COMPU_METHOD 0 0 0 4.29497e+09 /end TYPEDEF_MEASUREMENT
/begin GROUP xcpdaemon.xcpdaemon "Measurement event group"
 /begin REF_MEASUREMENT xcpdaemon.counter xcpdaemon.delay_ms xcpdaemon.gXcpLocalData.daq_start_clock xcpdaemon.gXcpLocalData.shm_app_id xcpdaemon.gXcpLocalData.init_mode xcpdaemon.gXcpData /end REF_MEASUREMENT
/end GROUP
/* #include "hello_xcp_105.a2l" */
/begin CHARACTERISTIC hello_xcp.params.counter_max "Maximum counter value" VALUE 0x80010004 U16 0 NO_COMPU_METHOD 0 65535 /end CHARACTERISTIC
/begin CHARACTERISTIC hello_xcp.params.delay_us "Mainloop delay time in us" VALUE 0x80010000 U32 0 NO_COMPU_METHOD 0 500000 PHYS_UNIT "us" /end CHARACTERISTIC
/begin CHARACTERISTIC hello_xcp.params.flow_rate "Flow rate" VALUE 0x80010008 F32 0 NO_COMPU_METHOD 0 2 PHYS_UNIT "m3/h" /end CHARACTERISTIC
/begin MEASUREMENT hello_xcp.t1 "Parameter t1 in function calc_power" UBYTE NO_COMPU_METHOD 0 0 0 255 ECU_ADDRESS 0x41001F ECU_ADDRESS_EXTENSION 2 READ_WRITE
 /begin IF_DATA XCP
  /begin DAQ_EVENT FIXED_EVENT_LIST EVENT 0x1 /end DAQ_EVENT
 /end IF_DATA
/end MEASUREMENT
/begin MEASUREMENT hello_xcp.t2 "Parameter t2 in function calc_power" UBYTE NO_COMPU_METHOD 0 0 0 255 ECU_ADDRESS 0x41001E ECU_ADDRESS_EXTENSION 2 READ_WRITE
 /begin IF_DATA XCP
  /begin DAQ_EVENT FIXED_EVENT_LIST EVENT 0x1 /end DAQ_EVENT
 /end IF_DATA
/end MEASUREMENT
/begin MEASUREMENT hello_xcp.diff_temp "Local variable diff temperature in function calc_power" FLOAT64_IEEE NO_COMPU_METHOD 0 0 -1e+12 1e+12 ECU_ADDRESS 0x410030 ECU_ADDRESS_EXTENSION 2 READ_WRITE
 /begin IF_DATA XCP
  /begin DAQ_EVENT FIXED_EVENT_LIST EVENT 0x1 /end DAQ_EVENT
 /end IF_DATA
/end MEASUREMENT
/begin MEASUREMENT hello_xcp.heat_power "Local variable calculated heat power in function calc_power" FLOAT64_IEEE NO_COMPU_METHOD 0 0 -1e+12 1e+12 ECU_ADDRESS 0x410028 ECU_ADDRESS_EXTENSION 2 READ_WRITE
 /begin IF_DATA XCP
  /begin DAQ_EVENT FIXED_EVENT_LIST EVENT 0x1 /end DAQ_EVENT
 /end IF_DATA
/end MEASUREMENT
/begin MEASUREMENT hello_xcp.outside_temperature "Temperature in °C read from outside sensor" UBYTE conv.temperature 0 0 -20 50 ECU_ADDRESS 0x5029A ECU_ADDRESS_EXTENSION 129 READ_WRITE
 /begin IF_DATA XCP
  /begin DAQ_EVENT FIXED_EVENT_LIST EVENT 0x2 /end DAQ_EVENT
 /end IF_DATA
/end MEASUREMENT
/begin MEASUREMENT hello_xcp.inside_temperature "Temperature in °C read from inside sensor" UBYTE conv.temperature 0 0 0 40 ECU_ADDRESS 0x5029B ECU_ADDRESS_EXTENSION 129 READ_WRITE
 /begin IF_DATA XCP
  /begin DAQ_EVENT FIXED_EVENT_LIST EVENT 0x2 /end DAQ_EVENT
 /end IF_DATA
/end MEASUREMENT
/begin MEASUREMENT hello_xcp.heat_energy "Accumulated heat energy in kWh" FLOAT64_IEEE NO_COMPU_METHOD 0 0 0 10000 ECU_ADDRESS 0x502F0 ECU_ADDRESS_EXTENSION 129 PHYS_UNIT "kWh" READ_WRITE
 /begin IF_DATA XCP
  /begin DAQ_EVENT FIXED_EVENT_LIST EVENT 0x2 /end DAQ_EVENT
 /end IF_DATA
/end MEASUREMENT
/begin MEASUREMENT hello_xcp.global_counter "Global free running counter" ULONG NO_COMPU_METHOD 0 0 0 4.29497e+09 ECU_ADDRESS 0x502F8 ECU_ADDRESS_EXTENSION 129 READ_WRITE
 /begin IF_DATA XCP
  /begin DAQ_EVENT FIXED_EVENT_LIST EVENT 0x2 /end DAQ_EVENT
 /end IF_DATA
/end MEASUREMENT
/begin MEASUREMENT hello_xcp.counter "Mainloop counter" UWORD NO_COMPU_METHOD 0 0 0 65535 ECU_ADDRESS 0x81001E ECU_ADDRESS_EXTENSION 2 READ_WRITE
 /begin IF_DATA XCP
  /begin DAQ_EVENT FIXED_EVENT_LIST EVENT 0x2 /end DAQ_EVENT
 /end IF_DATA
/end MEASUREMENT
/begin GROUP hello_xcp.params "Calibration Segment" ROOT
 /begin REF_CHARACTERISTIC hello_xcp.params.counter_max hello_xcp.params.delay_us hello_xcp.params.flow_rate /end REF_CHARACTERISTIC
/end GROUP
/begin GROUP hello_xcp.calc_power "Measurement event group"
 /begin REF_MEASUREMENT hello_xcp.t1 hello_xcp.t2 hello_xcp.diff_temp hello_xcp.heat_power /end REF_MEASUREMENT
/end GROUP
/begin GROUP hello_xcp.mainloop "Measurement event group"
 /begin REF_MEASUREMENT hello_xcp.outside_temperature hello_xcp.inside_temperature hello_xcp.heat_energy hello_xcp.global_counter hello_xcp.counter /end REF_MEASUREMENT
/end GROUP
/begin COMPU_METHOD conv.temperature "Temperature in °C from unsigned byte" LINEAR "%6.3" "C" COEFFS_LINEAR 1 -55 /end COMPU_METHOD
/* #include "hello_xcp_cpp_104.a2l" */
/begin TYPEDEF_STRUCTURE hello_xcp_cpp.ParametersT "Typedef for ParametersT" 0x78 /begin STRUCTURE_COMPONENT map C_map 0x18 /end STRUCTURE_COMPONENT /begin STRUCTURE_COMPONENT axis A_axis 0x58 /end STRUCTURE_COMPONENT /begin STRUCTURE_COMPONENT curve C_curve 0x38 /end STRUCTURE_COMPONENT /begin STRUCTURE_COMPONENT min C_min 0x8 /end STRUCTURE_COMPONENT /begin STRUCTURE_COMPONENT max C_max 0x10 /end STRUCTURE_COMPONENT /begin STRUCTURE_COMPONENT counter_max C_counter_max 0x4 /end STRUCTURE_COMPONENT /begin STRUCTURE_COMPONENT delay_us C_delay_us 0x0 /end STRUCTURE_COMPONENT /end TYPEDEF_STRUCTURE
/begin INSTANCE hello_xcp_cpp.params "Demo calibration parameters for hello_xcp_cpp example" hello_xcp_cpp.ParametersT 0x80020000 /end INSTANCE
/begin TYPEDEF_STRUCTURE hello_xcp_cpp.FloatingAverage "Typedef for FloatingAverage" 0x218 /begin STRUCTURE_COMPONENT current_index_ M_current_index_ 0x0 /end STRUCTURE_COMPONENT /begin STRUCTURE_COMPONENT sample_count_ M_sample_count_ 0x8 /end STRUCTURE_COMPONENT /begin STRUCTURE_COMPONENT sum_ M_sum_ 0x10 /end STRUCTURE_COMPONENT /begin STRUCTURE_COMPONENT samples_ M_samples_ 0x18 MATRIX_DIM 64 /end STRUCTURE_COMPONENT /end TYPEDEF_STRUCTURE
/begin MEASUREMENT hello_xcp_cpp.input "Input value for floating average" FLOAT64_IEEE NO_COMPU_METHOD 0 0 0 1000 ECU_ADDRESS 0xC00000 ECU_ADDRESS_EXTENSION 3 PHYS_UNIT "V" READ_WRITE
 /begin IF_DATA XCP
  /begin DAQ_EVENT FIXED_EVENT_LIST EVENT 0x3 /end DAQ_EVENT
 /end IF_DATA
/end MEASUREMENT
/begin MEASUREMENT hello_xcp_cpp.average "Current calculated average" FLOAT64_IEEE NO_COMPU_METHOD 0 0 -1e+12 1e+12 ECU_ADDRESS 0xC00000 ECU_ADDRESS_EXTENSION 4 READ_WRITE
 /begin IF_DATA XCP
  /begin DAQ_EVENT FIXED_EVENT_LIST EVENT 0x3 /end DAQ_EVENT
 /end IF_DATA
/end MEASUREMENT
/begin MEASUREMENT hello_xcp_cpp.current_index_ "Current position in ring buffer" A_UINT64 NO_COMPU_METHOD 0 0 0 1e+12 ECU_ADDRESS 0xC00000 ECU_ADDRESS_EXTENSION 5 READ_WRITE
 /begin IF_DATA XCP
  /begin DAQ_EVENT FIXED_EVENT_LIST EVENT 0x3 /end DAQ_EVENT
 /end IF_DATA
/end MEASUREMENT
/begin MEASUREMENT hello_xcp_cpp.sample_count_ "Number of samples collected" UBYTE NO_COMPU_METHOD 0 0 0 255 ECU_ADDRESS 0xC00000 ECU_ADDRESS_EXTENSION 6 READ_WRITE
 /begin IF_DATA XCP
  /begin DAQ_EVENT FIXED_EVENT_LIST EVENT 0x3 /end DAQ_EVENT
 /end IF_DATA
/end MEASUREMENT
/begin MEASUREMENT hello_xcp_cpp.sum_ "Running sum of all samples" FLOAT64_IEEE NO_COMPU_METHOD 0 0 -1e+12 1e+12 ECU_ADDRESS 0xC00000 ECU_ADDRESS_EXTENSION 7 READ_WRITE
 /begin IF_DATA XCP
  /begin DAQ_EVENT FIXED_EVENT_LIST EVENT 0x3 /end DAQ_EVENT
 /end IF_DATA
/end MEASUREMENT
/begin INSTANCE hello_xcp_cpp.FloatingAverage "This instance of FloatingAverage" hello_xcp_cpp.FloatingAverage 0xC00000 ECU_ADDRESS_EXTENSION 8 READ_WRITE
 /begin IF_DATA XCP
  /begin DAQ_EVENT FIXED_EVENT_LIST EVENT 0x3 /end DAQ_EVENT
 /end IF_DATA
/end INSTANCE
/begin MEASUREMENT hello_xcp_cpp.global_counter "Global counter variable" UWORD NO_COMPU_METHOD 0 0 0 65535 ECU_ADDRESS 0x1000000 ECU_ADDRESS_EXTENSION 3 READ_WRITE
 /begin IF_DATA XCP
  /begin DAQ_EVENT FIXED_EVENT_LIST EVENT 0x4 /end DAQ_EVENT
 /end IF_DATA
/end MEASUREMENT
/begin MEASUREMENT hello_xcp_cpp.counter "Local counter variable" UWORD NO_COMPU_METHOD 0 0 0 65535 ECU_ADDRESS 0x1000000 ECU_ADDRESS_EXTENSION 4 READ_WRITE
 /begin IF_DATA XCP
  /begin DAQ_EVENT FIXED_EVENT_LIST EVENT 0x4 /end DAQ_EVENT
 /end IF_DATA
/end MEASUREMENT
/begin MEASUREMENT hello_xcp_cpp.input_voltage "Input voltage" FLOAT64_IEEE NO_COMPU_METHOD 0 0 -100 100 ECU_ADDRESS 0x1000000 ECU_ADDRESS_EXTENSION 5 PHYS_UNIT "V" READ_WRITE
 /begin IF_DATA XCP
  /begin DAQ_EVENT FIXED_EVENT_LIST EVENT 0x4 /end DAQ_EVENT
 /end IF_DATA
/end MEASUREMENT
/begin MEASUREMENT hello_xcp_cpp.average_voltage "Calculated average voltage on input_voltage" FLOAT64_IEEE NO_COMPU_METHOD 0 0 -100 100 ECU_ADDRESS 0x1000000 ECU_ADDRESS_EXTENSION 6 PHYS_UNIT "V" READ_WRITE
 /begin IF_DATA XCP
  /begin DAQ_EVENT FIXED_EVENT_LIST EVENT 0x4 /end DAQ_EVENT
 /end IF_DATA
/end MEASUREMENT
/begin INSTANCE hello_xcp_cpp.average_filter "Local (stack) instance of FloatingAverage<128>" hello_xcp_cpp.FloatingAverage 0x1000000 ECU_ADDRESS_EXTENSION 7 READ_WRITE
 /begin IF_DATA XCP
  /begin DAQ_EVENT FIXED_EVENT_LIST EVENT 0x4 /end DAQ_EVENT
 /end IF_DATA
/end INSTANCE
/begin TYPEDEF_CHARACTERISTIC C_map "Demo map" MAP U8 0 NO_COMPU_METHOD 0 100
 /begin AXIS_DESCR FIX_AXIS NO_INPUT_QUANTITY NO_COMPU_METHOD 4 0 3 FIX_AXIS_PAR_DIST 0 1 4 /end AXIS_DESCR
 /begin AXIS_DESCR FIX_AXIS NO_INPUT_QUANTITY NO_COMPU_METHOD 8 0 7 FIX_AXIS_PAR_DIST 0 1 8 /end AXIS_DESCR
/end TYPEDEF_CHARACTERISTIC
/begin TYPEDEF_AXIS A_axis "Demo axis" NO_INPUT_QUANTITY A_U16 0 NO_COMPU_METHOD 16 0 100 /end TYPEDEF_AXIS
/begin TYPEDEF_CHARACTERISTIC C_curve "Demo curve" CURVE U16 0 NO_COMPU_METHOD 0 2000
 /begin AXIS_DESCR FIX_AXIS NO_INPUT_QUANTITY NO_COMPU_METHOD 16 0 15 FIX_AXIS_PAR_DIST 0 1 16 /end AXIS_DESCR
/end TYPEDEF_CHARACTERISTIC
/begin TYPEDEF_CHARACTERISTIC C_min "Minimum random number value" VALUE F64 0 NO_COMPU_METHOD -100 100 /end TYPEDEF_CHARACTERISTIC
/begin TYPEDEF_CHARACTERISTIC C_max "Maximum random number value" VALUE F64 0 NO_COMPU_METHOD -100 100 /end TYPEDEF_CHARACTERISTIC
/begin TYPEDEF_CHARACTERISTIC C_counter_max "Maximum counter value" VALUE U16 0 NO_COMPU_METHOD 0 65535 /end TYPEDEF_CHARACTERISTIC
/begin TYPEDEF_CHARACTERISTIC C_delay_us "Mainloop delay time in us" VALUE U32 0 NO_COMPU_METHOD 0 500000 PHYS_UNIT "us" /end TYPEDEF_CHARACTERISTIC
/begin TYPEDEF_MEASUREMENT M_current_index_ "Current position in the ring buffer" A_UINT64 NO_COMPU_METHOD 0 0 0 1e+12 /end TYPEDEF_MEASUREMENT
/begin TYPEDEF_MEASUREMENT M_sample_count_ "Number of samples collected so far" UBYTE NO_COMPU_METHOD 0 0 0 255 /end TYPEDEF_MEASUREMENT
/begin TYPEDEF_MEASUREMENT M_sum_ "Running sum of all samples" FLOAT64_IEEE NO_COMPU_METHOD 0 0 -1e+12 1e+12 /end TYPEDEF_MEASUREMENT
/begin TYPEDEF_MEASUREMENT M_samples_ "Ring buffer for samples" FLOAT64_IEEE NO_COMPU_METHOD 0 0 -1e+12 1e+12 /end TYPEDEF_MEASUREMENT
/begin GROUP hello_xcp_cpp.params "Calibration Segment" ROOT /begin REF_CHARACTERISTIC hello_xcp_cpp.params /end REF_CHARACTERISTIC /end GROUP
/begin GROUP hello_xcp_cpp.calcAvg "Measurement event group"
 /begin REF_MEASUREMENT hello_xcp_cpp.input hello_xcp_cpp.average hello_xcp_cpp.current_index_ hello_xcp_cpp.sample_count_ hello_xcp_cpp.sum_ hello_xcp_cpp.FloatingAverage /end REF_MEASUREMENT
/end GROUP
/begin GROUP hello_xcp_cpp.mainloop "Measurement event group"
 /begin REF_MEASUREMENT hello_xcp_cpp.global_counter hello_xcp_cpp.counter hello_xcp_cpp.input_voltage hello_xcp_cpp.average_voltage hello_xcp_cpp.average_filter /end REF_MEASUREMENT
/end GROUP
/begin COMPU_METHOD conv.events "" TAB_VERB "%.0 " "" COMPU_TAB_REF conv.events.table /end COMPU_METHOD
/begin COMPU_VTAB conv.events.table "" TAB_VERB 5 0 "xcpdaemon.xcpdaemon" 1 "hello_xcp.calc_power" 2 "hello_xcp.mainloop" 3 "hello_xcp_cpp.calcAvg" 4 "hello_xcp_cpp.mainloop" /end COMPU_VTAB
/begin GROUP Events "Events" ROOT
 /begin SUB_GROUP xcpdaemon.xcpdaemon hello_xcp.calc_power hello_xcp.mainloop hello_xcp_cpp.calcAvg hello_xcp_cpp.mainloop /end SUB_GROUP
/end GROUP
/begin MOD_PAR "" EPK "430e1943eb1c2ce0" ADDR_EPK 0x80000000
 /begin MEMORY_SEGMENT epk "" DATA FLASH INTERN 0x80000000 32 -1 -1 -1 -1 -1
  /begin IF_DATA XCP
   /begin SEGMENT 0 2 0 0 0 /begin CHECKSUM XCP_CRC_16_CITT MAX_BLOCK_SIZE 0xFFFF EXTERNAL_FUNCTION "" /end CHECKSUM
    /begin PAGE 0 ECU_ACCESS_DONT_CARE XCP_READ_ACCESS_DONT_CARE XCP_WRITE_ACCESS_DONT_CARE /end PAGE
    /begin PAGE 1 ECU_ACCESS_DONT_CARE XCP_READ_ACCESS_DONT_CARE XCP_WRITE_ACCESS_NOT_ALLOWED /end PAGE
   /end SEGMENT
  /end IF_DATA
 /end MEMORY_SEGMENT
 /begin MEMORY_SEGMENT hello_xcp.params "" DATA FLASH INTERN 0x80010000 12 -1 -1 -1 -1 -1
  /begin IF_DATA XCP
   /begin SEGMENT 1 2 0 0 0 /begin CHECKSUM XCP_CRC_16_CITT MAX_BLOCK_SIZE 0xFFFF EXTERNAL_FUNCTION "" /end CHECKSUM
    /begin PAGE 0 ECU_ACCESS_DONT_CARE XCP_READ_ACCESS_DONT_CARE XCP_WRITE_ACCESS_DONT_CARE /end PAGE
    /begin PAGE 1 ECU_ACCESS_DONT_CARE XCP_READ_ACCESS_DONT_CARE XCP_WRITE_ACCESS_NOT_ALLOWED /end PAGE
   /end SEGMENT
  /end IF_DATA
 /end MEMORY_SEGMENT
 /begin MEMORY_SEGMENT hello_xcp_cpp.params "" DATA FLASH INTERN 0x80020000 120 -1 -1 -1 -1 -1
  /begin IF_DATA XCP
   /begin SEGMENT 2 2 0 0 0 /begin CHECKSUM XCP_CRC_16_CITT MAX_BLOCK_SIZE 0xFFFF EXTERNAL_FUNCTION "" /end CHECKSUM
    /begin PAGE 0 ECU_ACCESS_DONT_CARE XCP_READ_ACCESS_DONT_CARE XCP_WRITE_ACCESS_DONT_CARE /end PAGE
    /begin PAGE 1 ECU_ACCESS_DONT_CARE XCP_READ_ACCESS_DONT_CARE XCP_WRITE_ACCESS_NOT_ALLOWED /end PAGE
   /end SEGMENT
  /end IF_DATA
 /end MEMORY_SEGMENT
/end MOD_PAR
/begin IF_DATA XCP
 /begin PROTOCOL_LAYER 0x104 1000 2000 0 0 0 0 0 248 512 BYTE_ORDER_MSB_LAST ADDRESS_GRANULARITY_BYTE OPTIONAL_CMD GET_COMM_MODE_INFO OPTIONAL_CMD GET_ID OPTIONAL_CMD SET_REQUEST OPTIONAL_CMD SET_MTA OPTIONAL_CMD UPLOAD OPTIONAL_CMD SHORT_UPLOAD OPTIONAL_CMD DOWNLOAD OPTIONAL_CMD SHORT_DOWNLOAD OPTIONAL_CMD GET_CAL_PAGE OPTIONAL_CMD SET_CAL_PAGE OPTIONAL_CMD COPY_CAL_PAGE OPTIONAL_CMD GET_PAG_PROCESSOR_INFO OPTIONAL_CMD GET_SEGMENT_INFO OPTIONAL_CMD GET_PAGE_INFO OPTIONAL_CMD GET_SEGMENT_MODE OPTIONAL_CMD SET_SEGMENT_MODE OPTIONAL_CMD BUILD_CHECKSUM OPTIONAL_CMD USER_CMD OPTIONAL_CMD GET_DAQ_RESOLUTION_INFO OPTIONAL_CMD GET_DAQ_PROCESSOR_INFO OPTIONAL_CMD GET_DAQ_EVENT_INFO OPTIONAL_CMD FREE_DAQ OPTIONAL_CMD ALLOC_DAQ OPTIONAL_CMD ALLOC_ODT OPTIONAL_CMD ALLOC_ODT_ENTRY OPTIONAL_CMD SET_DAQ_PTR OPTIONAL_CMD WRITE_DAQ OPTIONAL_CMD GET_DAQ_LIST_MODE OPTIONAL_CMD SET_DAQ_LIST_MODE OPTIONAL_CMD START_STOP_SYNCH OPTIONAL_CMD START_STOP_DAQ_LIST OPTIONAL_CMD GET_DAQ_CLOCK OPTIONAL_CMD WRITE_DAQ_MULTIPLE OPTIONAL_CMD TIME_CORRELATION_PROPERTIES OPTIONAL_LEVEL1_CMD GET_VERSION /end PROTOCOL_LAYER
 /begin DAQ DYNAMIC 0 5 0 OPTIMISATION_TYPE_DEFAULT ADDRESS_EXTENSION_FREE IDENTIFICATION_FIELD_TYPE_RELATIVE_BYTE GRANULARITY_ODT_ENTRY_SIZE_DAQ_BYTE 0xF8 OVERLOAD_INDICATION_PID /begin TIMESTAMP_SUPPORTED 0x1 SIZE_DWORD UNIT_1NS TIMESTAMP_FIXED /end TIMESTAMP_SUPPORTED
  /begin EVENT "xcpdaemon.xcpdaemon" "xcpdaemo" 0x0 DAQ 0xFF 0 0 0 CONSISTENCY EVENT /end EVENT
  /begin EVENT "hello_xcp.calc_power" "calc_pow" 0x1 DAQ 0xFF 0 0 0 CONSISTENCY EVENT /end EVENT
  /begin EVENT "hello_xcp.mainloop" "mainloop" 0x2 DAQ 0xFF 0 0 0 CONSISTENCY EVENT /end EVENT
  /begin EVENT "hello_xcp_cpp.calcAvg" "calcAvg" 0x3 DAQ 0xFF 0 0 0 CONSISTENCY EVENT /end EVENT
  /begin EVENT "hello_xcp_cpp.mainloop" "mainloop" 0x4 DAQ 0xFF 0 0 0 CONSISTENCY EVENT /end EVENT
 /end DAQ
/end IF_DATA
/end MODULE
/end PROJECT
