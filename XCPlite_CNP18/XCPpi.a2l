/* @@@@ File written by CANAPE_VERSION 18 0 30 @@@@ */ ASAP2_VERSION 1 71
/begin PROJECT XCPlite ""
/begin HEADER "" VERSION "1.0" /end HEADER
/begin MODULE XCPlite ""
/begin MOD_COMMON "" BYTE_ORDER MSB_LAST ALIGNMENT_BYTE 1 ALIGNMENT_WORD 1 ALIGNMENT_LONG 1 ALIGNMENT_INT64 1 ALIGNMENT_FLOAT16_IEEE 1 ALIGNMENT_FLOAT32_IEEE 1 ALIGNMENT_FLOAT64_IEEE 1 /end MOD_COMMON
/begin IF_DATA XCP
 /begin PROTOCOL_LAYER 0x0101 0x03E8 0x2710 0x00 0x00 0x00 0x00 0x00 0xFA 0x0574 BYTE_ORDER_MSB_LAST ADDRESS_GRANULARITY_BYTE OPTIONAL_CMD WRITE_DAQ_MULTIPLE OPTIONAL_CMD ALLOC_ODT_ENTRY OPTIONAL_CMD ALLOC_ODT OPTIONAL_CMD ALLOC_DAQ OPTIONAL_CMD FREE_DAQ OPTIONAL_CMD GET_DAQ_RESOLUTION_INFO OPTIONAL_CMD GET_DAQ_PROCESSOR_INFO OPTIONAL_CMD GET_DAQ_CLOCK OPTIONAL_CMD START_STOP_SYNCH OPTIONAL_CMD START_STOP_DAQ_LIST OPTIONAL_CMD GET_DAQ_LIST_MODE OPTIONAL_CMD SET_DAQ_LIST_MODE OPTIONAL_CMD WRITE_DAQ OPTIONAL_CMD SET_DAQ_PTR OPTIONAL_CMD CLEAR_DAQ_LIST OPTIONAL_CMD DOWNLOAD OPTIONAL_CMD SHORT_UPLOAD OPTIONAL_CMD UPLOAD OPTIONAL_CMD SET_MTA OPTIONAL_CMD GET_ID OPTIONAL_CMD GET_COMM_MODE_INFO /end PROTOCOL_LAYER
 /begin DAQ DYNAMIC 0x00 0x02 0x00 OPTIMISATION_TYPE_DEFAULT ADDRESS_EXTENSION_FREE IDENTIFICATION_FIELD_TYPE_RELATIVE_BYTE GRANULARITY_ODT_ENTRY_SIZE_DAQ_BYTE 0xF8 OVERLOAD_INDICATION_PID /begin TIMESTAMP_SUPPORTED 0x01 SIZE_DWORD UNIT_1US TIMESTAMP_FIXED /end TIMESTAMP_SUPPORTED /begin EVENT "Event1" "Event1" 0x01 DAQ 0xFF 0x01 0x06 0x00 /end EVENT /begin EVENT "Event2" "Event2" 0x02 DAQ 0xFF 0x01 0x06 0x00 /end EVENT /end DAQ
 /begin PAG 0x01 /end PAG
 /begin PGM PGM_MODE_ABSOLUTE 0x00 0x00 /end PGM
 /begin XCP_ON_UDP_IP 0x0100 0x15B3 ADDRESS "172.31.31.195" /end XCP_ON_UDP_IP
/end IF_DATA
/begin MOD_PAR ""
 /begin MEMORY_SEGMENT CALRAM_876c34b0-6a73-463f-af61-5843f024d3ba "" DATA FLASH INTERN 0x0 0xDF -1 -1 -1 -1 -1
  /begin IF_DATA XCP
   /begin SEGMENT 0x00 0x01 0x00 0x00 0x00
    /begin PAGE 0x00 ECU_ACCESS_DONT_CARE XCP_READ_ACCESS_DONT_CARE XCP_WRITE_ACCESS_NOT_ALLOWED /end PAGE
    /begin ADDRESS_MAPPING 0x00 0x025014 0xDF /end ADDRESS_MAPPING
   /end SEGMENT
  /end IF_DATA
 /end MEMORY_SEGMENT
 /begin MEMORY_SEGMENT CALRAM "" DATA RAM INTERN 0x25014 0xDF -1 -1 -1 -1 -1
  /begin IF_DATA XCP
   /begin SEGMENT 0x01 0x01 0x00 0x00 0x00
    /begin PAGE 0x00 ECU_ACCESS_DONT_CARE XCP_READ_ACCESS_DONT_CARE XCP_WRITE_ACCESS_DONT_CARE INIT_SEGMENT 0x00 /end PAGE
   /end SEGMENT
  /end IF_DATA
 /end MEMORY_SEGMENT
/end MOD_PAR
/begin COMPU_METHOD channel1_COMPU_METHOD "" LINEAR "%6.3" "Volt" COEFFS_LINEAR 1 1 /end COMPU_METHOD
/begin COMPU_METHOD timer_COMPU_METHOD "" LINEAR "%6.3" "s" COEFFS_LINEAR 1 0 /end COMPU_METHOD
/begin CHARACTERISTIC ampl "Amplitude" VALUE 0x28018 _FLOAT64_IEEE 0 NO_COMPU_METHOD -1e+12 1e+12 FORMAT "%.15" PHYS_UNIT "V" /end CHARACTERISTIC
/begin CHARACTERISTIC byteArray1 "" VAL_BLK 0x355B0 _UBYTE 0 NO_COMPU_METHOD 0 255 MATRIX_DIM 1400 FORMAT "%.15" /end CHARACTERISTIC
/begin CHARACTERISTIC byteArray10 "" VAL_BLK 0x3861C _UBYTE 0 NO_COMPU_METHOD 0 255 MATRIX_DIM 1400 FORMAT "%.15" /end CHARACTERISTIC
/begin CHARACTERISTIC byteArray11 "" VAL_BLK 0x33544 _UBYTE 0 NO_COMPU_METHOD 0 255 MATRIX_DIM 1400 FORMAT "%.15" /end CHARACTERISTIC
/begin CHARACTERISTIC byteArray12 "" VAL_BLK 0x35038 _UBYTE 0 NO_COMPU_METHOD 0 255 MATRIX_DIM 1400 FORMAT "%.15" /end CHARACTERISTIC
/begin CHARACTERISTIC byteArray13 "" VAL_BLK 0x3BC7C _UBYTE 0 NO_COMPU_METHOD 0 255 MATRIX_DIM 1400 FORMAT "%.15" /end CHARACTERISTIC
/begin CHARACTERISTIC byteArray14 "" VAL_BLK 0x3C1FC _UBYTE 0 NO_COMPU_METHOD 0 255 MATRIX_DIM 1400 FORMAT "%.15" /end CHARACTERISTIC
/begin CHARACTERISTIC byteArray15 "" VAL_BLK 0x3A120 _UBYTE 0 NO_COMPU_METHOD 0 255 MATRIX_DIM 1400 FORMAT "%.15" /end CHARACTERISTIC
/begin CHARACTERISTIC byteArray16 "" VAL_BLK 0x3AC10 _UBYTE 0 NO_COMPU_METHOD 0 255 MATRIX_DIM 1400 FORMAT "%.15" /end CHARACTERISTIC
/begin CHARACTERISTIC byteArray2 "" VAL_BLK 0x3A698 _UBYTE 0 NO_COMPU_METHOD 0 255 MATRIX_DIM 1400 FORMAT "%.15" /end CHARACTERISTIC
/begin CHARACTERISTIC byteArray3 "" VAL_BLK 0x38B94 _UBYTE 0 NO_COMPU_METHOD 0 255 MATRIX_DIM 1400 FORMAT "%.15" /end CHARACTERISTIC
/begin CHARACTERISTIC byteArray4 "" VAL_BLK 0x3B704 _UBYTE 0 NO_COMPU_METHOD 0 255 MATRIX_DIM 1400 FORMAT "%.15" /end CHARACTERISTIC
/begin CHARACTERISTIC byteArray5 "" VAL_BLK 0x3B188 _UBYTE 0 NO_COMPU_METHOD 0 255 MATRIX_DIM 1400 FORMAT "%.15" /end CHARACTERISTIC
/begin CHARACTERISTIC byteArray6 "" VAL_BLK 0x33ABC _UBYTE 0 NO_COMPU_METHOD 0 255 MATRIX_DIM 1400 FORMAT "%.15" /end CHARACTERISTIC
/begin CHARACTERISTIC byteArray7 "" VAL_BLK 0x3C774 _UBYTE 0 NO_COMPU_METHOD 0 255 MATRIX_DIM 1400 FORMAT "%.15" /end CHARACTERISTIC
/begin CHARACTERISTIC byteArray8 "" VAL_BLK 0x370A4 _UBYTE 0 NO_COMPU_METHOD 0 255 MATRIX_DIM 1400 FORMAT "%.15" /end CHARACTERISTIC
/begin CHARACTERISTIC byteArray9 "" VAL_BLK 0x35B28 _UBYTE 0 NO_COMPU_METHOD 0 255 MATRIX_DIM 1400 FORMAT "%.15" /end CHARACTERISTIC
/begin MEASUREMENT byteCounter "" UBYTE NO_COMPU_METHOD 0 0 0 255 ECU_ADDRESS 0x33540 FORMAT "%.15"
 /begin IF_DATA XCP
  /begin DAQ_EVENT FIXED_EVENT_LIST EVENT 0x1 /end DAQ_EVENT
 /end IF_DATA
/end MEASUREMENT
/begin MEASUREMENT channel1 "Demo floating point signal" FLOAT64_IEEE channel1_COMPU_METHOD 0 0 -1e+12 1e+12 ECU_ADDRESS 0x39110
 /begin IF_DATA XCP
  /begin DAQ_EVENT FIXED_EVENT_LIST EVENT 0x1 /end DAQ_EVENT
 /end IF_DATA
/end MEASUREMENT
/begin CHARACTERISTIC curve1_32 "32 byte calibration array" MAP 0x28068 _UBYTE 0 NO_COMPU_METHOD 0 255
 /begin AXIS_DESCR FIX_AXIS NO_INPUT_QUANTITY NO_COMPU_METHOD 32 0 31 READ_ONLY FORMAT "%.15" FIX_AXIS_PAR_DIST 0 1 32 /end AXIS_DESCR
 /begin AXIS_DESCR FIX_AXIS NO_INPUT_QUANTITY NO_COMPU_METHOD 1 0 0 READ_ONLY FORMAT "%.15" FIX_AXIS_PAR_DIST 0 1 1 /end AXIS_DESCR
 FORMAT "%.15" PHYS_UNIT "" /end CHARACTERISTIC
/begin MEASUREMENT dwordCounter "" ULONG NO_COMPU_METHOD 0 0 0 4294967295 ECU_ADDRESS 0x360A0 FORMAT "%.15"
 /begin IF_DATA XCP
  /begin DAQ_EVENT FIXED_EVENT_LIST EVENT 0x1 /end DAQ_EVENT
 /end IF_DATA
/end MEASUREMENT
/begin MEASUREMENT ecu.byte "" UBYTE NO_COMPU_METHOD 0 0 0 255 ECU_ADDRESS 0x0 FORMAT "%.15"
 /begin IF_DATA XCP
  /begin DAQ_EVENT FIXED_EVENT_LIST EVENT 0x3 /end DAQ_EVENT
 /end IF_DATA
/end MEASUREMENT
/begin MEASUREMENT ecu.dword "" ULONG NO_COMPU_METHOD 0 0 0 4294967295 ECU_ADDRESS 0x0 FORMAT "%.15"
 /begin IF_DATA XCP
  /begin DAQ_EVENT FIXED_EVENT_LIST EVENT 0x3 /end DAQ_EVENT
 /end IF_DATA
/end MEASUREMENT
/begin MEASUREMENT ecu.ecuppCounter "" UWORD NO_COMPU_METHOD 0 0 0 65535 ECU_ADDRESS 0x0 FORMAT "%.15"
 /begin IF_DATA XCP
  /begin DAQ_EVENT FIXED_EVENT_LIST EVENT 0x3 /end DAQ_EVENT
 /end IF_DATA
/end MEASUREMENT
/begin MEASUREMENT ecu.word "" UWORD NO_COMPU_METHOD 0 0 0 65535 ECU_ADDRESS 0x0 FORMAT "%.15"
 /begin IF_DATA XCP
  /begin DAQ_EVENT FIXED_EVENT_LIST EVENT 0x3 /end DAQ_EVENT
 /end IF_DATA
/end MEASUREMENT
/begin MEASUREMENT ecuCounter "" UWORD NO_COMPU_METHOD 0 0 0 65535 ECU_ADDRESS 0x280C8 FORMAT "%.15"
 /begin IF_DATA XCP
  /begin DAQ_EVENT FIXED_EVENT_LIST EVENT 0x1 /end DAQ_EVENT
 /end IF_DATA
/end MEASUREMENT
/begin CHARACTERISTIC gCmdCycle "Command handler cycle time" VALUE 0x2809C _ULONG 0 NO_COMPU_METHOD 0 4294967295 FORMAT "%.15" PHYS_UNIT "us" /end CHARACTERISTIC
/begin MEASUREMENT gEcu.ecuppCounter "" UWORD NO_COMPU_METHOD 0 0 0 65535 ECU_ADDRESS 0x525D0 FORMAT "%.15"
 /begin IF_DATA XCP
  /begin DAQ_EVENT FIXED_EVENT_LIST EVENT 0x2 /end DAQ_EVENT
 /end IF_DATA
/end MEASUREMENT
/begin CHARACTERISTIC gExit "Quit application" VALUE 0x280DC _UBYTE 0 NO_COMPU_METHOD 0 255 FORMAT "%.15" PHYS_UNIT "" /end CHARACTERISTIC
/begin CHARACTERISTIC gFlushCycle "Flush cycle time" VALUE 0x280A0 _ULONG 0 NO_COMPU_METHOD 0 4294967295 FORMAT "%.15" PHYS_UNIT "us" /end CHARACTERISTIC
/begin CHARACTERISTIC gTaskCycleTimerECU "ECU cycle time (ns delay)" VALUE 0x280A4 _ULONG 0 NO_COMPU_METHOD 0 4294967295 FORMAT "%.15" PHYS_UNIT "ns" /end CHARACTERISTIC
/begin CHARACTERISTIC gTaskCycleTimerECUpp "ECU cycle time (ns delay)" VALUE 0x280A8 _ULONG 0 NO_COMPU_METHOD 0 4294967295 FORMAT "%.15" PHYS_UNIT "ns" /end CHARACTERISTIC
/begin CHARACTERISTIC gTaskCycleTimerServer "Server loop cycle time (ns delay)" VALUE 0x28098 _ULONG 0 NO_COMPU_METHOD 0 4294967295 FORMAT "%.15" PHYS_UNIT "ns" /end CHARACTERISTIC
/begin CHARACTERISTIC gXcpDebugLevel "Debug verbosity" VALUE 0x280AC _UBYTE 0 NO_COMPU_METHOD 0 255 FORMAT "%.15" PHYS_UNIT "" /end CHARACTERISTIC
/begin CHARACTERISTIC longArray1 "" VAL_BLK 0x39120 _ULONG 0 NO_COMPU_METHOD 0 4294967295 MATRIX_DIM 1024 FORMAT "%.15" /end CHARACTERISTIC
/begin CHARACTERISTIC longArray2 "" VAL_BLK 0x3761C _ULONG 0 NO_COMPU_METHOD 0 4294967295 MATRIX_DIM 1024 FORMAT "%.15" /end CHARACTERISTIC
/begin CHARACTERISTIC longArray3 "" VAL_BLK 0x360A4 _ULONG 0 NO_COMPU_METHOD 0 4294967295 MATRIX_DIM 1024 FORMAT "%.15" /end CHARACTERISTIC
/begin CHARACTERISTIC longArray4 "" VAL_BLK 0x34038 _ULONG 0 NO_COMPU_METHOD 0 4294967295 MATRIX_DIM 1024 FORMAT "%.15" /end CHARACTERISTIC
/begin CHARACTERISTIC map1_8_8 "8*8 byte calibration array" MAP 0x28028 _UBYTE 0 NO_COMPU_METHOD 0 255
 /begin AXIS_DESCR FIX_AXIS NO_INPUT_QUANTITY NO_COMPU_METHOD 8 0 7 READ_ONLY FORMAT "%.15" FIX_AXIS_PAR_DIST 0 1 8 /end AXIS_DESCR
 /begin AXIS_DESCR FIX_AXIS NO_INPUT_QUANTITY NO_COMPU_METHOD 8 0 7 READ_ONLY FORMAT "%.15" FIX_AXIS_PAR_DIST 0 1 8 /end AXIS_DESCR
 FORMAT "%.15" PHYS_UNIT "" /end CHARACTERISTIC
/begin CHARACTERISTIC offset "Offset" VALUE 0x280D0 _FLOAT64_IEEE 0 NO_COMPU_METHOD -1e+12 1e+12 FORMAT "%.15" PHYS_UNIT "V" /end CHARACTERISTIC
/begin CHARACTERISTIC period "Period" VALUE 0x28020 _FLOAT64_IEEE 0 NO_COMPU_METHOD -1e+12 1e+12 FORMAT "%.15" PHYS_UNIT "s" /end CHARACTERISTIC
/begin MEASUREMENT sbyteCounter "" SBYTE NO_COMPU_METHOD 0 0 -128 127 ECU_ADDRESS 0x3C1F4 FORMAT "%.15"
 /begin IF_DATA XCP
  /begin DAQ_EVENT FIXED_EVENT_LIST EVENT 0x1 /end DAQ_EVENT
 /end IF_DATA
/end MEASUREMENT
/begin MEASUREMENT sdwordCounter "" SLONG NO_COMPU_METHOD 0 0 -2147483648 2147483647 ECU_ADDRESS 0x3C1F8 FORMAT "%.15"
 /begin IF_DATA XCP
  /begin DAQ_EVENT FIXED_EVENT_LIST EVENT 0x1 /end DAQ_EVENT
 /end IF_DATA
/end MEASUREMENT
/begin MEASUREMENT swordCounter "" SWORD NO_COMPU_METHOD 0 0 -32768 32767 ECU_ADDRESS 0x34034 FORMAT "%.15"
 /begin IF_DATA XCP
  /begin DAQ_EVENT FIXED_EVENT_LIST EVENT 0x1 /end DAQ_EVENT
 /end IF_DATA
/end MEASUREMENT
/begin MEASUREMENT timer "Time in s" FLOAT64_IEEE timer_COMPU_METHOD 0 0 -1e+12 1e+12 ECU_ADDRESS 0x39118
 /begin IF_DATA XCP
  /begin DAQ_EVENT FIXED_EVENT_LIST EVENT 0x1 /end DAQ_EVENT
 /end IF_DATA
/end MEASUREMENT
/begin MEASUREMENT wordCounter "" UWORD NO_COMPU_METHOD 0 0 0 65535 ECU_ADDRESS 0x3B700 FORMAT "%.15"
 /begin IF_DATA XCP
  /begin DAQ_EVENT FIXED_EVENT_LIST EVENT 0x1 /end DAQ_EVENT
 /end IF_DATA
/end MEASUREMENT
/begin GROUP Arrays "" ROOT
 /begin REF_CHARACTERISTIC byteArray1 byteArray10 byteArray11 byteArray12 byteArray13 byteArray14 byteArray15 byteArray16 byteArray2 byteArray3 byteArray4 byteArray5 byteArray6 byteArray7 byteArray8 byteArray9 longArray1 longArray2 longArray3 longArray4 /end REF_CHARACTERISTIC
/end GROUP
/begin GROUP Test_Parameters "" ROOT
 /begin REF_CHARACTERISTIC gCmdCycle gExit gFlushCycle gTaskCycleTimerECU gTaskCycleTimerECUpp gTaskCycleTimerServer gXcpDebugLevel /end REF_CHARACTERISTIC
/end GROUP
/begin TYPEDEF_MEASUREMENT Measurement_SWord "" SWORD NO_COMPU_METHOD 0 0 -32768 32767 /end TYPEDEF_MEASUREMENT
/begin TYPEDEF_MEASUREMENT Measurement_UByte "" UBYTE NO_COMPU_METHOD 0 0 0 255 /end TYPEDEF_MEASUREMENT
/begin TYPEDEF_MEASUREMENT Measurement_ULong "" ULONG NO_COMPU_METHOD 0 0 0 4294967295 /end TYPEDEF_MEASUREMENT
/begin TYPEDEF_MEASUREMENT Measurement_UWord "" UWORD NO_COMPU_METHOD 0 0 0 65535 /end TYPEDEF_MEASUREMENT
/begin TYPEDEF_MEASUREMENT _FLOAT64_IEEE "" FLOAT64_IEEE NO_COMPU_METHOD 0 0 -1000000000000 1000000000000 /end TYPEDEF_MEASUREMENT
/begin TYPEDEF_MEASUREMENT _SBYTE "" SBYTE NO_COMPU_METHOD 0 0 -128 127 /end TYPEDEF_MEASUREMENT
/begin TYPEDEF_MEASUREMENT _SLONG "" SLONG NO_COMPU_METHOD 0 0 -2147483648 2147483647 /end TYPEDEF_MEASUREMENT
/begin TYPEDEF_MEASUREMENT _SWORD "" SWORD NO_COMPU_METHOD 0 0 -32768 32767 /end TYPEDEF_MEASUREMENT
/begin TYPEDEF_MEASUREMENT _UBYTE "" UBYTE NO_COMPU_METHOD 0 0 0 255 /end TYPEDEF_MEASUREMENT
/begin TYPEDEF_MEASUREMENT _ULONG "" ULONG NO_COMPU_METHOD 0 0 0 4294967295 /end TYPEDEF_MEASUREMENT
/begin TYPEDEF_MEASUREMENT _UWORD "" UWORD NO_COMPU_METHOD 0 0 0 65535 /end TYPEDEF_MEASUREMENT
/begin TYPEDEF_STRUCTURE ecu "class ecu" 16 SYMBOL_TYPE_LINK "ecu"
 /begin STRUCTURE_COMPONENT ecuppCounter Measurement_UWord 0 SYMBOL_TYPE_LINK "ecuppCounter" /end STRUCTURE_COMPONENT
 /begin STRUCTURE_COMPONENT byte Measurement_UByte 2 SYMBOL_TYPE_LINK "byte" /end STRUCTURE_COMPONENT
 /begin STRUCTURE_COMPONENT word Measurement_UWord 4 SYMBOL_TYPE_LINK "word" /end STRUCTURE_COMPONENT
 /begin STRUCTURE_COMPONENT dword Measurement_ULong 8 SYMBOL_TYPE_LINK "dword" /end STRUCTURE_COMPONENT
 /begin STRUCTURE_COMPONENT sword Measurement_SWord 12 SYMBOL_TYPE_LINK "sword" /end STRUCTURE_COMPONENT
/end TYPEDEF_STRUCTURE
/begin RECORD_LAYOUT _FLOAT64_IEEE FNC_VALUES 1 FLOAT64_IEEE ROW_DIR DIRECT /end RECORD_LAYOUT
/begin RECORD_LAYOUT _SBYTE FNC_VALUES 1 SBYTE ROW_DIR DIRECT /end RECORD_LAYOUT
/begin RECORD_LAYOUT _SLONG FNC_VALUES 1 SLONG ROW_DIR DIRECT /end RECORD_LAYOUT
/begin RECORD_LAYOUT _SWORD FNC_VALUES 1 SWORD ROW_DIR DIRECT /end RECORD_LAYOUT
/begin RECORD_LAYOUT _UBYTE FNC_VALUES 1 UBYTE ROW_DIR DIRECT /end RECORD_LAYOUT
/begin RECORD_LAYOUT _ULONG FNC_VALUES 1 ULONG ROW_DIR DIRECT /end RECORD_LAYOUT
/begin RECORD_LAYOUT _UWORD FNC_VALUES 1 UWORD ROW_DIR DIRECT /end RECORD_LAYOUT
/begin RECORD_LAYOUT __UBYTE_Z FNC_VALUES 1 UBYTE ROW_DIR DIRECT /end RECORD_LAYOUT
/begin RECORD_LAYOUT __UWORD_Z FNC_VALUES 1 UWORD ROW_DIR DIRECT /end RECORD_LAYOUT
/begin RECORD_LAYOUT __ULONG_Z FNC_VALUES 1 ULONG ROW_DIR DIRECT /end RECORD_LAYOUT
/begin RECORD_LAYOUT __SBYTE_Z FNC_VALUES 1 SBYTE ROW_DIR DIRECT /end RECORD_LAYOUT
/begin RECORD_LAYOUT __SWORD_Z FNC_VALUES 1 SWORD ROW_DIR DIRECT /end RECORD_LAYOUT
/begin RECORD_LAYOUT __SLONG_Z FNC_VALUES 1 SLONG ROW_DIR DIRECT /end RECORD_LAYOUT
/begin RECORD_LAYOUT __FLOAT32_IEEE_Z FNC_VALUES 1 FLOAT32_IEEE ROW_DIR DIRECT /end RECORD_LAYOUT
/begin RECORD_LAYOUT __FLOAT64_IEEE_Z FNC_VALUES 1 FLOAT64_IEEE ROW_DIR DIRECT /end RECORD_LAYOUT
/begin RECORD_LAYOUT __UBYTE_S FNC_VALUES 1 UBYTE COLUMN_DIR DIRECT /end RECORD_LAYOUT
/begin RECORD_LAYOUT __UWORD_S FNC_VALUES 1 UWORD COLUMN_DIR DIRECT /end RECORD_LAYOUT
/begin RECORD_LAYOUT __ULONG_S FNC_VALUES 1 ULONG COLUMN_DIR DIRECT /end RECORD_LAYOUT
/begin RECORD_LAYOUT __SBYTE_S FNC_VALUES 1 SBYTE COLUMN_DIR DIRECT /end RECORD_LAYOUT
/begin RECORD_LAYOUT __SWORD_S FNC_VALUES 1 SWORD COLUMN_DIR DIRECT /end RECORD_LAYOUT
/begin RECORD_LAYOUT __SLONG_S FNC_VALUES 1 SLONG COLUMN_DIR DIRECT /end RECORD_LAYOUT
/begin RECORD_LAYOUT __FLOAT32_IEEE_S FNC_VALUES 1 FLOAT32_IEEE COLUMN_DIR DIRECT /end RECORD_LAYOUT
/begin RECORD_LAYOUT __FLOAT64_IEEE_S FNC_VALUES 1 FLOAT64_IEEE COLUMN_DIR DIRECT /end RECORD_LAYOUT
/begin RECORD_LAYOUT SSV__UBYTE_S AXIS_PTS_X 1 UBYTE INDEX_INCR DIRECT /end RECORD_LAYOUT
/begin RECORD_LAYOUT SSV__UWORD_S AXIS_PTS_X 1 UWORD INDEX_INCR DIRECT /end RECORD_LAYOUT
/begin RECORD_LAYOUT SSV__ULONG_S AXIS_PTS_X 1 ULONG INDEX_INCR DIRECT /end RECORD_LAYOUT
/begin RECORD_LAYOUT SSV__SBYTE_S AXIS_PTS_X 1 SBYTE INDEX_INCR DIRECT /end RECORD_LAYOUT
/begin RECORD_LAYOUT SSV__SWORD_S AXIS_PTS_X 1 SWORD INDEX_INCR DIRECT /end RECORD_LAYOUT
/begin RECORD_LAYOUT SSV__SLONG_S AXIS_PTS_X 1 SLONG INDEX_INCR DIRECT /end RECORD_LAYOUT
/begin RECORD_LAYOUT SSV__FLOAT32_IEEE_S AXIS_PTS_X 1 FLOAT32_IEEE INDEX_INCR DIRECT /end RECORD_LAYOUT
/begin RECORD_LAYOUT SSV__FLOAT64_IEEE_S AXIS_PTS_X 1 FLOAT64_IEEE INDEX_INCR DIRECT /end RECORD_LAYOUT
/begin RECORD_LAYOUT __A_UINT64_Z FNC_VALUES 1 A_UINT64 ROW_DIR DIRECT /end RECORD_LAYOUT
/begin RECORD_LAYOUT __A_INT64_Z FNC_VALUES 1 A_INT64 ROW_DIR DIRECT /end RECORD_LAYOUT
/begin RECORD_LAYOUT __A_UINT64_S FNC_VALUES 1 A_UINT64 COLUMN_DIR DIRECT /end RECORD_LAYOUT
/begin RECORD_LAYOUT __A_INT64_S FNC_VALUES 1 A_INT64 COLUMN_DIR DIRECT /end RECORD_LAYOUT
/begin RECORD_LAYOUT SSV__A_UINT64_S AXIS_PTS_X 1 A_UINT64 INDEX_INCR DIRECT /end RECORD_LAYOUT
/begin RECORD_LAYOUT SSV__A_INT64_S AXIS_PTS_X 1 A_INT64 INDEX_INCR DIRECT /end RECORD_LAYOUT
/end MODULE
/end PROJECT
