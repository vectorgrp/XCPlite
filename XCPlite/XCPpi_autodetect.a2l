/* generated by XCPlite */ ASAP2_VERSION 1 71
/begin PROJECT XCPlite ""
/begin HEADER "" VERSION "1.0" /end HEADER
/begin MODULE XCPlite ""
/include "XCP_104.aml"
/begin MOD_COMMON "" BYTE_ORDER MSB_LAST ALIGNMENT_BYTE 1 ALIGNMENT_WORD 1 ALIGNMENT_LONG 1 ALIGNMENT_FLOAT16_IEEE 1 ALIGNMENT_FLOAT32_IEEE 1 ALIGNMENT_FLOAT64_IEEE 1 ALIGNMENT_INT64 1 /end MOD_COMMON
/begin IF_DATA XCP
 /begin PROTOCOL_LAYER 0x0103 0x03E8 0x2710 0x00 0x00 0x00 0x00 0x00 0xFA 0x0574 BYTE_ORDER_MSB_LAST ADDRESS_GRANULARITY_BYTE OPTIONAL_CMD GET_COMM_MODE_INFO OPTIONAL_CMD GET_ID OPTIONAL_CMD SET_MTA OPTIONAL_CMD UPLOAD OPTIONAL_CMD SHORT_UPLOAD OPTIONAL_CMD DOWNLOAD OPTIONAL_CMD SHORT_UPLOAD OPTIONAL_CMD GET_DAQ_RESOLUTION_INFO OPTIONAL_CMD GET_DAQ_PROCESSOR_INFO OPTIONAL_CMD FREE_DAQ OPTIONAL_CMD ALLOC_DAQ OPTIONAL_CMD ALLOC_ODT OPTIONAL_CMD ALLOC_ODT_ENTRY OPTIONAL_CMD SET_DAQ_PTR OPTIONAL_CMD WRITE_DAQ OPTIONAL_CMD WRITE_DAQ_MULTIPLE OPTIONAL_CMD GET_DAQ_LIST_MODE OPTIONAL_CMD SET_DAQ_LIST_MODE OPTIONAL_CMD START_STOP_SYNCH OPTIONAL_CMD START_STOP_DAQ_LIST OPTIONAL_CMD GET_DAQ_CLOCK OPTIONAL_LEVEL1_CMD GET_VERSION /end PROTOCOL_LAYER
 /begin DAQ DYNAMIC 0x00 0x03 0x00 OPTIMISATION_TYPE_DEFAULT ADDRESS_EXTENSION_FREE IDENTIFICATION_FIELD_TYPE_RELATIVE_BYTE GRANULARITY_ODT_ENTRY_SIZE_DAQ_BYTE 0xF8 OVERLOAD_INDICATION_PID /begin TIMESTAMP_SUPPORTED 0x01 SIZE_DWORD UNIT_1US TIMESTAMP_FIXED /end TIMESTAMP_SUPPORTED /begin EVENT "EcuCyclic" "EcuCyclic" 0x1 DAQ 0xFF 0x01 0x06 0x00 /end EVENT /begin EVENT "EcuTask1" "EcuTask1" 0x2 DAQ 0xFF 0x01 0x06 0x00 /end EVENT /begin EVENT "EcuTask2" "EcuTask2" 0x3 DAQ 0xFF 0x01 0x06 0x00 /end EVENT
  /begin EVENT "activeEcuTask" "activeEcuTask" 0x4 DAQ 0xFF 0x01 0x06 0x00 /end EVENT
 /end DAQ
 /begin PAG 0x00 /end PAG
 /begin PGM PGM_MODE_ABSOLUTE 0x00 0x00 /end PGM
 /begin XCP_ON_UDP_IP 0x0103 0x15B3 ADDRESS "172.31.31.194" /end XCP_ON_UDP_IP
/end IF_DATA
/begin CHARACTERISTIC gFlushCycle "DAQ queue flush cycle time" VALUE 0x8FB0D4 _ULONG 0 NO_COMPU_METHOD 0 4294967295 PHYS_UNIT "us" /end CHARACTERISTIC
/begin CHARACTERISTIC gCmdCycle "XCP command handler cycle time" VALUE 0x8FB0D8 _ULONG 0 NO_COMPU_METHOD 0 4294967295 PHYS_UNIT "us" /end CHARACTERISTIC
/begin CHARACTERISTIC gTransmitCycle "DAQ transmit cycle time" VALUE 0x8FB0DC _ULONG 0 NO_COMPU_METHOD 0 4294967295 PHYS_UNIT "us" /end CHARACTERISTIC
/begin CHARACTERISTIC gTaskCycleTimerServer "Server thread sleep time" VALUE 0x8FB0E0 _ULONG 0 NO_COMPU_METHOD 0 4294967295 PHYS_UNIT "ns" /end CHARACTERISTIC
/begin GROUP Server_Parameters "" /begin REF_CHARACTERISTIC gFlushCycle gCmdCycle gTransmitCycle gTaskCycleTimerServer /end REF_CHARACTERISTIC /end GROUP
/begin TYPEDEF_STRUCTURE EcuTask "TYPEDEF for class EcuTask" 0x58 SYMBOL_TYPE_LINK "EcuTask" /begin STRUCTURE_COMPONENT taskId _ULONG 0x0 SYMBOL_TYPE_LINK "taskId" /end STRUCTURE_COMPONENT /begin STRUCTURE_COMPONENT counter _UWORD 0x4 SYMBOL_TYPE_LINK "counter" /end STRUCTURE_COMPONENT /begin STRUCTURE_COMPONENT channel1 _FLOAT64_IEEE 0x10 SYMBOL_TYPE_LINK "channel1" /end STRUCTURE_COMPONENT /begin STRUCTURE_COMPONENT byte _UBYTE 0x38 SYMBOL_TYPE_LINK "byte" /end STRUCTURE_COMPONENT /begin STRUCTURE_COMPONENT word _UWORD 0x3A SYMBOL_TYPE_LINK "word" /end STRUCTURE_COMPONENT /begin STRUCTURE_COMPONENT dword _ULONG 0x3C SYMBOL_TYPE_LINK "dword" /end STRUCTURE_COMPONENT /end TYPEDEF_STRUCTURE
/begin INSTANCE ecuTask1 "" EcuTask 0xB5D290
 /begin IF_DATA XCP
  /begin DAQ_EVENT FIXED_EVENT_LIST EVENT 0x2 /end DAQ_EVENT
 /end IF_DATA
/end INSTANCE
/begin INSTANCE ecuTask2 "" EcuTask 0xB5D318
 /begin IF_DATA XCP
  /begin DAQ_EVENT FIXED_EVENT_LIST EVENT 0x3 /end DAQ_EVENT
 /end IF_DATA
/end INSTANCE
/begin INSTANCE activeEcuTask "" EcuTask 0x0
 /begin IF_DATA XCP
  /begin DAQ_EVENT FIXED_EVENT_LIST EVENT 0x4 /end DAQ_EVENT
 /end IF_DATA
/end INSTANCE
/begin MEASUREMENT ecuCounter "" UWORD NO_COMPU_METHOD 0 0 0 65535 ECU_ADDRESS 0x8FB3F0
 /begin IF_DATA XCP
  /begin DAQ_EVENT FIXED_EVENT_LIST EVENT 0x1 /end DAQ_EVENT
 /end IF_DATA
/end MEASUREMENT
/begin COMPU_METHOD timer_COMPU_METHOD "" LINEAR "%6.3" "s" COEFFS_LINEAR 1 0 /end COMPU_METHOD
/begin MEASUREMENT timer "Time in s" FLOAT64_IEEE timer_COMPU_METHOD 0 0 -1E12 1E12 ECU_ADDRESS 0x9330A0
 /begin IF_DATA XCP
  /begin DAQ_EVENT FIXED_EVENT_LIST EVENT 0x1 /end DAQ_EVENT
 /end IF_DATA
/end MEASUREMENT
/begin COMPU_METHOD channel1_COMPU_METHOD "" LINEAR "%6.3" "V" COEFFS_LINEAR 1 0 /end COMPU_METHOD
/begin MEASUREMENT channel1 "Demo sine wave signal" FLOAT64_IEEE channel1_COMPU_METHOD 0 0 -1E12 1E12 ECU_ADDRESS 0x933098
 /begin IF_DATA XCP
  /begin DAQ_EVENT FIXED_EVENT_LIST EVENT 0x1 /end DAQ_EVENT
 /end IF_DATA
/end MEASUREMENT
/begin CHARACTERISTIC ampl "Amplitude" VALUE 0x8FB038 _FLOAT64_IEEE 0 NO_COMPU_METHOD 0 100 PHYS_UNIT "V" /end CHARACTERISTIC
/begin CHARACTERISTIC offset "Offset" VALUE 0x8FB3F8 _FLOAT64_IEEE 0 NO_COMPU_METHOD -50 50 PHYS_UNIT "V" /end CHARACTERISTIC
/begin CHARACTERISTIC period "Period" VALUE 0x8FB030 _FLOAT64_IEEE 0 NO_COMPU_METHOD 0 10 PHYS_UNIT "s" /end CHARACTERISTIC
/begin CHARACTERISTIC map1_8_8 "8*8 byte calibration array" MAP 0x8FB040 _UBYTE 0 NO_COMPU_METHOD 0 255
 /begin AXIS_DESCR FIX_AXIS NO_INPUT_QUANTITY NO_COMPU_METHOD 8 0 7 FIX_AXIS_PAR_DIST 0 1 8 /end AXIS_DESCR
 /begin AXIS_DESCR FIX_AXIS NO_INPUT_QUANTITY NO_COMPU_METHOD 8 0 7 FIX_AXIS_PAR_DIST 0 1 8 /end AXIS_DESCR
 PHYS_UNIT "" CHARACTERISTIC curve1_32 "32 byte calibration array" MAP 0x8FB080 _UBYTE 0 NO_COMPU_METHOD 0 255
 /begin AXIS_DESCR FIX_AXIS NO_INPUT_QUANTITY NO_COMPU_METHOD 32 0 31 FIX_AXIS_PAR_DIST 0 1 32 /end AXIS_DESCR
 /begin AXIS_DESCR FIX_AXIS NO_INPUT_QUANTITY NO_COMPU_METHOD 1 0 0 FIX_AXIS_PAR_DIST 0 1 1 /end AXIS_DESCR
 PHYS_UNIT "" MEASUREMENT byteCounter "" UBYTE NO_COMPU_METHOD 0 0 0 255 ECU_ADDRESS 0x929896
 /begin IF_DATA XCP
  /begin DAQ_EVENT FIXED_EVENT_LIST EVENT 0x1 /end DAQ_EVENT
 /end IF_DATA
 /begin MEASUREMENT wordCounter "" UWORD NO_COMPU_METHOD 0 0 0 65535 ECU_ADDRESS 0x929894
  /begin IF_DATA XCP
   /begin DAQ_EVENT FIXED_EVENT_LIST EVENT 0x1 /end DAQ_EVENT
  /end IF_DATA
 /end MEASUREMENT
 /begin MEASUREMENT dwordCounter "" ULONG NO_COMPU_METHOD 0 0 0 4294967295 ECU_ADDRESS 0x929890
  /begin IF_DATA XCP
   /begin DAQ_EVENT FIXED_EVENT_LIST EVENT 0x1 /end DAQ_EVENT
  /end IF_DATA
 /end MEASUREMENT
 /begin MEASUREMENT sbyteCounter "" SBYTE NO_COMPU_METHOD 0 0 -128 127 ECU_ADDRESS 0x92988C
  /begin IF_DATA XCP
   /begin DAQ_EVENT FIXED_EVENT_LIST EVENT 0x1 /end DAQ_EVENT
  /end IF_DATA
 /end MEASUREMENT
 /begin MEASUREMENT swordCounter "" SWORD NO_COMPU_METHOD 0 0 -32768 32767 ECU_ADDRESS 0x92988A
  /begin IF_DATA XCP
   /begin DAQ_EVENT FIXED_EVENT_LIST EVENT 0x1 /end DAQ_EVENT
  /end IF_DATA
 /end MEASUREMENT
 /begin MEASUREMENT sdwordCounter "" SLONG NO_COMPU_METHOD 0 0 -2147483648 2147483647 ECU_ADDRESS 0x927A2C
  /begin IF_DATA XCP
   /begin DAQ_EVENT FIXED_EVENT_LIST EVENT 0x1 /end DAQ_EVENT
  /end IF_DATA
 /end MEASUREMENT
 /begin CHARACTERISTIC byteArray1 "" VAL_BLK 0x932B20 _UBYTE 0 NO_COMPU_METHOD 0 255 MATRIX_DIM 1400
  /begin IF_DATA XCP
   /begin DAQ_EVENT FIXED_EVENT_LIST EVENT 0x1 /end DAQ_EVENT
  /end IF_DATA
 /end CHARACTERISTIC
 /begin CHARACTERISTIC byteArray2 "" VAL_BLK 0x9325A0 _UBYTE 0 NO_COMPU_METHOD 0 255 MATRIX_DIM 1400
  /begin IF_DATA XCP
   /begin DAQ_EVENT FIXED_EVENT_LIST EVENT 0x1 /end DAQ_EVENT
  /end IF_DATA
 /end CHARACTERISTIC
 /begin CHARACTERISTIC byteArray3 "" VAL_BLK 0x932020 _UBYTE 0 NO_COMPU_METHOD 0 255 MATRIX_DIM 1400
  /begin IF_DATA XCP
   /begin DAQ_EVENT FIXED_EVENT_LIST EVENT 0x1 /end DAQ_EVENT
  /end IF_DATA
 /end CHARACTERISTIC
 /begin CHARACTERISTIC byteArray4 "" VAL_BLK 0x931AA0 _UBYTE 0 NO_COMPU_METHOD 0 255 MATRIX_DIM 1400
  /begin IF_DATA XCP
   /begin DAQ_EVENT FIXED_EVENT_LIST EVENT 0x1 /end DAQ_EVENT
  /end IF_DATA
 /end CHARACTERISTIC
 /begin CHARACTERISTIC byteArray5 "" VAL_BLK 0x931520 _UBYTE 0 NO_COMPU_METHOD 0 255 MATRIX_DIM 1400
  /begin IF_DATA XCP
   /begin DAQ_EVENT FIXED_EVENT_LIST EVENT 0x1 /end DAQ_EVENT
  /end IF_DATA
 /end CHARACTERISTIC
 /begin CHARACTERISTIC byteArray6 "" VAL_BLK 0x930FA0 _UBYTE 0 NO_COMPU_METHOD 0 255 MATRIX_DIM 1400
  /begin IF_DATA XCP
   /begin DAQ_EVENT FIXED_EVENT_LIST EVENT 0x1 /end DAQ_EVENT
  /end IF_DATA
 /end CHARACTERISTIC
 /begin CHARACTERISTIC byteArray7 "" VAL_BLK 0x930A20 _UBYTE 0 NO_COMPU_METHOD 0 255 MATRIX_DIM 1400
  /begin IF_DATA XCP
   /begin DAQ_EVENT FIXED_EVENT_LIST EVENT 0x1 /end DAQ_EVENT
  /end IF_DATA
 /end CHARACTERISTIC
 /begin CHARACTERISTIC byteArray8 "" VAL_BLK 0x9304A0 _UBYTE 0 NO_COMPU_METHOD 0 255 MATRIX_DIM 1400
  /begin IF_DATA XCP
   /begin DAQ_EVENT FIXED_EVENT_LIST EVENT 0x1 /end DAQ_EVENT
  /end IF_DATA
 /end CHARACTERISTIC
 /begin CHARACTERISTIC byteArray9 "" VAL_BLK 0x92FF20 _UBYTE 0 NO_COMPU_METHOD 0 255 MATRIX_DIM 1400
  /begin IF_DATA XCP
   /begin DAQ_EVENT FIXED_EVENT_LIST EVENT 0x1 /end DAQ_EVENT
  /end IF_DATA
 /end CHARACTERISTIC
 /begin CHARACTERISTIC byteArray10 "" VAL_BLK 0x92F9A0 _UBYTE 0 NO_COMPU_METHOD 0 255 MATRIX_DIM 1400
  /begin IF_DATA XCP
   /begin DAQ_EVENT FIXED_EVENT_LIST EVENT 0x1 /end DAQ_EVENT
  /end IF_DATA
 /end CHARACTERISTIC
 /begin CHARACTERISTIC byteArray11 "" VAL_BLK 0x92F420 _UBYTE 0 NO_COMPU_METHOD 0 255 MATRIX_DIM 1400
  /begin IF_DATA XCP
   /begin DAQ_EVENT FIXED_EVENT_LIST EVENT 0x1 /end DAQ_EVENT
  /end IF_DATA
 /end CHARACTERISTIC
 /begin CHARACTERISTIC byteArray12 "" VAL_BLK 0x92EEA0 _UBYTE 0 NO_COMPU_METHOD 0 255 MATRIX_DIM 1400
  /begin IF_DATA XCP
   /begin DAQ_EVENT FIXED_EVENT_LIST EVENT 0x1 /end DAQ_EVENT
  /end IF_DATA
 /end CHARACTERISTIC
 /begin CHARACTERISTIC byteArray13 "" VAL_BLK 0x92E920 _UBYTE 0 NO_COMPU_METHOD 0 255 MATRIX_DIM 1400
  /begin IF_DATA XCP
   /begin DAQ_EVENT FIXED_EVENT_LIST EVENT 0x1 /end DAQ_EVENT
  /end IF_DATA
 /end CHARACTERISTIC
 /begin CHARACTERISTIC byteArray14 "" VAL_BLK 0x92E3A0 _UBYTE 0 NO_COMPU_METHOD 0 255 MATRIX_DIM 1400
  /begin IF_DATA XCP
   /begin DAQ_EVENT FIXED_EVENT_LIST EVENT 0x1 /end DAQ_EVENT
  /end IF_DATA
 /end CHARACTERISTIC
 /begin CHARACTERISTIC byteArray15 "" VAL_BLK 0x92DE20 _UBYTE 0 NO_COMPU_METHOD 0 255 MATRIX_DIM 1400
  /begin IF_DATA XCP
   /begin DAQ_EVENT FIXED_EVENT_LIST EVENT 0x1 /end DAQ_EVENT
  /end IF_DATA
 /end CHARACTERISTIC
 /begin CHARACTERISTIC byteArray16 "" VAL_BLK 0x92D8A0 _UBYTE 0 NO_COMPU_METHOD 0 255 MATRIX_DIM 1400
  /begin IF_DATA XCP
   /begin DAQ_EVENT FIXED_EVENT_LIST EVENT 0x1 /end DAQ_EVENT
  /end IF_DATA
 /end CHARACTERISTIC
 /begin CHARACTERISTIC longArray1 "" VAL_BLK 0x92C8A0 _ULONG 0 NO_COMPU_METHOD 0 4294967295 MATRIX_DIM 1024
  /begin IF_DATA XCP
   /begin DAQ_EVENT FIXED_EVENT_LIST EVENT 0x1 /end DAQ_EVENT
  /end IF_DATA
 /end CHARACTERISTIC
 /begin CHARACTERISTIC longArray2 "" VAL_BLK 0x92B8A0 _ULONG 0 NO_COMPU_METHOD 0 4294967295 MATRIX_DIM 1024
  /begin IF_DATA XCP
   /begin DAQ_EVENT FIXED_EVENT_LIST EVENT 0x1 /end DAQ_EVENT
  /end IF_DATA
 /end CHARACTERISTIC
 /begin CHARACTERISTIC longArray3 "" VAL_BLK 0x92A8A0 _ULONG 0 NO_COMPU_METHOD 0 4294967295 MATRIX_DIM 1024
  /begin IF_DATA XCP
   /begin DAQ_EVENT FIXED_EVENT_LIST EVENT 0x1 /end DAQ_EVENT
  /end IF_DATA
 /end CHARACTERISTIC
 /begin CHARACTERISTIC longArray4 "" VAL_BLK 0x9298A0 _ULONG 0 NO_COMPU_METHOD 0 4294967295 MATRIX_DIM 1024
  /begin IF_DATA XCP
   /begin DAQ_EVENT FIXED_EVENT_LIST EVENT 0x1 /end DAQ_EVENT
  /end IF_DATA
 /end CHARACTERISTIC
 /begin GROUP Arrays ""
  /begin REF_CHARACTERISTIC byteArray1 byteArray2 byteArray3 byteArray4 byteArray5 byteArray6 byteArray7 byteArray8 byteArray9 byteArray10 byteArray11 byteArray12 byteArray13 byteArray14 byteArray15 byteArray16 longArray1 longArray2 longArray3 longArray4 /end REF_CHARACTERISTIC
 /end GROUP
 /begin CHARACTERISTIC gActiveEcuTaskId "Active ecu task id control" VALUE 0x8FB404 _ULONG 0 NO_COMPU_METHOD 0 4294967295 PHYS_UNIT "" /end CHARACTERISTIC
 /begin CHARACTERISTIC gTaskCycleTimerECU "ECU cycle time (ns delay)" VALUE 0x8FB0BC _ULONG 0 NO_COMPU_METHOD 0 4294967295 PHYS_UNIT "ns" /end CHARACTERISTIC
 /begin CHARACTERISTIC gTaskCycleTimerECUpp "ECU cycle time (ns delay)" VALUE 0x8FB0C0 _ULONG 0 NO_COMPU_METHOD 0 4294967295 PHYS_UNIT "ns" /end CHARACTERISTIC
 /begin CHARACTERISTIC gXcpDebugLevel "Console output verbosity" VALUE 0x8FB0F6 _UBYTE 0 NO_COMPU_METHOD 0 255 PHYS_UNIT "" /end CHARACTERISTIC
 /begin GROUP Demo_Parameters ""
  /begin REF_CHARACTERISTIC gActiveEcuTaskId gTaskCycleTimerECU gTaskCycleTimerECUpp gXcpDebugLevel /end REF_CHARACTERISTIC
 /end GROUP
 /begin RECORD_LAYOUT _SLONG FNC_VALUES 1 SLONG ROW_DIR DIRECT /end RECORD_LAYOUT
 /begin RECORD_LAYOUT _SWORD FNC_VALUES 1 SWORD ROW_DIR DIRECT /end RECORD_LAYOUT
 /begin RECORD_LAYOUT _SBYTE FNC_VALUES 1 SBYTE ROW_DIR DIRECT /end RECORD_LAYOUT
 /begin RECORD_LAYOUT _UBYTE FNC_VALUES 1 UBYTE ROW_DIR DIRECT /end RECORD_LAYOUT
 /begin RECORD_LAYOUT _UWORD FNC_VALUES 1 UWORD ROW_DIR DIRECT /end RECORD_LAYOUT
 /begin RECORD_LAYOUT _ULONG FNC_VALUES 1 ULONG ROW_DIR DIRECT /end RECORD_LAYOUT
 /begin RECORD_LAYOUT _FLOAT64_IEEE FNC_VALUES 1 FLOAT64_IEEE ROW_DIR DIRECT /end RECORD_LAYOUT
 /begin TYPEDEF_MEASUREMENT _SLONG "" SLONG NO_COMPU_METHOD 0 0 -2147483648 2147483647 /end TYPEDEF_MEASUREMENT
 /begin TYPEDEF_MEASUREMENT _SWORD "" SWORD NO_COMPU_METHOD 0 0 -32768 32767 /end TYPEDEF_MEASUREMENT
 /begin TYPEDEF_MEASUREMENT _SBYTE "" SBYTE NO_COMPU_METHOD 0 0 -128 127 /end TYPEDEF_MEASUREMENT
 /begin TYPEDEF_MEASUREMENT _UBYTE "" UBYTE NO_COMPU_METHOD 0 0 0 255 /end TYPEDEF_MEASUREMENT
 /begin TYPEDEF_MEASUREMENT _UWORD "" UWORD NO_COMPU_METHOD 0 0 0 65535 /end TYPEDEF_MEASUREMENT
 /begin TYPEDEF_MEASUREMENT _ULONG "" ULONG NO_COMPU_METHOD 0 0 0 4294967295 /end TYPEDEF_MEASUREMENT
 /begin TYPEDEF_MEASUREMENT _FLOAT64_IEEE "" FLOAT64_IEEE NO_COMPU_METHOD 0 0 -1E12 1E12 /end TYPEDEF_MEASUREMENT
/end CHARACTERISTIC
/end MODULE
/end PROJECT
