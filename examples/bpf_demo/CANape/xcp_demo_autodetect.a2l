ASAP2_VERSION 1 71
/begin PROJECT bpf_demo ""
/begin HEADER "" VERSION "1.0" PROJECT_NO XCPLITE__CASDD /end HEADER
/begin MODULE bpf_demo ""
/include "XCP_104.aml"
/begin MOD_COMMON "" BYTE_ORDER MSB_LAST ALIGNMENT_BYTE 1 ALIGNMENT_WORD 1 ALIGNMENT_LONG 1 ALIGNMENT_FLOAT16_IEEE 1 ALIGNMENT_FLOAT32_IEEE 1 ALIGNMENT_FLOAT64_IEEE 1 ALIGNMENT_INT64 1 /end MOD_COMMON
/* Absolute addressing mode: default_event=mainloop_event (1), addr_ext=1 */
/begin MEASUREMENT syscall_count "Total tracked syscalls count" ULONG NO_COMPU_METHOD 0 0 0 4.29497e+09 ECU_ADDRESS 0x41C58 ECU_ADDRESS_EXTENSION 1 READ_WRITE
 /begin IF_DATA XCP
  /begin DAQ_EVENT VARIABLE /begin DEFAULT_EVENT_LIST EVENT 0x1 /end DEFAULT_EVENT_LIST /end DAQ_EVENT
 /end IF_DATA
/end MEASUREMENT
/begin MEASUREMENT syscall_rate "Total tracked syscalls per second" ULONG NO_COMPU_METHOD 0 0 0 2000 ECU_ADDRESS 0x41C68 ECU_ADDRESS_EXTENSION 1 PHYS_UNIT "1/s" READ_WRITE
 /begin IF_DATA XCP
  /begin DAQ_EVENT VARIABLE /begin DEFAULT_EVENT_LIST EVENT 0x1 /end DEFAULT_EVENT_LIST /end DAQ_EVENT
 /end IF_DATA
/end MEASUREMENT
/* Absolute addressing mode: default_event=process_event (2), addr_ext=1 */
/begin MEASUREMENT new_process_pid "New process PID" ULONG NO_COMPU_METHOD 0 0 0 4.29497e+09 ECU_ADDRESS 0x41C78 ECU_ADDRESS_EXTENSION 1 READ_WRITE
 /begin IF_DATA XCP
  /begin DAQ_EVENT VARIABLE /begin DEFAULT_EVENT_LIST EVENT 0x2 /end DEFAULT_EVENT_LIST /end DAQ_EVENT
 /end IF_DATA
/end MEASUREMENT
/* Absolute addressing mode: default_event=syscall_event (3), addr_ext=1 */
/begin MEASUREMENT syscall_nr "Current syscall number" ULONG NO_COMPU_METHOD 0 0 0 4.29497e+09 ECU_ADDRESS 0x41C5C ECU_ADDRESS_EXTENSION 1 READ_WRITE
 /begin IF_DATA XCP
  /begin DAQ_EVENT VARIABLE /begin DEFAULT_EVENT_LIST EVENT 0x3 /end DEFAULT_EVENT_LIST /end DAQ_EVENT
 /end IF_DATA
/end MEASUREMENT
/begin MEASUREMENT syscall_pid "Syscall PID" ULONG NO_COMPU_METHOD 0 0 0 4.29497e+09 ECU_ADDRESS 0x41C60 ECU_ADDRESS_EXTENSION 1 READ_WRITE
 /begin IF_DATA XCP
  /begin DAQ_EVENT VARIABLE /begin DEFAULT_EVENT_LIST EVENT 0x3 /end DEFAULT_EVENT_LIST /end DAQ_EVENT
 /end IF_DATA
/end MEASUREMENT
/begin MEASUREMENT io_setup "" ULONG NO_COMPU_METHOD 0 0 0 4.29497e+09 ECU_ADDRESS 0x41178 ECU_ADDRESS_EXTENSION 1 READ_WRITE /end MEASUREMENT
/begin MEASUREMENT io_destroy "" ULONG NO_COMPU_METHOD 0 0 0 4.29497e+09 ECU_ADDRESS 0x4117C ECU_ADDRESS_EXTENSION 1 READ_WRITE /end MEASUREMENT
/begin MEASUREMENT io_submit "" ULONG NO_COMPU_METHOD 0 0 0 4.29497e+09 ECU_ADDRESS 0x41180 ECU_ADDRESS_EXTENSION 1 READ_WRITE /end MEASUREMENT
/begin MEASUREMENT io_cancel "" ULONG NO_COMPU_METHOD 0 0 0 4.29497e+09 ECU_ADDRESS 0x41184 ECU_ADDRESS_EXTENSION 1 READ_WRITE /end MEASUREMENT
/begin MEASUREMENT io_getevents "" ULONG NO_COMPU_METHOD 0 0 0 4.29497e+09 ECU_ADDRESS 0x41188 ECU_ADDRESS_EXTENSION 1 READ_WRITE /end MEASUREMENT
/begin MEASUREMENT setxattr "" ULONG NO_COMPU_METHOD 0 0 0 4.29497e+09 ECU_ADDRESS 0x4118C ECU_ADDRESS_EXTENSION 1 READ_WRITE /end MEASUREMENT
/begin MEASUREMENT lsetxattr "" ULONG NO_COMPU_METHOD 0 0 0 4.29497e+09 ECU_ADDRESS 0x41190 ECU_ADDRESS_EXTENSION 1 READ_WRITE /end MEASUREMENT
/begin MEASUREMENT fsetxattr "" ULONG NO_COMPU_METHOD 0 0 0 4.29497e+09 ECU_ADDRESS 0x41194 ECU_ADDRESS_EXTENSION 1 READ_WRITE /end MEASUREMENT
/begin MEASUREMENT getxattr "" ULONG NO_COMPU_METHOD 0 0 0 4.29497e+09 ECU_ADDRESS 0x41198 ECU_ADDRESS_EXTENSION 1 READ_WRITE /end MEASUREMENT
/begin MEASUREMENT lgetxattr "" ULONG NO_COMPU_METHOD 0 0 0 4.29497e+09 ECU_ADDRESS 0x4119C ECU_ADDRESS_EXTENSION 1 READ_WRITE /end MEASUREMENT
/begin MEASUREMENT fgetxattr "" ULONG NO_COMPU_METHOD 0 0 0 4.29497e+09 ECU_ADDRESS 0x411A0 ECU_ADDRESS_EXTENSION 1 READ_WRITE /end MEASUREMENT
/begin MEASUREMENT listxattr "" ULONG NO_COMPU_METHOD 0 0 0 4.29497e+09 ECU_ADDRESS 0x411A4 ECU_ADDRESS_EXTENSION 1 READ_WRITE /end MEASUREMENT
/begin MEASUREMENT llistxattr "" ULONG NO_COMPU_METHOD 0 0 0 4.29497e+09 ECU_ADDRESS 0x411A8 ECU_ADDRESS_EXTENSION 1 READ_WRITE /end MEASUREMENT
/begin MEASUREMENT flistxattr "" ULONG NO_COMPU_METHOD 0 0 0 4.29497e+09 ECU_ADDRESS 0x411AC ECU_ADDRESS_EXTENSION 1 READ_WRITE /end MEASUREMENT
/begin MEASUREMENT removexattr "" ULONG NO_COMPU_METHOD 0 0 0 4.29497e+09 ECU_ADDRESS 0x411B0 ECU_ADDRESS_EXTENSION 1 READ_WRITE /end MEASUREMENT
/begin MEASUREMENT lremovexattr "" ULONG NO_COMPU_METHOD 0 0 0 4.29497e+09 ECU_ADDRESS 0x411B4 ECU_ADDRESS_EXTENSION 1 READ_WRITE /end MEASUREMENT
/begin MEASUREMENT fremovexattr "" ULONG NO_COMPU_METHOD 0 0 0 4.29497e+09 ECU_ADDRESS 0x411B8 ECU_ADDRESS_EXTENSION 1 READ_WRITE /end MEASUREMENT
/begin MEASUREMENT getcwd "" ULONG NO_COMPU_METHOD 0 0 0 4.29497e+09 ECU_ADDRESS 0x411BC ECU_ADDRESS_EXTENSION 1 READ_WRITE /end MEASUREMENT
/begin MEASUREMENT lookup_dcookie "" ULONG NO_COMPU_METHOD 0 0 0 4.29497e+09 ECU_ADDRESS 0x411C0 ECU_ADDRESS_EXTENSION 1 READ_WRITE /end MEASUREMENT
/begin MEASUREMENT eventfd2 "" ULONG NO_COMPU_METHOD 0 0 0 4.29497e+09 ECU_ADDRESS 0x411C4 ECU_ADDRESS_EXTENSION 1 READ_WRITE /end MEASUREMENT
/begin MEASUREMENT epoll_create1 "" ULONG NO_COMPU_METHOD 0 0 0 4.29497e+09 ECU_ADDRESS 0x411C8 ECU_ADDRESS_EXTENSION 1 READ_WRITE /end MEASUREMENT
/begin MEASUREMENT epoll_ctl "" ULONG NO_COMPU_METHOD 0 0 0 4.29497e+09 ECU_ADDRESS 0x411CC ECU_ADDRESS_EXTENSION 1 READ_WRITE /end MEASUREMENT
/begin MEASUREMENT epoll_pwait "" ULONG NO_COMPU_METHOD 0 0 0 4.29497e+09 ECU_ADDRESS 0x411D0 ECU_ADDRESS_EXTENSION 1 READ_WRITE /end MEASUREMENT
/begin MEASUREMENT dup "" ULONG NO_COMPU_METHOD 0 0 0 4.29497e+09 ECU_ADDRESS 0x411D4 ECU_ADDRESS_EXTENSION 1 READ_WRITE /end MEASUREMENT
/begin MEASUREMENT dup3 "" ULONG NO_COMPU_METHOD 0 0 0 4.29497e+09 ECU_ADDRESS 0x411D8 ECU_ADDRESS_EXTENSION 1 READ_WRITE /end MEASUREMENT
/begin MEASUREMENT fcntl "" ULONG NO_COMPU_METHOD 0 0 0 4.29497e+09 ECU_ADDRESS 0x411DC ECU_ADDRESS_EXTENSION 1 READ_WRITE /end MEASUREMENT
/begin MEASUREMENT inotify_init1 "" ULONG NO_COMPU_METHOD 0 0 0 4.29497e+09 ECU_ADDRESS 0x411E0 ECU_ADDRESS_EXTENSION 1 READ_WRITE /end MEASUREMENT
/begin MEASUREMENT inotify_add_watch "" ULONG NO_COMPU_METHOD 0 0 0 4.29497e+09 ECU_ADDRESS 0x411E4 ECU_ADDRESS_EXTENSION 1 READ_WRITE /end MEASUREMENT
/begin MEASUREMENT inotify_rm_watch "" ULONG NO_COMPU_METHOD 0 0 0 4.29497e+09 ECU_ADDRESS 0x411E8 ECU_ADDRESS_EXTENSION 1 READ_WRITE /end MEASUREMENT
/begin MEASUREMENT ioctl "" ULONG NO_COMPU_METHOD 0 0 0 4.29497e+09 ECU_ADDRESS 0x411EC ECU_ADDRESS_EXTENSION 1 READ_WRITE /end MEASUREMENT
/begin MEASUREMENT ioprio_set "" ULONG NO_COMPU_METHOD 0 0 0 4.29497e+09 ECU_ADDRESS 0x411F0 ECU_ADDRESS_EXTENSION 1 READ_WRITE /end MEASUREMENT
/begin MEASUREMENT ioprio_get "" ULONG NO_COMPU_METHOD 0 0 0 4.29497e+09 ECU_ADDRESS 0x411F4 ECU_ADDRESS_EXTENSION 1 READ_WRITE /end MEASUREMENT
/begin MEASUREMENT flock "" ULONG NO_COMPU_METHOD 0 0 0 4.29497e+09 ECU_ADDRESS 0x411F8 ECU_ADDRESS_EXTENSION 1 READ_WRITE /end MEASUREMENT
/begin MEASUREMENT mknodat "" ULONG NO_COMPU_METHOD 0 0 0 4.29497e+09 ECU_ADDRESS 0x411FC ECU_ADDRESS_EXTENSION 1 READ_WRITE /end MEASUREMENT
/begin MEASUREMENT mkdirat "" ULONG NO_COMPU_METHOD 0 0 0 4.29497e+09 ECU_ADDRESS 0x41200 ECU_ADDRESS_EXTENSION 1 READ_WRITE /end MEASUREMENT
/begin MEASUREMENT unlinkat "" ULONG NO_COMPU_METHOD 0 0 0 4.29497e+09 ECU_ADDRESS 0x41204 ECU_ADDRESS_EXTENSION 1 READ_WRITE /end MEASUREMENT
/begin MEASUREMENT symlinkat "" ULONG NO_COMPU_METHOD 0 0 0 4.29497e+09 ECU_ADDRESS 0x41208 ECU_ADDRESS_EXTENSION 1 READ_WRITE /end MEASUREMENT
/begin MEASUREMENT linkat "" ULONG NO_COMPU_METHOD 0 0 0 4.29497e+09 ECU_ADDRESS 0x4120C ECU_ADDRESS_EXTENSION 1 READ_WRITE /end MEASUREMENT
/begin MEASUREMENT renameat "" ULONG NO_COMPU_METHOD 0 0 0 4.29497e+09 ECU_ADDRESS 0x41210 ECU_ADDRESS_EXTENSION 1 READ_WRITE /end MEASUREMENT
/begin MEASUREMENT umount2 "" ULONG NO_COMPU_METHOD 0 0 0 4.29497e+09 ECU_ADDRESS 0x41214 ECU_ADDRESS_EXTENSION 1 READ_WRITE /end MEASUREMENT
/begin MEASUREMENT mount "" ULONG NO_COMPU_METHOD 0 0 0 4.29497e+09 ECU_ADDRESS 0x41218 ECU_ADDRESS_EXTENSION 1 READ_WRITE /end MEASUREMENT
/begin MEASUREMENT pivot_root "" ULONG NO_COMPU_METHOD 0 0 0 4.29497e+09 ECU_ADDRESS 0x4121C ECU_ADDRESS_EXTENSION 1 READ_WRITE /end MEASUREMENT
/begin MEASUREMENT nfsservctl "" ULONG NO_COMPU_METHOD 0 0 0 4.29497e+09 ECU_ADDRESS 0x41220 ECU_ADDRESS_EXTENSION 1 READ_WRITE /end MEASUREMENT
/begin MEASUREMENT statfs "" ULONG NO_COMPU_METHOD 0 0 0 4.29497e+09 ECU_ADDRESS 0x41224 ECU_ADDRESS_EXTENSION 1 READ_WRITE /end MEASUREMENT
/begin MEASUREMENT fstatfs "" ULONG NO_COMPU_METHOD 0 0 0 4.29497e+09 ECU_ADDRESS 0x41228 ECU_ADDRESS_EXTENSION 1 READ_WRITE /end MEASUREMENT
/begin MEASUREMENT truncate "" ULONG NO_COMPU_METHOD 0 0 0 4.29497e+09 ECU_ADDRESS 0x4122C ECU_ADDRESS_EXTENSION 1 READ_WRITE /end MEASUREMENT
/begin MEASUREMENT ftruncate "" ULONG NO_COMPU_METHOD 0 0 0 4.29497e+09 ECU_ADDRESS 0x41230 ECU_ADDRESS_EXTENSION 1 READ_WRITE /end MEASUREMENT
/begin MEASUREMENT fallocate "" ULONG NO_COMPU_METHOD 0 0 0 4.29497e+09 ECU_ADDRESS 0x41234 ECU_ADDRESS_EXTENSION 1 READ_WRITE /end MEASUREMENT
/begin MEASUREMENT faccessat "" ULONG NO_COMPU_METHOD 0 0 0 4.29497e+09 ECU_ADDRESS 0x41238 ECU_ADDRESS_EXTENSION 1 READ_WRITE /end MEASUREMENT
/begin MEASUREMENT chdir "" ULONG NO_COMPU_METHOD 0 0 0 4.29497e+09 ECU_ADDRESS 0x4123C ECU_ADDRESS_EXTENSION 1 READ_WRITE /end MEASUREMENT
/begin MEASUREMENT fchdir "" ULONG NO_COMPU_METHOD 0 0 0 4.29497e+09 ECU_ADDRESS 0x41240 ECU_ADDRESS_EXTENSION 1 READ_WRITE /end MEASUREMENT
/begin MEASUREMENT chroot "" ULONG NO_COMPU_METHOD 0 0 0 4.29497e+09 ECU_ADDRESS 0x41244 ECU_ADDRESS_EXTENSION 1 READ_WRITE /end MEASUREMENT
/begin MEASUREMENT fchmod "" ULONG NO_COMPU_METHOD 0 0 0 4.29497e+09 ECU_ADDRESS 0x41248 ECU_ADDRESS_EXTENSION 1 READ_WRITE /end MEASUREMENT
/begin MEASUREMENT fchmodat "" ULONG NO_COMPU_METHOD 0 0 0 4.29497e+09 ECU_ADDRESS 0x4124C ECU_ADDRESS_EXTENSION 1 READ_WRITE /end MEASUREMENT
/begin MEASUREMENT fchownat "" ULONG NO_COMPU_METHOD 0 0 0 4.29497e+09 ECU_ADDRESS 0x41250 ECU_ADDRESS_EXTENSION 1 READ_WRITE /end MEASUREMENT
/begin MEASUREMENT fchown "" ULONG NO_COMPU_METHOD 0 0 0 4.29497e+09 ECU_ADDRESS 0x41254 ECU_ADDRESS_EXTENSION 1 READ_WRITE /end MEASUREMENT
/begin MEASUREMENT openat "" ULONG NO_COMPU_METHOD 0 0 0 4.29497e+09 ECU_ADDRESS 0x41258 ECU_ADDRESS_EXTENSION 1 READ_WRITE /end MEASUREMENT
/begin MEASUREMENT close "" ULONG NO_COMPU_METHOD 0 0 0 4.29497e+09 ECU_ADDRESS 0x4125C ECU_ADDRESS_EXTENSION 1 READ_WRITE /end MEASUREMENT
/begin MEASUREMENT vhangup "" ULONG NO_COMPU_METHOD 0 0 0 4.29497e+09 ECU_ADDRESS 0x41260 ECU_ADDRESS_EXTENSION 1 READ_WRITE /end MEASUREMENT
/begin MEASUREMENT pipe2 "" ULONG NO_COMPU_METHOD 0 0 0 4.29497e+09 ECU_ADDRESS 0x41264 ECU_ADDRESS_EXTENSION 1 READ_WRITE /end MEASUREMENT
/begin MEASUREMENT quotactl "" ULONG NO_COMPU_METHOD 0 0 0 4.29497e+09 ECU_ADDRESS 0x41268 ECU_ADDRESS_EXTENSION 1 READ_WRITE /end MEASUREMENT
/begin MEASUREMENT getdents64 "" ULONG NO_COMPU_METHOD 0 0 0 4.29497e+09 ECU_ADDRESS 0x4126C ECU_ADDRESS_EXTENSION 1 READ_WRITE /end MEASUREMENT
/begin MEASUREMENT lseek "" ULONG NO_COMPU_METHOD 0 0 0 4.29497e+09 ECU_ADDRESS 0x41270 ECU_ADDRESS_EXTENSION 1 READ_WRITE /end MEASUREMENT
/begin MEASUREMENT read "" ULONG NO_COMPU_METHOD 0 0 0 4.29497e+09 ECU_ADDRESS 0x41274 ECU_ADDRESS_EXTENSION 1 READ_WRITE /end MEASUREMENT
/begin MEASUREMENT write "" ULONG NO_COMPU_METHOD 0 0 0 4.29497e+09 ECU_ADDRESS 0x41278 ECU_ADDRESS_EXTENSION 1 READ_WRITE /end MEASUREMENT
/begin MEASUREMENT readv "" ULONG NO_COMPU_METHOD 0 0 0 4.29497e+09 ECU_ADDRESS 0x4127C ECU_ADDRESS_EXTENSION 1 READ_WRITE /end MEASUREMENT
/begin MEASUREMENT writev "" ULONG NO_COMPU_METHOD 0 0 0 4.29497e+09 ECU_ADDRESS 0x41280 ECU_ADDRESS_EXTENSION 1 READ_WRITE /end MEASUREMENT
/begin MEASUREMENT pread64 "" ULONG NO_COMPU_METHOD 0 0 0 4.29497e+09 ECU_ADDRESS 0x41284 ECU_ADDRESS_EXTENSION 1 READ_WRITE /end MEASUREMENT
/begin MEASUREMENT pwrite64 "" ULONG NO_COMPU_METHOD 0 0 0 4.29497e+09 ECU_ADDRESS 0x41288 ECU_ADDRESS_EXTENSION 1 READ_WRITE /end MEASUREMENT
/begin MEASUREMENT preadv "" ULONG NO_COMPU_METHOD 0 0 0 4.29497e+09 ECU_ADDRESS 0x4128C ECU_ADDRESS_EXTENSION 1 READ_WRITE /end MEASUREMENT
/begin MEASUREMENT pwritev "" ULONG NO_COMPU_METHOD 0 0 0 4.29497e+09 ECU_ADDRESS 0x41290 ECU_ADDRESS_EXTENSION 1 READ_WRITE /end MEASUREMENT
/begin MEASUREMENT sendfile "" ULONG NO_COMPU_METHOD 0 0 0 4.29497e+09 ECU_ADDRESS 0x41294 ECU_ADDRESS_EXTENSION 1 READ_WRITE /end MEASUREMENT
/begin MEASUREMENT pselect6 "" ULONG NO_COMPU_METHOD 0 0 0 4.29497e+09 ECU_ADDRESS 0x41298 ECU_ADDRESS_EXTENSION 1 READ_WRITE /end MEASUREMENT
/begin MEASUREMENT ppoll "" ULONG NO_COMPU_METHOD 0 0 0 4.29497e+09 ECU_ADDRESS 0x4129C ECU_ADDRESS_EXTENSION 1 READ_WRITE /end MEASUREMENT
/begin MEASUREMENT signalfd4 "" ULONG NO_COMPU_METHOD 0 0 0 4.29497e+09 ECU_ADDRESS 0x412A0 ECU_ADDRESS_EXTENSION 1 READ_WRITE /end MEASUREMENT
/begin MEASUREMENT vmsplice "" ULONG NO_COMPU_METHOD 0 0 0 4.29497e+09 ECU_ADDRESS 0x412A4 ECU_ADDRESS_EXTENSION 1 READ_WRITE /end MEASUREMENT
/begin MEASUREMENT splice "" ULONG NO_COMPU_METHOD 0 0 0 4.29497e+09 ECU_ADDRESS 0x412A8 ECU_ADDRESS_EXTENSION 1 READ_WRITE /end MEASUREMENT
/begin MEASUREMENT tee "" ULONG NO_COMPU_METHOD 0 0 0 4.29497e+09 ECU_ADDRESS 0x412AC ECU_ADDRESS_EXTENSION 1 READ_WRITE /end MEASUREMENT
/begin MEASUREMENT readlinkat "" ULONG NO_COMPU_METHOD 0 0 0 4.29497e+09 ECU_ADDRESS 0x412B0 ECU_ADDRESS_EXTENSION 1 READ_WRITE /end MEASUREMENT
/begin MEASUREMENT fstatat "" ULONG NO_COMPU_METHOD 0 0 0 4.29497e+09 ECU_ADDRESS 0x412B4 ECU_ADDRESS_EXTENSION 1 READ_WRITE /end MEASUREMENT
/begin MEASUREMENT fstat "" ULONG NO_COMPU_METHOD 0 0 0 4.29497e+09 ECU_ADDRESS 0x412B8 ECU_ADDRESS_EXTENSION 1 READ_WRITE /end MEASUREMENT
/begin MEASUREMENT sync "" ULONG NO_COMPU_METHOD 0 0 0 4.29497e+09 ECU_ADDRESS 0x412BC ECU_ADDRESS_EXTENSION 1 READ_WRITE /end MEASUREMENT
/begin MEASUREMENT fsync "" ULONG NO_COMPU_METHOD 0 0 0 4.29497e+09 ECU_ADDRESS 0x412C0 ECU_ADDRESS_EXTENSION 1 READ_WRITE /end MEASUREMENT
/begin MEASUREMENT fdatasync "" ULONG NO_COMPU_METHOD 0 0 0 4.29497e+09 ECU_ADDRESS 0x412C4 ECU_ADDRESS_EXTENSION 1 READ_WRITE /end MEASUREMENT
/begin MEASUREMENT sync_file_range "" ULONG NO_COMPU_METHOD 0 0 0 4.29497e+09 ECU_ADDRESS 0x412C8 ECU_ADDRESS_EXTENSION 1 READ_WRITE /end MEASUREMENT
/begin MEASUREMENT timerfd_create "" ULONG NO_COMPU_METHOD 0 0 0 4.29497e+09 ECU_ADDRESS 0x412CC ECU_ADDRESS_EXTENSION 1 READ_WRITE /end MEASUREMENT
/begin MEASUREMENT timerfd_settime "" ULONG NO_COMPU_METHOD 0 0 0 4.29497e+09 ECU_ADDRESS 0x412D0 ECU_ADDRESS_EXTENSION 1 READ_WRITE /end MEASUREMENT
/begin MEASUREMENT timerfd_gettime "" ULONG NO_COMPU_METHOD 0 0 0 4.29497e+09 ECU_ADDRESS 0x412D4 ECU_ADDRESS_EXTENSION 1 READ_WRITE /end MEASUREMENT
/begin MEASUREMENT utimensat "" ULONG NO_COMPU_METHOD 0 0 0 4.29497e+09 ECU_ADDRESS 0x412D8 ECU_ADDRESS_EXTENSION 1 READ_WRITE /end MEASUREMENT
/begin MEASUREMENT acct "" ULONG NO_COMPU_METHOD 0 0 0 4.29497e+09 ECU_ADDRESS 0x412DC ECU_ADDRESS_EXTENSION 1 READ_WRITE /end MEASUREMENT
/begin MEASUREMENT capget "" ULONG NO_COMPU_METHOD 0 0 0 4.29497e+09 ECU_ADDRESS 0x412E0 ECU_ADDRESS_EXTENSION 1 READ_WRITE /end MEASUREMENT
/begin MEASUREMENT capset "" ULONG NO_COMPU_METHOD 0 0 0 4.29497e+09 ECU_ADDRESS 0x412E4 ECU_ADDRESS_EXTENSION 1 READ_WRITE /end MEASUREMENT
/begin MEASUREMENT personality "" ULONG NO_COMPU_METHOD 0 0 0 4.29497e+09 ECU_ADDRESS 0x412E8 ECU_ADDRESS_EXTENSION 1 READ_WRITE /end MEASUREMENT
/begin MEASUREMENT exit "" ULONG NO_COMPU_METHOD 0 0 0 4.29497e+09 ECU_ADDRESS 0x412EC ECU_ADDRESS_EXTENSION 1 READ_WRITE /end MEASUREMENT
/begin MEASUREMENT exit_group "" ULONG NO_COMPU_METHOD 0 0 0 4.29497e+09 ECU_ADDRESS 0x412F0 ECU_ADDRESS_EXTENSION 1 READ_WRITE /end MEASUREMENT
/begin MEASUREMENT waitid "" ULONG NO_COMPU_METHOD 0 0 0 4.29497e+09 ECU_ADDRESS 0x412F4 ECU_ADDRESS_EXTENSION 1 READ_WRITE /end MEASUREMENT
/begin MEASUREMENT set_tid_address "" ULONG NO_COMPU_METHOD 0 0 0 4.29497e+09 ECU_ADDRESS 0x412F8 ECU_ADDRESS_EXTENSION 1 READ_WRITE /end MEASUREMENT
/begin MEASUREMENT unshare "" ULONG NO_COMPU_METHOD 0 0 0 4.29497e+09 ECU_ADDRESS 0x412FC ECU_ADDRESS_EXTENSION 1 READ_WRITE /end MEASUREMENT
/begin MEASUREMENT futex "" ULONG NO_COMPU_METHOD 0 0 0 4.29497e+09 ECU_ADDRESS 0x41300 ECU_ADDRESS_EXTENSION 1 READ_WRITE /end MEASUREMENT
/begin MEASUREMENT set_robust_list "" ULONG NO_COMPU_METHOD 0 0 0 4.29497e+09 ECU_ADDRESS 0x41304 ECU_ADDRESS_EXTENSION 1 READ_WRITE /end MEASUREMENT
/begin MEASUREMENT get_robust_list "" ULONG NO_COMPU_METHOD 0 0 0 4.29497e+09 ECU_ADDRESS 0x41308 ECU_ADDRESS_EXTENSION 1 READ_WRITE /end MEASUREMENT
/begin MEASUREMENT nanosleep "" ULONG NO_COMPU_METHOD 0 0 0 4.29497e+09 ECU_ADDRESS 0x4130C ECU_ADDRESS_EXTENSION 1 READ_WRITE /end MEASUREMENT
/begin MEASUREMENT getitimer "" ULONG NO_COMPU_METHOD 0 0 0 4.29497e+09 ECU_ADDRESS 0x41310 ECU_ADDRESS_EXTENSION 1 READ_WRITE /end MEASUREMENT
/begin MEASUREMENT setitimer "" ULONG NO_COMPU_METHOD 0 0 0 4.29497e+09 ECU_ADDRESS 0x41314 ECU_ADDRESS_EXTENSION 1 READ_WRITE /end MEASUREMENT
/begin MEASUREMENT kexec_load "" ULONG NO_COMPU_METHOD 0 0 0 4.29497e+09 ECU_ADDRESS 0x41318 ECU_ADDRESS_EXTENSION 1 READ_WRITE /end MEASUREMENT
/begin MEASUREMENT init_module "" ULONG NO_COMPU_METHOD 0 0 0 4.29497e+09 ECU_ADDRESS 0x4131C ECU_ADDRESS_EXTENSION 1 READ_WRITE /end MEASUREMENT
/begin MEASUREMENT delete_module "" ULONG NO_COMPU_METHOD 0 0 0 4.29497e+09 ECU_ADDRESS 0x41320 ECU_ADDRESS_EXTENSION 1 READ_WRITE /end MEASUREMENT
/begin MEASUREMENT timer_create "" ULONG NO_COMPU_METHOD 0 0 0 4.29497e+09 ECU_ADDRESS 0x41324 ECU_ADDRESS_EXTENSION 1 READ_WRITE /end MEASUREMENT
/begin MEASUREMENT timer_gettime "" ULONG NO_COMPU_METHOD 0 0 0 4.29497e+09 ECU_ADDRESS 0x41328 ECU_ADDRESS_EXTENSION 1 READ_WRITE /end MEASUREMENT
/begin MEASUREMENT timer_getoverrun "" ULONG NO_COMPU_METHOD 0 0 0 4.29497e+09 ECU_ADDRESS 0x4132C ECU_ADDRESS_EXTENSION 1 READ_WRITE /end MEASUREMENT
/begin MEASUREMENT timer_settime "" ULONG NO_COMPU_METHOD 0 0 0 4.29497e+09 ECU_ADDRESS 0x41330 ECU_ADDRESS_EXTENSION 1 READ_WRITE /end MEASUREMENT
/begin MEASUREMENT timer_delete "" ULONG NO_COMPU_METHOD 0 0 0 4.29497e+09 ECU_ADDRESS 0x41334 ECU_ADDRESS_EXTENSION 1 READ_WRITE /end MEASUREMENT
/begin MEASUREMENT clock_settime "" ULONG NO_COMPU_METHOD 0 0 0 4.29497e+09 ECU_ADDRESS 0x41338 ECU_ADDRESS_EXTENSION 1 READ_WRITE /end MEASUREMENT
/begin MEASUREMENT clock_gettime "" ULONG NO_COMPU_METHOD 0 0 0 4.29497e+09 ECU_ADDRESS 0x4133C ECU_ADDRESS_EXTENSION 1 READ_WRITE /end MEASUREMENT
/begin MEASUREMENT clock_getres "" ULONG NO_COMPU_METHOD 0 0 0 4.29497e+09 ECU_ADDRESS 0x41340 ECU_ADDRESS_EXTENSION 1 READ_WRITE /end MEASUREMENT
/begin MEASUREMENT clock_nanosleep "" ULONG NO_COMPU_METHOD 0 0 0 4.29497e+09 ECU_ADDRESS 0x41344 ECU_ADDRESS_EXTENSION 1 READ_WRITE /end MEASUREMENT
/begin MEASUREMENT syslog "" ULONG NO_COMPU_METHOD 0 0 0 4.29497e+09 ECU_ADDRESS 0x41348 ECU_ADDRESS_EXTENSION 1 READ_WRITE /end MEASUREMENT
/begin MEASUREMENT ptrace "" ULONG NO_COMPU_METHOD 0 0 0 4.29497e+09 ECU_ADDRESS 0x4134C ECU_ADDRESS_EXTENSION 1 READ_WRITE /end MEASUREMENT
/begin MEASUREMENT sched_setparam "" ULONG NO_COMPU_METHOD 0 0 0 4.29497e+09 ECU_ADDRESS 0x41350 ECU_ADDRESS_EXTENSION 1 READ_WRITE /end MEASUREMENT
/begin MEASUREMENT sched_setscheduler "" ULONG NO_COMPU_METHOD 0 0 0 4.29497e+09 ECU_ADDRESS 0x41354 ECU_ADDRESS_EXTENSION 1 READ_WRITE /end MEASUREMENT
/begin MEASUREMENT sched_getscheduler "" ULONG NO_COMPU_METHOD 0 0 0 4.29497e+09 ECU_ADDRESS 0x41358 ECU_ADDRESS_EXTENSION 1 READ_WRITE /end MEASUREMENT
/begin MEASUREMENT sched_getparam "" ULONG NO_COMPU_METHOD 0 0 0 4.29497e+09 ECU_ADDRESS 0x4135C ECU_ADDRESS_EXTENSION 1 READ_WRITE /end MEASUREMENT
/begin MEASUREMENT sched_setaffinity "" ULONG NO_COMPU_METHOD 0 0 0 4.29497e+09 ECU_ADDRESS 0x41360 ECU_ADDRESS_EXTENSION 1 READ_WRITE /end MEASUREMENT
/begin MEASUREMENT sched_getaffinity "" ULONG NO_COMPU_METHOD 0 0 0 4.29497e+09 ECU_ADDRESS 0x41364 ECU_ADDRESS_EXTENSION 1 READ_WRITE /end MEASUREMENT
/begin MEASUREMENT sched_yield "" ULONG NO_COMPU_METHOD 0 0 0 4.29497e+09 ECU_ADDRESS 0x41368 ECU_ADDRESS_EXTENSION 1 READ_WRITE /end MEASUREMENT
/begin MEASUREMENT sched_get_priority_max "" ULONG NO_COMPU_METHOD 0 0 0 4.29497e+09 ECU_ADDRESS 0x4136C ECU_ADDRESS_EXTENSION 1 READ_WRITE /end MEASUREMENT
/begin MEASUREMENT sched_get_priority_min "" ULONG NO_COMPU_METHOD 0 0 0 4.29497e+09 ECU_ADDRESS 0x41370 ECU_ADDRESS_EXTENSION 1 READ_WRITE /end MEASUREMENT
/begin MEASUREMENT sched_rr_get_interval "" ULONG NO_COMPU_METHOD 0 0 0 4.29497e+09 ECU_ADDRESS 0x41374 ECU_ADDRESS_EXTENSION 1 READ_WRITE /end MEASUREMENT
/begin MEASUREMENT restart_syscall "" ULONG NO_COMPU_METHOD 0 0 0 4.29497e+09 ECU_ADDRESS 0x41378 ECU_ADDRESS_EXTENSION 1 READ_WRITE /end MEASUREMENT
/begin MEASUREMENT kill "" ULONG NO_COMPU_METHOD 0 0 0 4.29497e+09 ECU_ADDRESS 0x4137C ECU_ADDRESS_EXTENSION 1 READ_WRITE /end MEASUREMENT
/begin MEASUREMENT tkill "" ULONG NO_COMPU_METHOD 0 0 0 4.29497e+09 ECU_ADDRESS 0x41380 ECU_ADDRESS_EXTENSION 1 READ_WRITE /end MEASUREMENT
/begin MEASUREMENT tgkill "" ULONG NO_COMPU_METHOD 0 0 0 4.29497e+09 ECU_ADDRESS 0x41384 ECU_ADDRESS_EXTENSION 1 READ_WRITE /end MEASUREMENT
/begin MEASUREMENT sigaltstack "" ULONG NO_COMPU_METHOD 0 0 0 4.29497e+09 ECU_ADDRESS 0x41388 ECU_ADDRESS_EXTENSION 1 READ_WRITE /end MEASUREMENT
/begin MEASUREMENT rt_sigsuspend "" ULONG NO_COMPU_METHOD 0 0 0 4.29497e+09 ECU_ADDRESS 0x4138C ECU_ADDRESS_EXTENSION 1 READ_WRITE /end MEASUREMENT
/begin MEASUREMENT rt_sigaction "" ULONG NO_COMPU_METHOD 0 0 0 4.29497e+09 ECU_ADDRESS 0x41390 ECU_ADDRESS_EXTENSION 1 READ_WRITE /end MEASUREMENT
/begin MEASUREMENT rt_sigprocmask "" ULONG NO_COMPU_METHOD 0 0 0 4.29497e+09 ECU_ADDRESS 0x41394 ECU_ADDRESS_EXTENSION 1 READ_WRITE /end MEASUREMENT
/begin MEASUREMENT rt_sigpending "" ULONG NO_COMPU_METHOD 0 0 0 4.29497e+09 ECU_ADDRESS 0x41398 ECU_ADDRESS_EXTENSION 1 READ_WRITE /end MEASUREMENT
/begin MEASUREMENT rt_sigtimedwait "" ULONG NO_COMPU_METHOD 0 0 0 4.29497e+09 ECU_ADDRESS 0x4139C ECU_ADDRESS_EXTENSION 1 READ_WRITE /end MEASUREMENT
/begin MEASUREMENT rt_sigqueueinfo "" ULONG NO_COMPU_METHOD 0 0 0 4.29497e+09 ECU_ADDRESS 0x413A0 ECU_ADDRESS_EXTENSION 1 READ_WRITE /end MEASUREMENT
/begin MEASUREMENT rt_sigreturn "" ULONG NO_COMPU_METHOD 0 0 0 4.29497e+09 ECU_ADDRESS 0x413A4 ECU_ADDRESS_EXTENSION 1 READ_WRITE /end MEASUREMENT
/begin MEASUREMENT setpriority "" ULONG NO_COMPU_METHOD 0 0 0 4.29497e+09 ECU_ADDRESS 0x413A8 ECU_ADDRESS_EXTENSION 1 READ_WRITE /end MEASUREMENT
/begin MEASUREMENT getpriority "" ULONG NO_COMPU_METHOD 0 0 0 4.29497e+09 ECU_ADDRESS 0x413AC ECU_ADDRESS_EXTENSION 1 READ_WRITE /end MEASUREMENT
/begin MEASUREMENT reboot "" ULONG NO_COMPU_METHOD 0 0 0 4.29497e+09 ECU_ADDRESS 0x413B0 ECU_ADDRESS_EXTENSION 1 READ_WRITE /end MEASUREMENT
/begin MEASUREMENT setregid "" ULONG NO_COMPU_METHOD 0 0 0 4.29497e+09 ECU_ADDRESS 0x413B4 ECU_ADDRESS_EXTENSION 1 READ_WRITE /end MEASUREMENT
/begin MEASUREMENT setgid "" ULONG NO_COMPU_METHOD 0 0 0 4.29497e+09 ECU_ADDRESS 0x413B8 ECU_ADDRESS_EXTENSION 1 READ_WRITE /end MEASUREMENT
/begin MEASUREMENT setreuid "" ULONG NO_COMPU_METHOD 0 0 0 4.29497e+09 ECU_ADDRESS 0x413BC ECU_ADDRESS_EXTENSION 1 READ_WRITE /end MEASUREMENT
/begin MEASUREMENT setuid "" ULONG NO_COMPU_METHOD 0 0 0 4.29497e+09 ECU_ADDRESS 0x413C0 ECU_ADDRESS_EXTENSION 1 READ_WRITE /end MEASUREMENT
/begin MEASUREMENT setresuid "" ULONG NO_COMPU_METHOD 0 0 0 4.29497e+09 ECU_ADDRESS 0x413C4 ECU_ADDRESS_EXTENSION 1 READ_WRITE /end MEASUREMENT
/begin MEASUREMENT getresuid "" ULONG NO_COMPU_METHOD 0 0 0 4.29497e+09 ECU_ADDRESS 0x413C8 ECU_ADDRESS_EXTENSION 1 READ_WRITE /end MEASUREMENT
/begin MEASUREMENT setresgid "" ULONG NO_COMPU_METHOD 0 0 0 4.29497e+09 ECU_ADDRESS 0x413CC ECU_ADDRESS_EXTENSION 1 READ_WRITE /end MEASUREMENT
/begin MEASUREMENT getresgid "" ULONG NO_COMPU_METHOD 0 0 0 4.29497e+09 ECU_ADDRESS 0x413D0 ECU_ADDRESS_EXTENSION 1 READ_WRITE /end MEASUREMENT
/begin MEASUREMENT setfsuid "" ULONG NO_COMPU_METHOD 0 0 0 4.29497e+09 ECU_ADDRESS 0x413D4 ECU_ADDRESS_EXTENSION 1 READ_WRITE /end MEASUREMENT
/begin MEASUREMENT setfsgid "" ULONG NO_COMPU_METHOD 0 0 0 4.29497e+09 ECU_ADDRESS 0x413D8 ECU_ADDRESS_EXTENSION 1 READ_WRITE /end MEASUREMENT
/begin MEASUREMENT times "" ULONG NO_COMPU_METHOD 0 0 0 4.29497e+09 ECU_ADDRESS 0x413DC ECU_ADDRESS_EXTENSION 1 READ_WRITE /end MEASUREMENT
/begin MEASUREMENT setpgid "" ULONG NO_COMPU_METHOD 0 0 0 4.29497e+09 ECU_ADDRESS 0x413E0 ECU_ADDRESS_EXTENSION 1 READ_WRITE /end MEASUREMENT
/begin MEASUREMENT getpgid "" ULONG NO_COMPU_METHOD 0 0 0 4.29497e+09 ECU_ADDRESS 0x413E4 ECU_ADDRESS_EXTENSION 1 READ_WRITE /end MEASUREMENT
/begin MEASUREMENT getsid "" ULONG NO_COMPU_METHOD 0 0 0 4.29497e+09 ECU_ADDRESS 0x413E8 ECU_ADDRESS_EXTENSION 1 READ_WRITE /end MEASUREMENT
/begin MEASUREMENT setsid "" ULONG NO_COMPU_METHOD 0 0 0 4.29497e+09 ECU_ADDRESS 0x413EC ECU_ADDRESS_EXTENSION 1 READ_WRITE /end MEASUREMENT
/begin MEASUREMENT getgroups "" ULONG NO_COMPU_METHOD 0 0 0 4.29497e+09 ECU_ADDRESS 0x413F0 ECU_ADDRESS_EXTENSION 1 READ_WRITE /end MEASUREMENT
/begin MEASUREMENT setgroups "" ULONG NO_COMPU_METHOD 0 0 0 4.29497e+09 ECU_ADDRESS 0x413F4 ECU_ADDRESS_EXTENSION 1 READ_WRITE /end MEASUREMENT
/begin MEASUREMENT uname "" ULONG NO_COMPU_METHOD 0 0 0 4.29497e+09 ECU_ADDRESS 0x413F8 ECU_ADDRESS_EXTENSION 1 READ_WRITE /end MEASUREMENT
/begin MEASUREMENT sethostname "" ULONG NO_COMPU_METHOD 0 0 0 4.29497e+09 ECU_ADDRESS 0x413FC ECU_ADDRESS_EXTENSION 1 READ_WRITE /end MEASUREMENT
/begin MEASUREMENT setdomainname "" ULONG NO_COMPU_METHOD 0 0 0 4.29497e+09 ECU_ADDRESS 0x41400 ECU_ADDRESS_EXTENSION 1 READ_WRITE /end MEASUREMENT
/begin MEASUREMENT getrlimit "" ULONG NO_COMPU_METHOD 0 0 0 4.29497e+09 ECU_ADDRESS 0x41404 ECU_ADDRESS_EXTENSION 1 READ_WRITE /end MEASUREMENT
/begin MEASUREMENT setrlimit "" ULONG NO_COMPU_METHOD 0 0 0 4.29497e+09 ECU_ADDRESS 0x41408 ECU_ADDRESS_EXTENSION 1 READ_WRITE /end MEASUREMENT
/begin MEASUREMENT getrusage "" ULONG NO_COMPU_METHOD 0 0 0 4.29497e+09 ECU_ADDRESS 0x4140C ECU_ADDRESS_EXTENSION 1 READ_WRITE /end MEASUREMENT
/begin MEASUREMENT umask "" ULONG NO_COMPU_METHOD 0 0 0 4.29497e+09 ECU_ADDRESS 0x41410 ECU_ADDRESS_EXTENSION 1 READ_WRITE /end MEASUREMENT
/begin MEASUREMENT prctl "" ULONG NO_COMPU_METHOD 0 0 0 4.29497e+09 ECU_ADDRESS 0x41414 ECU_ADDRESS_EXTENSION 1 READ_WRITE /end MEASUREMENT
/begin MEASUREMENT getcpu "" ULONG NO_COMPU_METHOD 0 0 0 4.29497e+09 ECU_ADDRESS 0x41418 ECU_ADDRESS_EXTENSION 1 READ_WRITE /end MEASUREMENT
/begin MEASUREMENT gettimeofday "" ULONG NO_COMPU_METHOD 0 0 0 4.29497e+09 ECU_ADDRESS 0x4141C ECU_ADDRESS_EXTENSION 1 READ_WRITE /end MEASUREMENT
/begin MEASUREMENT settimeofday "" ULONG NO_COMPU_METHOD 0 0 0 4.29497e+09 ECU_ADDRESS 0x41420 ECU_ADDRESS_EXTENSION 1 READ_WRITE /end MEASUREMENT
/begin MEASUREMENT adjtimex "" ULONG NO_COMPU_METHOD 0 0 0 4.29497e+09 ECU_ADDRESS 0x41424 ECU_ADDRESS_EXTENSION 1 READ_WRITE /end MEASUREMENT
/begin MEASUREMENT getpid "" ULONG NO_COMPU_METHOD 0 0 0 4.29497e+09 ECU_ADDRESS 0x41428 ECU_ADDRESS_EXTENSION 1 READ_WRITE /end MEASUREMENT
/begin MEASUREMENT getppid "" ULONG NO_COMPU_METHOD 0 0 0 4.29497e+09 ECU_ADDRESS 0x4142C ECU_ADDRESS_EXTENSION 1 READ_WRITE /end MEASUREMENT
/begin MEASUREMENT getuid "" ULONG NO_COMPU_METHOD 0 0 0 4.29497e+09 ECU_ADDRESS 0x41430 ECU_ADDRESS_EXTENSION 1 READ_WRITE /end MEASUREMENT
/begin MEASUREMENT geteuid "" ULONG NO_COMPU_METHOD 0 0 0 4.29497e+09 ECU_ADDRESS 0x41434 ECU_ADDRESS_EXTENSION 1 READ_WRITE /end MEASUREMENT
/begin MEASUREMENT getgid "" ULONG NO_COMPU_METHOD 0 0 0 4.29497e+09 ECU_ADDRESS 0x41438 ECU_ADDRESS_EXTENSION 1 READ_WRITE /end MEASUREMENT
/begin MEASUREMENT getegid "" ULONG NO_COMPU_METHOD 0 0 0 4.29497e+09 ECU_ADDRESS 0x4143C ECU_ADDRESS_EXTENSION 1 READ_WRITE /end MEASUREMENT
/begin MEASUREMENT gettid "" ULONG NO_COMPU_METHOD 0 0 0 4.29497e+09 ECU_ADDRESS 0x41440 ECU_ADDRESS_EXTENSION 1 READ_WRITE /end MEASUREMENT
/begin MEASUREMENT sysinfo "" ULONG NO_COMPU_METHOD 0 0 0 4.29497e+09 ECU_ADDRESS 0x41444 ECU_ADDRESS_EXTENSION 1 READ_WRITE /end MEASUREMENT
/begin MEASUREMENT mq_open "" ULONG NO_COMPU_METHOD 0 0 0 4.29497e+09 ECU_ADDRESS 0x41448 ECU_ADDRESS_EXTENSION 1 READ_WRITE /end MEASUREMENT
/begin MEASUREMENT mq_unlink "" ULONG NO_COMPU_METHOD 0 0 0 4.29497e+09 ECU_ADDRESS 0x4144C ECU_ADDRESS_EXTENSION 1 READ_WRITE /end MEASUREMENT
/begin MEASUREMENT mq_timedsend "" ULONG NO_COMPU_METHOD 0 0 0 4.29497e+09 ECU_ADDRESS 0x41450 ECU_ADDRESS_EXTENSION 1 READ_WRITE /end MEASUREMENT
/begin MEASUREMENT mq_timedreceive "" ULONG NO_COMPU_METHOD 0 0 0 4.29497e+09 ECU_ADDRESS 0x41454 ECU_ADDRESS_EXTENSION 1 READ_WRITE /end MEASUREMENT
/begin MEASUREMENT mq_notify "" ULONG NO_COMPU_METHOD 0 0 0 4.29497e+09 ECU_ADDRESS 0x41458 ECU_ADDRESS_EXTENSION 1 READ_WRITE /end MEASUREMENT
/begin MEASUREMENT mq_getsetattr "" ULONG NO_COMPU_METHOD 0 0 0 4.29497e+09 ECU_ADDRESS 0x4145C ECU_ADDRESS_EXTENSION 1 READ_WRITE /end MEASUREMENT
/begin MEASUREMENT msgget "" ULONG NO_COMPU_METHOD 0 0 0 4.29497e+09 ECU_ADDRESS 0x41460 ECU_ADDRESS_EXTENSION 1 READ_WRITE /end MEASUREMENT
/begin MEASUREMENT msgctl "" ULONG NO_COMPU_METHOD 0 0 0 4.29497e+09 ECU_ADDRESS 0x41464 ECU_ADDRESS_EXTENSION 1 READ_WRITE /end MEASUREMENT
/begin MEASUREMENT msgrcv "" ULONG NO_COMPU_METHOD 0 0 0 4.29497e+09 ECU_ADDRESS 0x41468 ECU_ADDRESS_EXTENSION 1 READ_WRITE /end MEASUREMENT
/begin MEASUREMENT msgsnd "" ULONG NO_COMPU_METHOD 0 0 0 4.29497e+09 ECU_ADDRESS 0x4146C ECU_ADDRESS_EXTENSION 1 READ_WRITE /end MEASUREMENT
/begin MEASUREMENT semget "" ULONG NO_COMPU_METHOD 0 0 0 4.29497e+09 ECU_ADDRESS 0x41470 ECU_ADDRESS_EXTENSION 1 READ_WRITE /end MEASUREMENT
/begin MEASUREMENT semctl "" ULONG NO_COMPU_METHOD 0 0 0 4.29497e+09 ECU_ADDRESS 0x41474 ECU_ADDRESS_EXTENSION 1 READ_WRITE /end MEASUREMENT
/begin MEASUREMENT semtimedop "" ULONG NO_COMPU_METHOD 0 0 0 4.29497e+09 ECU_ADDRESS 0x41478 ECU_ADDRESS_EXTENSION 1 READ_WRITE /end MEASUREMENT
/begin MEASUREMENT semop "" ULONG NO_COMPU_METHOD 0 0 0 4.29497e+09 ECU_ADDRESS 0x4147C ECU_ADDRESS_EXTENSION 1 READ_WRITE /end MEASUREMENT
/begin MEASUREMENT shmget "" ULONG NO_COMPU_METHOD 0 0 0 4.29497e+09 ECU_ADDRESS 0x41480 ECU_ADDRESS_EXTENSION 1 READ_WRITE /end MEASUREMENT
/begin MEASUREMENT shmctl "" ULONG NO_COMPU_METHOD 0 0 0 4.29497e+09 ECU_ADDRESS 0x41484 ECU_ADDRESS_EXTENSION 1 READ_WRITE /end MEASUREMENT
/begin MEASUREMENT shmat "" ULONG NO_COMPU_METHOD 0 0 0 4.29497e+09 ECU_ADDRESS 0x41488 ECU_ADDRESS_EXTENSION 1 READ_WRITE /end MEASUREMENT
/begin MEASUREMENT shmdt "" ULONG NO_COMPU_METHOD 0 0 0 4.29497e+09 ECU_ADDRESS 0x4148C ECU_ADDRESS_EXTENSION 1 READ_WRITE /end MEASUREMENT
/begin MEASUREMENT socket "" ULONG NO_COMPU_METHOD 0 0 0 4.29497e+09 ECU_ADDRESS 0x41490 ECU_ADDRESS_EXTENSION 1 READ_WRITE /end MEASUREMENT
/begin MEASUREMENT socketpair "" ULONG NO_COMPU_METHOD 0 0 0 4.29497e+09 ECU_ADDRESS 0x41494 ECU_ADDRESS_EXTENSION 1 READ_WRITE /end MEASUREMENT
/begin MEASUREMENT bind "" ULONG NO_COMPU_METHOD 0 0 0 4.29497e+09 ECU_ADDRESS 0x41498 ECU_ADDRESS_EXTENSION 1 READ_WRITE /end MEASUREMENT
/begin MEASUREMENT listen "" ULONG NO_COMPU_METHOD 0 0 0 4.29497e+09 ECU_ADDRESS 0x4149C ECU_ADDRESS_EXTENSION 1 READ_WRITE /end MEASUREMENT
/begin MEASUREMENT accept "" ULONG NO_COMPU_METHOD 0 0 0 4.29497e+09 ECU_ADDRESS 0x414A0 ECU_ADDRESS_EXTENSION 1 READ_WRITE /end MEASUREMENT
/begin MEASUREMENT connect "" ULONG NO_COMPU_METHOD 0 0 0 4.29497e+09 ECU_ADDRESS 0x414A4 ECU_ADDRESS_EXTENSION 1 READ_WRITE /end MEASUREMENT
/begin MEASUREMENT getsockname "" ULONG NO_COMPU_METHOD 0 0 0 4.29497e+09 ECU_ADDRESS 0x414A8 ECU_ADDRESS_EXTENSION 1 READ_WRITE /end MEASUREMENT
/begin MEASUREMENT getpeername "" ULONG NO_COMPU_METHOD 0 0 0 4.29497e+09 ECU_ADDRESS 0x414AC ECU_ADDRESS_EXTENSION 1 READ_WRITE /end MEASUREMENT
/begin MEASUREMENT sendto "" ULONG NO_COMPU_METHOD 0 0 0 4.29497e+09 ECU_ADDRESS 0x414B0 ECU_ADDRESS_EXTENSION 1 READ_WRITE /end MEASUREMENT
/begin MEASUREMENT recvfrom "" ULONG NO_COMPU_METHOD 0 0 0 4.29497e+09 ECU_ADDRESS 0x414B4 ECU_ADDRESS_EXTENSION 1 READ_WRITE /end MEASUREMENT
/begin MEASUREMENT setsockopt "" ULONG NO_COMPU_METHOD 0 0 0 4.29497e+09 ECU_ADDRESS 0x414B8 ECU_ADDRESS_EXTENSION 1 READ_WRITE /end MEASUREMENT
/begin MEASUREMENT getsockopt "" ULONG NO_COMPU_METHOD 0 0 0 4.29497e+09 ECU_ADDRESS 0x414BC ECU_ADDRESS_EXTENSION 1 READ_WRITE /end MEASUREMENT
/begin MEASUREMENT shutdown "" ULONG NO_COMPU_METHOD 0 0 0 4.29497e+09 ECU_ADDRESS 0x414C0 ECU_ADDRESS_EXTENSION 1 READ_WRITE /end MEASUREMENT
/begin MEASUREMENT sendmsg "" ULONG NO_COMPU_METHOD 0 0 0 4.29497e+09 ECU_ADDRESS 0x414C4 ECU_ADDRESS_EXTENSION 1 READ_WRITE /end MEASUREMENT
/begin MEASUREMENT recvmsg "" ULONG NO_COMPU_METHOD 0 0 0 4.29497e+09 ECU_ADDRESS 0x414C8 ECU_ADDRESS_EXTENSION 1 READ_WRITE /end MEASUREMENT
/begin MEASUREMENT readahead "" ULONG NO_COMPU_METHOD 0 0 0 4.29497e+09 ECU_ADDRESS 0x414CC ECU_ADDRESS_EXTENSION 1 READ_WRITE /end MEASUREMENT
/begin MEASUREMENT brk "" ULONG NO_COMPU_METHOD 0 0 0 4.29497e+09 ECU_ADDRESS 0x414D0 ECU_ADDRESS_EXTENSION 1 READ_WRITE /end MEASUREMENT
/begin MEASUREMENT munmap "" ULONG NO_COMPU_METHOD 0 0 0 4.29497e+09 ECU_ADDRESS 0x414D4 ECU_ADDRESS_EXTENSION 1 READ_WRITE /end MEASUREMENT
/begin MEASUREMENT mremap "" ULONG NO_COMPU_METHOD 0 0 0 4.29497e+09 ECU_ADDRESS 0x414D8 ECU_ADDRESS_EXTENSION 1 READ_WRITE /end MEASUREMENT
/begin MEASUREMENT add_key "" ULONG NO_COMPU_METHOD 0 0 0 4.29497e+09 ECU_ADDRESS 0x414DC ECU_ADDRESS_EXTENSION 1 READ_WRITE /end MEASUREMENT
/begin MEASUREMENT request_key "" ULONG NO_COMPU_METHOD 0 0 0 4.29497e+09 ECU_ADDRESS 0x414E0 ECU_ADDRESS_EXTENSION 1 READ_WRITE /end MEASUREMENT
/begin MEASUREMENT keyctl "" ULONG NO_COMPU_METHOD 0 0 0 4.29497e+09 ECU_ADDRESS 0x414E4 ECU_ADDRESS_EXTENSION 1 READ_WRITE /end MEASUREMENT
/begin MEASUREMENT clone "" ULONG NO_COMPU_METHOD 0 0 0 4.29497e+09 ECU_ADDRESS 0x414E8 ECU_ADDRESS_EXTENSION 1 READ_WRITE /end MEASUREMENT
/begin MEASUREMENT execve "" ULONG NO_COMPU_METHOD 0 0 0 4.29497e+09 ECU_ADDRESS 0x414EC ECU_ADDRESS_EXTENSION 1 READ_WRITE /end MEASUREMENT
/begin MEASUREMENT mmap "" ULONG NO_COMPU_METHOD 0 0 0 4.29497e+09 ECU_ADDRESS 0x414F0 ECU_ADDRESS_EXTENSION 1 READ_WRITE /end MEASUREMENT
/begin MEASUREMENT fadvise64 "" ULONG NO_COMPU_METHOD 0 0 0 4.29497e+09 ECU_ADDRESS 0x414F4 ECU_ADDRESS_EXTENSION 1 READ_WRITE /end MEASUREMENT
/begin MEASUREMENT swapon "" ULONG NO_COMPU_METHOD 0 0 0 4.29497e+09 ECU_ADDRESS 0x414F8 ECU_ADDRESS_EXTENSION 1 READ_WRITE /end MEASUREMENT
/begin MEASUREMENT swapoff "" ULONG NO_COMPU_METHOD 0 0 0 4.29497e+09 ECU_ADDRESS 0x414FC ECU_ADDRESS_EXTENSION 1 READ_WRITE /end MEASUREMENT
/begin MEASUREMENT mprotect "" ULONG NO_COMPU_METHOD 0 0 0 4.29497e+09 ECU_ADDRESS 0x41500 ECU_ADDRESS_EXTENSION 1 READ_WRITE /end MEASUREMENT
/begin MEASUREMENT msync "" ULONG NO_COMPU_METHOD 0 0 0 4.29497e+09 ECU_ADDRESS 0x41504 ECU_ADDRESS_EXTENSION 1 READ_WRITE /end MEASUREMENT
/begin MEASUREMENT mlock "" ULONG NO_COMPU_METHOD 0 0 0 4.29497e+09 ECU_ADDRESS 0x41508 ECU_ADDRESS_EXTENSION 1 READ_WRITE /end MEASUREMENT
/begin MEASUREMENT munlock "" ULONG NO_COMPU_METHOD 0 0 0 4.29497e+09 ECU_ADDRESS 0x4150C ECU_ADDRESS_EXTENSION 1 READ_WRITE /end MEASUREMENT
/begin MEASUREMENT mlockall "" ULONG NO_COMPU_METHOD 0 0 0 4.29497e+09 ECU_ADDRESS 0x41510 ECU_ADDRESS_EXTENSION 1 READ_WRITE /end MEASUREMENT
/begin MEASUREMENT munlockall "" ULONG NO_COMPU_METHOD 0 0 0 4.29497e+09 ECU_ADDRESS 0x41514 ECU_ADDRESS_EXTENSION 1 READ_WRITE /end MEASUREMENT
/begin MEASUREMENT mincore "" ULONG NO_COMPU_METHOD 0 0 0 4.29497e+09 ECU_ADDRESS 0x41518 ECU_ADDRESS_EXTENSION 1 READ_WRITE /end MEASUREMENT
/begin MEASUREMENT madvise "" ULONG NO_COMPU_METHOD 0 0 0 4.29497e+09 ECU_ADDRESS 0x4151C ECU_ADDRESS_EXTENSION 1 READ_WRITE /end MEASUREMENT
/begin MEASUREMENT remap_file_pages "" ULONG NO_COMPU_METHOD 0 0 0 4.29497e+09 ECU_ADDRESS 0x41520 ECU_ADDRESS_EXTENSION 1 READ_WRITE /end MEASUREMENT
/begin MEASUREMENT mbind "" ULONG NO_COMPU_METHOD 0 0 0 4.29497e+09 ECU_ADDRESS 0x41524 ECU_ADDRESS_EXTENSION 1 READ_WRITE /end MEASUREMENT
/begin MEASUREMENT get_mempolicy "" ULONG NO_COMPU_METHOD 0 0 0 4.29497e+09 ECU_ADDRESS 0x41528 ECU_ADDRESS_EXTENSION 1 READ_WRITE /end MEASUREMENT
/begin MEASUREMENT set_mempolicy "" ULONG NO_COMPU_METHOD 0 0 0 4.29497e+09 ECU_ADDRESS 0x4152C ECU_ADDRESS_EXTENSION 1 READ_WRITE /end MEASUREMENT
/begin MEASUREMENT migrate_pages "" ULONG NO_COMPU_METHOD 0 0 0 4.29497e+09 ECU_ADDRESS 0x41530 ECU_ADDRESS_EXTENSION 1 READ_WRITE /end MEASUREMENT
/begin MEASUREMENT move_pages "" ULONG NO_COMPU_METHOD 0 0 0 4.29497e+09 ECU_ADDRESS 0x41534 ECU_ADDRESS_EXTENSION 1 READ_WRITE /end MEASUREMENT
/begin MEASUREMENT rt_tgsigqueueinfo "" ULONG NO_COMPU_METHOD 0 0 0 4.29497e+09 ECU_ADDRESS 0x41538 ECU_ADDRESS_EXTENSION 1 READ_WRITE /end MEASUREMENT
/begin MEASUREMENT perf_event_open "" ULONG NO_COMPU_METHOD 0 0 0 4.29497e+09 ECU_ADDRESS 0x4153C ECU_ADDRESS_EXTENSION 1 READ_WRITE /end MEASUREMENT
/begin MEASUREMENT accept4 "" ULONG NO_COMPU_METHOD 0 0 0 4.29497e+09 ECU_ADDRESS 0x41540 ECU_ADDRESS_EXTENSION 1 READ_WRITE /end MEASUREMENT
/begin MEASUREMENT recvmmsg "" ULONG NO_COMPU_METHOD 0 0 0 4.29497e+09 ECU_ADDRESS 0x41544 ECU_ADDRESS_EXTENSION 1 READ_WRITE /end MEASUREMENT
/begin MEASUREMENT arch_specific_syscall "" ULONG NO_COMPU_METHOD 0 0 0 4.29497e+09 ECU_ADDRESS 0x41548 ECU_ADDRESS_EXTENSION 1 READ_WRITE /end MEASUREMENT
/begin MEASUREMENT wait4 "" ULONG NO_COMPU_METHOD 0 0 0 4.29497e+09 ECU_ADDRESS 0x41588 ECU_ADDRESS_EXTENSION 1 READ_WRITE /end MEASUREMENT
/begin MEASUREMENT renameat2 "" ULONG NO_COMPU_METHOD 0 0 0 4.29497e+09 ECU_ADDRESS 0x415C8 ECU_ADDRESS_EXTENSION 1 READ_WRITE /end MEASUREMENT
/begin MEASUREMENT seccomp "" ULONG NO_COMPU_METHOD 0 0 0 4.29497e+09 ECU_ADDRESS 0x415CC ECU_ADDRESS_EXTENSION 1 READ_WRITE /end MEASUREMENT
/begin MEASUREMENT getrandom "" ULONG NO_COMPU_METHOD 0 0 0 4.29497e+09 ECU_ADDRESS 0x415D0 ECU_ADDRESS_EXTENSION 1 READ_WRITE /end MEASUREMENT
/begin MEASUREMENT memfd_create "" ULONG NO_COMPU_METHOD 0 0 0 4.29497e+09 ECU_ADDRESS 0x415D4 ECU_ADDRESS_EXTENSION 1 READ_WRITE /end MEASUREMENT
/begin MEASUREMENT bpf "" ULONG NO_COMPU_METHOD 0 0 0 4.29497e+09 ECU_ADDRESS 0x415D8 ECU_ADDRESS_EXTENSION 1 READ_WRITE /end MEASUREMENT
/begin MEASUREMENT execveat "" ULONG NO_COMPU_METHOD 0 0 0 4.29497e+09 ECU_ADDRESS 0x415DC ECU_ADDRESS_EXTENSION 1 READ_WRITE /end MEASUREMENT
/begin MEASUREMENT userfaultfd "" ULONG NO_COMPU_METHOD 0 0 0 4.29497e+09 ECU_ADDRESS 0x415E0 ECU_ADDRESS_EXTENSION 1 READ_WRITE /end MEASUREMENT
/begin MEASUREMENT membarrier "" ULONG NO_COMPU_METHOD 0 0 0 4.29497e+09 ECU_ADDRESS 0x415E4 ECU_ADDRESS_EXTENSION 1 READ_WRITE /end MEASUREMENT
/begin MEASUREMENT mlock2 "" ULONG NO_COMPU_METHOD 0 0 0 4.29497e+09 ECU_ADDRESS 0x415E8 ECU_ADDRESS_EXTENSION 1 READ_WRITE /end MEASUREMENT
/begin MEASUREMENT copy_file_range "" ULONG NO_COMPU_METHOD 0 0 0 4.29497e+09 ECU_ADDRESS 0x415EC ECU_ADDRESS_EXTENSION 1 READ_WRITE /end MEASUREMENT
/begin MEASUREMENT preadv2 "" ULONG NO_COMPU_METHOD 0 0 0 4.29497e+09 ECU_ADDRESS 0x415F0 ECU_ADDRESS_EXTENSION 1 READ_WRITE /end MEASUREMENT
/begin MEASUREMENT pwritev2 "" ULONG NO_COMPU_METHOD 0 0 0 4.29497e+09 ECU_ADDRESS 0x415F4 ECU_ADDRESS_EXTENSION 1 READ_WRITE /end MEASUREMENT
/begin MEASUREMENT pkey_mprotect "" ULONG NO_COMPU_METHOD 0 0 0 4.29497e+09 ECU_ADDRESS 0x415F8 ECU_ADDRESS_EXTENSION 1 READ_WRITE /end MEASUREMENT
/begin MEASUREMENT pkey_alloc "" ULONG NO_COMPU_METHOD 0 0 0 4.29497e+09 ECU_ADDRESS 0x415FC ECU_ADDRESS_EXTENSION 1 READ_WRITE /end MEASUREMENT
/begin MEASUREMENT pkey_free "" ULONG NO_COMPU_METHOD 0 0 0 4.29497e+09 ECU_ADDRESS 0x41600 ECU_ADDRESS_EXTENSION 1 READ_WRITE /end MEASUREMENT
/begin MEASUREMENT statx "" ULONG NO_COMPU_METHOD 0 0 0 4.29497e+09 ECU_ADDRESS 0x41604 ECU_ADDRESS_EXTENSION 1 READ_WRITE /end MEASUREMENT
/begin MEASUREMENT io_pgetevents "" ULONG NO_COMPU_METHOD 0 0 0 4.29497e+09 ECU_ADDRESS 0x41608 ECU_ADDRESS_EXTENSION 1 READ_WRITE /end MEASUREMENT
/begin MEASUREMENT rseq "" ULONG NO_COMPU_METHOD 0 0 0 4.29497e+09 ECU_ADDRESS 0x4160C ECU_ADDRESS_EXTENSION 1 READ_WRITE /end MEASUREMENT
/begin MEASUREMENT kexec_file_load "" ULONG NO_COMPU_METHOD 0 0 0 4.29497e+09 ECU_ADDRESS 0x41610 ECU_ADDRESS_EXTENSION 1 READ_WRITE /end MEASUREMENT
/begin MEASUREMENT pidfd_send_signal "" ULONG NO_COMPU_METHOD 0 0 0 4.29497e+09 ECU_ADDRESS 0x41818 ECU_ADDRESS_EXTENSION 1 READ_WRITE /end MEASUREMENT
/begin MEASUREMENT io_uring_setup "" ULONG NO_COMPU_METHOD 0 0 0 4.29497e+09 ECU_ADDRESS 0x4181C ECU_ADDRESS_EXTENSION 1 READ_WRITE /end MEASUREMENT
/begin MEASUREMENT io_uring_enter "" ULONG NO_COMPU_METHOD 0 0 0 4.29497e+09 ECU_ADDRESS 0x41820 ECU_ADDRESS_EXTENSION 1 READ_WRITE /end MEASUREMENT
/begin MEASUREMENT io_uring_register "" ULONG NO_COMPU_METHOD 0 0 0 4.29497e+09 ECU_ADDRESS 0x41824 ECU_ADDRESS_EXTENSION 1 READ_WRITE /end MEASUREMENT
/begin MEASUREMENT open_tree "" ULONG NO_COMPU_METHOD 0 0 0 4.29497e+09 ECU_ADDRESS 0x41828 ECU_ADDRESS_EXTENSION 1 READ_WRITE /end MEASUREMENT
/begin MEASUREMENT move_mount "" ULONG NO_COMPU_METHOD 0 0 0 4.29497e+09 ECU_ADDRESS 0x4182C ECU_ADDRESS_EXTENSION 1 READ_WRITE /end MEASUREMENT
/begin MEASUREMENT fsopen "" ULONG NO_COMPU_METHOD 0 0 0 4.29497e+09 ECU_ADDRESS 0x41830 ECU_ADDRESS_EXTENSION 1 READ_WRITE /end MEASUREMENT
/begin MEASUREMENT fsconfig "" ULONG NO_COMPU_METHOD 0 0 0 4.29497e+09 ECU_ADDRESS 0x41834 ECU_ADDRESS_EXTENSION 1 READ_WRITE /end MEASUREMENT
/begin MEASUREMENT fsmount "" ULONG NO_COMPU_METHOD 0 0 0 4.29497e+09 ECU_ADDRESS 0x41838 ECU_ADDRESS_EXTENSION 1 READ_WRITE /end MEASUREMENT
/begin MEASUREMENT fspick "" ULONG NO_COMPU_METHOD 0 0 0 4.29497e+09 ECU_ADDRESS 0x4183C ECU_ADDRESS_EXTENSION 1 READ_WRITE /end MEASUREMENT
/begin MEASUREMENT pidfd_open "" ULONG NO_COMPU_METHOD 0 0 0 4.29497e+09 ECU_ADDRESS 0x41840 ECU_ADDRESS_EXTENSION 1 READ_WRITE /end MEASUREMENT
/begin MEASUREMENT clone3 "" ULONG NO_COMPU_METHOD 0 0 0 4.29497e+09 ECU_ADDRESS 0x41844 ECU_ADDRESS_EXTENSION 1 READ_WRITE /end MEASUREMENT
/begin MEASUREMENT close_range "" ULONG NO_COMPU_METHOD 0 0 0 4.29497e+09 ECU_ADDRESS 0x41848 ECU_ADDRESS_EXTENSION 1 READ_WRITE /end MEASUREMENT
/begin MEASUREMENT openat2 "" ULONG NO_COMPU_METHOD 0 0 0 4.29497e+09 ECU_ADDRESS 0x4184C ECU_ADDRESS_EXTENSION 1 READ_WRITE /end MEASUREMENT
/begin MEASUREMENT pidfd_getfd "" ULONG NO_COMPU_METHOD 0 0 0 4.29497e+09 ECU_ADDRESS 0x41850 ECU_ADDRESS_EXTENSION 1 READ_WRITE /end MEASUREMENT
/begin MEASUREMENT faccessat2 "" ULONG NO_COMPU_METHOD 0 0 0 4.29497e+09 ECU_ADDRESS 0x41854 ECU_ADDRESS_EXTENSION 1 READ_WRITE /end MEASUREMENT
/begin MEASUREMENT process_madvise "" ULONG NO_COMPU_METHOD 0 0 0 4.29497e+09 ECU_ADDRESS 0x41858 ECU_ADDRESS_EXTENSION 1 READ_WRITE /end MEASUREMENT
/begin MEASUREMENT epoll_pwait2 "" ULONG NO_COMPU_METHOD 0 0 0 4.29497e+09 ECU_ADDRESS 0x4185C ECU_ADDRESS_EXTENSION 1 READ_WRITE /end MEASUREMENT
/begin MEASUREMENT mount_setattr "" ULONG NO_COMPU_METHOD 0 0 0 4.29497e+09 ECU_ADDRESS 0x41860 ECU_ADDRESS_EXTENSION 1 READ_WRITE /end MEASUREMENT
/begin MEASUREMENT quotactl_fd "" ULONG NO_COMPU_METHOD 0 0 0 4.29497e+09 ECU_ADDRESS 0x41864 ECU_ADDRESS_EXTENSION 1 READ_WRITE /end MEASUREMENT
/begin MEASUREMENT landlock_create_ruleset "" ULONG NO_COMPU_METHOD 0 0 0 4.29497e+09 ECU_ADDRESS 0x41868 ECU_ADDRESS_EXTENSION 1 READ_WRITE /end MEASUREMENT
/begin MEASUREMENT landlock_add_rule "" ULONG NO_COMPU_METHOD 0 0 0 4.29497e+09 ECU_ADDRESS 0x4186C ECU_ADDRESS_EXTENSION 1 READ_WRITE /end MEASUREMENT
/begin MEASUREMENT landlock_restrict_self "" ULONG NO_COMPU_METHOD 0 0 0 4.29497e+09 ECU_ADDRESS 0x41870 ECU_ADDRESS_EXTENSION 1 READ_WRITE /end MEASUREMENT
/begin MEASUREMENT memfd_secret "" ULONG NO_COMPU_METHOD 0 0 0 4.29497e+09 ECU_ADDRESS 0x41874 ECU_ADDRESS_EXTENSION 1 READ_WRITE /end MEASUREMENT
/begin MEASUREMENT process_mrelease "" ULONG NO_COMPU_METHOD 0 0 0 4.29497e+09 ECU_ADDRESS 0x41878 ECU_ADDRESS_EXTENSION 1 READ_WRITE /end MEASUREMENT
/begin MEASUREMENT futex_waitv "" ULONG NO_COMPU_METHOD 0 0 0 4.29497e+09 ECU_ADDRESS 0x4187C ECU_ADDRESS_EXTENSION 1 READ_WRITE /end MEASUREMENT
/begin MEASUREMENT set_mempolicy_home_node "" ULONG NO_COMPU_METHOD 0 0 0 4.29497e+09 ECU_ADDRESS 0x41880 ECU_ADDRESS_EXTENSION 1 READ_WRITE /end MEASUREMENT
/begin MEASUREMENT cachestat "" ULONG NO_COMPU_METHOD 0 0 0 4.29497e+09 ECU_ADDRESS 0x41884 ECU_ADDRESS_EXTENSION 1 READ_WRITE /end MEASUREMENT
/begin MEASUREMENT fchmodat2 "" ULONG NO_COMPU_METHOD 0 0 0 4.29497e+09 ECU_ADDRESS 0x41888 ECU_ADDRESS_EXTENSION 1 READ_WRITE /end MEASUREMENT
/begin MEASUREMENT map_shadow_stack "" ULONG NO_COMPU_METHOD 0 0 0 4.29497e+09 ECU_ADDRESS 0x4188C ECU_ADDRESS_EXTENSION 1 READ_WRITE /end MEASUREMENT
/begin MEASUREMENT futex_wake "" ULONG NO_COMPU_METHOD 0 0 0 4.29497e+09 ECU_ADDRESS 0x41890 ECU_ADDRESS_EXTENSION 1 READ_WRITE /end MEASUREMENT
/begin MEASUREMENT futex_wait "" ULONG NO_COMPU_METHOD 0 0 0 4.29497e+09 ECU_ADDRESS 0x41894 ECU_ADDRESS_EXTENSION 1 READ_WRITE /end MEASUREMENT
/begin MEASUREMENT futex_requeue "" ULONG NO_COMPU_METHOD 0 0 0 4.29497e+09 ECU_ADDRESS 0x41898 ECU_ADDRESS_EXTENSION 1 READ_WRITE /end MEASUREMENT
/begin MEASUREMENT statmount "" ULONG NO_COMPU_METHOD 0 0 0 4.29497e+09 ECU_ADDRESS 0x4189C ECU_ADDRESS_EXTENSION 1 READ_WRITE /end MEASUREMENT
/begin MEASUREMENT listmount "" ULONG NO_COMPU_METHOD 0 0 0 4.29497e+09 ECU_ADDRESS 0x418A0 ECU_ADDRESS_EXTENSION 1 READ_WRITE /end MEASUREMENT
/begin MEASUREMENT lsm_get_self_attr "" ULONG NO_COMPU_METHOD 0 0 0 4.29497e+09 ECU_ADDRESS 0x418A4 ECU_ADDRESS_EXTENSION 1 READ_WRITE /end MEASUREMENT
/begin MEASUREMENT lsm_set_self_attr "" ULONG NO_COMPU_METHOD 0 0 0 4.29497e+09 ECU_ADDRESS 0x418A8 ECU_ADDRESS_EXTENSION 1 READ_WRITE /end MEASUREMENT
/begin MEASUREMENT lsm_list_modules "" ULONG NO_COMPU_METHOD 0 0 0 4.29497e+09 ECU_ADDRESS 0x418AC ECU_ADDRESS_EXTENSION 1 READ_WRITE /end MEASUREMENT
/begin MEASUREMENT mseal "" ULONG NO_COMPU_METHOD 0 0 0 4.29497e+09 ECU_ADDRESS 0x418B0 ECU_ADDRESS_EXTENSION 1 READ_WRITE /end MEASUREMENT
/* Typedefs */
/begin RECORD_LAYOUT U8 FNC_VALUES 1 UBYTE ROW_DIR DIRECT /end RECORD_LAYOUT
/begin RECORD_LAYOUT A_U8 AXIS_PTS_X 1 UBYTE INDEX_INCR DIRECT /end RECORD_LAYOUT
/begin TYPEDEF_MEASUREMENT M_U8 "" UBYTE NO_COMPU_METHOD 0 0 0 255 /end TYPEDEF_MEASUREMENT
/begin TYPEDEF_CHARACTERISTIC C_U8 "" VALUE U8 0 NO_COMPU_METHOD 0 255 /end TYPEDEF_CHARACTERISTIC
/begin RECORD_LAYOUT U16 FNC_VALUES 1 UWORD ROW_DIR DIRECT /end RECORD_LAYOUT
/begin RECORD_LAYOUT A_U16 AXIS_PTS_X 1 UWORD INDEX_INCR DIRECT /end RECORD_LAYOUT
/begin TYPEDEF_MEASUREMENT M_U16 "" UWORD NO_COMPU_METHOD 0 0 0 65535 /end TYPEDEF_MEASUREMENT
/begin TYPEDEF_CHARACTERISTIC C_U16 "" VALUE U16 0 NO_COMPU_METHOD 0 65535 /end TYPEDEF_CHARACTERISTIC
/begin RECORD_LAYOUT U32 FNC_VALUES 1 ULONG ROW_DIR DIRECT /end RECORD_LAYOUT
/begin RECORD_LAYOUT A_U32 AXIS_PTS_X 1 ULONG INDEX_INCR DIRECT /end RECORD_LAYOUT
/begin TYPEDEF_MEASUREMENT M_U32 "" ULONG NO_COMPU_METHOD 0 0 0 4294967295 /end TYPEDEF_MEASUREMENT
/begin TYPEDEF_CHARACTERISTIC C_U32 "" VALUE U32 0 NO_COMPU_METHOD 0 4.29497e+09 /end TYPEDEF_CHARACTERISTIC
/begin RECORD_LAYOUT U64 FNC_VALUES 1 A_UINT64 ROW_DIR DIRECT /end RECORD_LAYOUT
/begin RECORD_LAYOUT A_U64 AXIS_PTS_X 1 A_UINT64 INDEX_INCR DIRECT /end RECORD_LAYOUT
/begin TYPEDEF_MEASUREMENT M_U64 "" A_UINT64 NO_COMPU_METHOD 0 0 0 1000000000000 /end TYPEDEF_MEASUREMENT
/begin TYPEDEF_CHARACTERISTIC C_U64 "" VALUE U64 0 NO_COMPU_METHOD 0 1e+12 /end TYPEDEF_CHARACTERISTIC
/begin RECORD_LAYOUT I8 FNC_VALUES 1 SBYTE ROW_DIR DIRECT /end RECORD_LAYOUT
/begin RECORD_LAYOUT A_I8 AXIS_PTS_X 1 SBYTE INDEX_INCR DIRECT /end RECORD_LAYOUT
/begin TYPEDEF_MEASUREMENT M_I8 "" SBYTE NO_COMPU_METHOD 0 0 -128 127 /end TYPEDEF_MEASUREMENT
/begin TYPEDEF_CHARACTERISTIC C_I8 "" VALUE I8 0 NO_COMPU_METHOD -128 127 /end TYPEDEF_CHARACTERISTIC
/begin RECORD_LAYOUT I16 FNC_VALUES 1 SWORD ROW_DIR DIRECT /end RECORD_LAYOUT
/begin RECORD_LAYOUT A_I16 AXIS_PTS_X 1 SWORD INDEX_INCR DIRECT /end RECORD_LAYOUT
/begin TYPEDEF_MEASUREMENT M_I16 "" SWORD NO_COMPU_METHOD 0 0 -32768 32767 /end TYPEDEF_MEASUREMENT
/begin TYPEDEF_CHARACTERISTIC C_I16 "" VALUE I16 0 NO_COMPU_METHOD -32768 32767 /end TYPEDEF_CHARACTERISTIC
/begin RECORD_LAYOUT I32 FNC_VALUES 1 SLONG ROW_DIR DIRECT /end RECORD_LAYOUT
/begin RECORD_LAYOUT A_I32 AXIS_PTS_X 1 SLONG INDEX_INCR DIRECT /end RECORD_LAYOUT
/begin TYPEDEF_MEASUREMENT M_I32 "" SLONG NO_COMPU_METHOD 0 0 -2147483648 2147483647 /end TYPEDEF_MEASUREMENT
/begin TYPEDEF_CHARACTERISTIC C_I32 "" VALUE I32 0 NO_COMPU_METHOD -2.14748e+09 2.14748e+09 /end TYPEDEF_CHARACTERISTIC
/begin RECORD_LAYOUT I64 FNC_VALUES 1 A_INT64 ROW_DIR DIRECT /end RECORD_LAYOUT
/begin RECORD_LAYOUT A_I64 AXIS_PTS_X 1 A_INT64 INDEX_INCR DIRECT /end RECORD_LAYOUT
/begin TYPEDEF_MEASUREMENT M_I64 "" A_INT64 NO_COMPU_METHOD 0 0 -1000000000000 1000000000000 /end TYPEDEF_MEASUREMENT
/begin TYPEDEF_CHARACTERISTIC C_I64 "" VALUE I64 0 NO_COMPU_METHOD -1e+12 1e+12 /end TYPEDEF_CHARACTERISTIC
/begin RECORD_LAYOUT F32 FNC_VALUES 1 FLOAT32_IEEE ROW_DIR DIRECT /end RECORD_LAYOUT
/begin RECORD_LAYOUT A_F32 AXIS_PTS_X 1 FLOAT32_IEEE INDEX_INCR DIRECT /end RECORD_LAYOUT
/begin TYPEDEF_MEASUREMENT M_F32 "" FLOAT32_IEEE NO_COMPU_METHOD 0 0 -1e+12 1e+12 /end TYPEDEF_MEASUREMENT
/begin TYPEDEF_CHARACTERISTIC C_F32 "" VALUE F32 0 NO_COMPU_METHOD -1e+12 1e+12 /end TYPEDEF_CHARACTERISTIC
/begin RECORD_LAYOUT F64 FNC_VALUES 1 FLOAT64_IEEE ROW_DIR DIRECT /end RECORD_LAYOUT
/begin RECORD_LAYOUT A_F64 AXIS_PTS_X 1 FLOAT64_IEEE INDEX_INCR DIRECT /end RECORD_LAYOUT
/begin TYPEDEF_MEASUREMENT M_F64 "" FLOAT64_IEEE NO_COMPU_METHOD 0 0 -1e+12 1e+12 /end TYPEDEF_MEASUREMENT
/begin TYPEDEF_CHARACTERISTIC C_F64 "" VALUE F64 0 NO_COMPU_METHOD -1e+12 1e+12 /end TYPEDEF_CHARACTERISTIC
/* Groups */
/begin GROUP mainloop_event "Measurement event group" /begin REF_MEASUREMENT syscall_count syscall_rate /end REF_MEASUREMENT /end GROUP
/begin GROUP process_event "Measurement event group" /begin REF_MEASUREMENT new_process_pid /end REF_MEASUREMENT /end GROUP
/begin GROUP syscall_event "Measurement event group"
 /begin REF_MEASUREMENT syscall_nr syscall_pid io_setup io_destroy io_submit io_cancel io_getevents setxattr lsetxattr fsetxattr getxattr lgetxattr fgetxattr listxattr llistxattr flistxattr removexattr lremovexattr fremovexattr getcwd lookup_dcookie eventfd2 epoll_create1 epoll_ctl epoll_pwait dup dup3 fcntl inotify_init1 inotify_add_watch inotify_rm_watch ioctl ioprio_set ioprio_get flock mknodat mkdirat unlinkat symlinkat linkat renameat umount2 mount pivot_root nfsservctl statfs fstatfs truncate ftruncate fallocate faccessat chdir fchdir chroot fchmod fchmodat fchownat fchown openat close vhangup pipe2 quotactl getdents64 lseek read write readv writev pread64 pwrite64 preadv pwritev sendfile pselect6 ppoll signalfd4 vmsplice splice tee readlinkat fstatat fstat sync fsync fdatasync sync_file_range timerfd_create timerfd_settime timerfd_gettime utimensat acct capget capset personality exit exit_group waitid set_tid_address unshare futex set_robust_list get_robust_list nanosleep getitimer setitimer kexec_load init_module delete_module timer_create timer_gettime timer_getoverrun timer_settime timer_delete clock_settime clock_gettime clock_getres clock_nanosleep syslog ptrace sched_setparam sched_setscheduler sched_getscheduler sched_getparam sched_setaffinity sched_getaffinity sched_yield sched_get_priority_max sched_get_priority_min sched_rr_get_interval restart_syscall kill tkill tgkill sigaltstack rt_sigsuspend rt_sigaction rt_sigprocmask rt_sigpending rt_sigtimedwait rt_sigqueueinfo rt_sigreturn setpriority getpriority reboot setregid setgid setreuid setuid setresuid getresuid setresgid getresgid setfsuid setfsgid times setpgid getpgid getsid setsid getgroups setgroups uname sethostname setdomainname getrlimit setrlimit getrusage umask prctl getcpu gettimeofday settimeofday adjtimex getpid getppid getuid geteuid getgid getegid gettid sysinfo mq_open mq_unlink mq_timedsend mq_timedreceive mq_notify mq_getsetattr msgget msgctl msgrcv msgsnd semget semctl semtimedop semop shmget shmctl shmat shmdt socket socketpair bind listen accept connect getsockname getpeername sendto recvfrom setsockopt getsockopt shutdown sendmsg recvmsg readahead brk munmap mremap add_key request_key keyctl clone execve mmap fadvise64 swapon swapoff mprotect msync mlock munlock mlockall munlockall mincore madvise remap_file_pages mbind get_mempolicy set_mempolicy migrate_pages move_pages rt_tgsigqueueinfo perf_event_open accept4 recvmmsg arch_specific_syscall wait4 renameat2 seccomp getrandom memfd_create bpf execveat userfaultfd membarrier mlock2 copy_file_range preadv2 pwritev2 pkey_mprotect pkey_alloc pkey_free statx io_pgetevents rseq kexec_file_load pidfd_send_signal io_uring_setup io_uring_enter io_uring_register open_tree move_mount fsopen fsconfig fsmount fspick pidfd_open clone3 close_range openat2 pidfd_getfd faccessat2 process_madvise epoll_pwait2 mount_setattr quotactl_fd landlock_create_ruleset landlock_add_rule landlock_restrict_self memfd_secret process_mrelease futex_waitv set_mempolicy_home_node cachestat fchmodat2 map_shadow_stack futex_wake futex_wait futex_requeue statmount listmount lsm_get_self_attr lsm_set_self_attr lsm_list_modules mseal /end REF_MEASUREMENT
/end GROUP
/begin GROUP Events "Events" ROOT
 /begin SUB_GROUP async mainloop_event process_event syscall_event sendto recvfrom /end SUB_GROUP
/end GROUP
/* Conversions */
/begin COMPU_METHOD conv.bool "" TAB_VERB "%.0" "" COMPU_TAB_REF conv.bool.table /end COMPU_METHOD
/begin COMPU_VTAB conv.bool.table "" TAB_VERB 2 0 "false" 1 "true" /end COMPU_VTAB
/begin COMPU_METHOD conv.events "" TAB_VERB "%.0 " "" COMPU_TAB_REF conv.events.table /end COMPU_METHOD
/begin COMPU_VTAB conv.events.table "" TAB_VERB 6 0 "async" 1 "mainloop_event" 2 "process_event" 3 "syscall_event" 4 "sendto" 5 "recvfrom" /end COMPU_VTAB
/begin MOD_PAR "" EPK "_21_43_27" ADDR_EPK 0x80000000
 /begin MEMORY_SEGMENT epk "" DATA FLASH INTERN 0x80000000 9 -1 -1 -1 -1 -1
  /begin IF_DATA XCP
   /begin SEGMENT 0 2 0 0 0 /begin CHECKSUM XCP_CRC_16_CITT MAX_BLOCK_SIZE 0xFFFF EXTERNAL_FUNCTION "" /end CHECKSUM
    /begin PAGE 0 ECU_ACCESS_DONT_CARE XCP_READ_ACCESS_DONT_CARE XCP_WRITE_ACCESS_DONT_CARE /end PAGE
    /begin PAGE 1 ECU_ACCESS_DONT_CARE XCP_READ_ACCESS_DONT_CARE XCP_WRITE_ACCESS_NOT_ALLOWED /end PAGE
   /end SEGMENT
  /end IF_DATA
 /end MEMORY_SEGMENT
/end MOD_PAR
/begin IF_DATA XCP
 /begin PROTOCOL_LAYER 0x104 1000 2000 0 0 0 0 0 248 1024 BYTE_ORDER_MSB_LAST ADDRESS_GRANULARITY_BYTE OPTIONAL_CMD GET_COMM_MODE_INFO OPTIONAL_CMD GET_ID OPTIONAL_CMD SET_REQUEST OPTIONAL_CMD SET_MTA OPTIONAL_CMD UPLOAD OPTIONAL_CMD SHORT_UPLOAD OPTIONAL_CMD DOWNLOAD OPTIONAL_CMD SHORT_DOWNLOAD OPTIONAL_CMD GET_CAL_PAGE OPTIONAL_CMD SET_CAL_PAGE OPTIONAL_CMD COPY_CAL_PAGE OPTIONAL_CMD GET_PAG_PROCESSOR_INFO OPTIONAL_CMD GET_SEGMENT_INFO OPTIONAL_CMD GET_PAGE_INFO OPTIONAL_CMD GET_SEGMENT_MODE OPTIONAL_CMD SET_SEGMENT_MODE OPTIONAL_CMD BUILD_CHECKSUM OPTIONAL_CMD USER_CMD OPTIONAL_CMD GET_DAQ_RESOLUTION_INFO OPTIONAL_CMD GET_DAQ_PROCESSOR_INFO OPTIONAL_CMD GET_DAQ_EVENT_INFO OPTIONAL_CMD FREE_DAQ OPTIONAL_CMD ALLOC_DAQ OPTIONAL_CMD ALLOC_ODT OPTIONAL_CMD ALLOC_ODT_ENTRY OPTIONAL_CMD SET_DAQ_PTR OPTIONAL_CMD WRITE_DAQ OPTIONAL_CMD GET_DAQ_LIST_MODE OPTIONAL_CMD SET_DAQ_LIST_MODE OPTIONAL_CMD START_STOP_SYNCH OPTIONAL_CMD START_STOP_DAQ_LIST OPTIONAL_CMD GET_DAQ_CLOCK OPTIONAL_CMD WRITE_DAQ_MULTIPLE OPTIONAL_CMD TIME_CORRELATION_PROPERTIES OPTIONAL_LEVEL1_CMD GET_VERSION /end PROTOCOL_LAYER
 /begin DAQ DYNAMIC 0 6 0 OPTIMISATION_TYPE_DEFAULT ADDRESS_EXTENSION_FREE IDENTIFICATION_FIELD_TYPE_RELATIVE_BYTE GRANULARITY_ODT_ENTRY_SIZE_DAQ_BYTE 0xF8 OVERLOAD_INDICATION_PID PRESCALER_SUPPORTED /begin TIMESTAMP_SUPPORTED 0x1 SIZE_DWORD UNIT_1NS TIMESTAMP_FIXED /end TIMESTAMP_SUPPORTED /begin EVENT "async" "async" 0x0 DAQ 0xFF 100 4 0 CONSISTENCY EVENT /end EVENT
  /begin EVENT "mainloop_event" "mainloop_event" 0x1 DAQ 0xFF 0 0 0 CONSISTENCY EVENT /end EVENT
  /begin EVENT "process_event" "process_event" 0x2 DAQ 0xFF 0 0 0 CONSISTENCY EVENT /end EVENT
  /begin EVENT "syscall_event" "syscall_event" 0x3 DAQ 0xFF 0 0 0 CONSISTENCY EVENT /end EVENT
  /begin EVENT "sendto" "sendto" 0x4 DAQ 0xFF 0 0 0 CONSISTENCY EVENT /end EVENT
  /begin EVENT "recvfrom" "recvfrom" 0x5 DAQ 0xFF 0 0 0 CONSISTENCY EVENT /end EVENT
 /end DAQ
 /begin XCP_ON_TCP_IP 0x104 5555 ADDRESS "192.168.0.206" /end XCP_ON_TCP_IP
/end IF_DATA
/end MODULE
/end PROJECT
