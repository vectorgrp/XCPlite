ASAP2_VERSION 1 71
/begin PROJECT ptp_demo ""
/begin HEADER "" VERSION "1.0" PROJECT_NO XCPLITE__CASDD /end HEADER
/begin MODULE ptp_demo ""
/include "XCP_104.aml"
/begin MOD_COMMON "" BYTE_ORDER MSB_LAST ALIGNMENT_BYTE 1 ALIGNMENT_WORD 1 ALIGNMENT_LONG 1 ALIGNMENT_FLOAT16_IEEE 1 ALIGNMENT_FLOAT32_IEEE 1 ALIGNMENT_FLOAT64_IEEE 1 ALIGNMENT_INT64 1 /end MOD_COMMON
/begin CHARACTERISTIC params.reset "Reset PTP observer state" VALUE 0x80010000 U8 0 NO_COMPU_METHOD 0 1 /end CHARACTERISTIC
/begin CHARACTERISTIC params.t1_correction "Correction for t1" VALUE 0x80010004 I32 0 NO_COMPU_METHOD -100 100 /end CHARACTERISTIC
/begin CHARACTERISTIC params.drift_correction "Correction for drift" VALUE 0x80010008 I32 0 NO_COMPU_METHOD -100000 100000 /end CHARACTERISTIC
/begin CHARACTERISTIC params.drift_filter_size "Drift filter size" VALUE 0x8001000C U8 0 NO_COMPU_METHOD 1 300 /end CHARACTERISTIC
/begin CHARACTERISTIC params.jitter_rms_filter_size "Jitter RMS filter size" VALUE 0x8001000D U8 0 NO_COMPU_METHOD 1 300 /end CHARACTERISTIC
/begin CHARACTERISTIC params.jitter_avg_filter_size "Jitter average filter size" VALUE 0x8001000E U8 0 NO_COMPU_METHOD 1 300 /end CHARACTERISTIC
/begin CHARACTERISTIC params.max_correction "Maximum correction per cycle" VALUE 0x80010010 F64 0 NO_COMPU_METHOD 0 100 PHYS_UNIT "ns" /end CHARACTERISTIC
/begin CHARACTERISTIC params.servo_i_gain "Integral gain for servo" VALUE 0x80010020 F64 0 NO_COMPU_METHOD 0 1 /end CHARACTERISTIC
/begin CHARACTERISTIC params.servo_p_gain "Proportional gain for servo" VALUE 0x80010018 F64 0 NO_COMPU_METHOD 0 1 /end CHARACTERISTIC
/begin MEASUREMENT gPtpC.gm.domain "domain" UBYTE NO_COMPU_METHOD 0 0 0 255 ECU_ADDRESS 0x4031C ECU_ADDRESS_EXTENSION 1 READ_WRITE
 /begin IF_DATA XCP
  /begin DAQ_EVENT VARIABLE /begin DEFAULT_EVENT_LIST EVENT 0x0 /end DEFAULT_EVENT_LIST /end DAQ_EVENT
 /end IF_DATA
/end MEASUREMENT
/begin CHARACTERISTIC gPtpC.gm.uuid "grandmaster UUID" VAL_BLK 0x4031D U8 0 NO_COMPU_METHOD 0 255 MATRIX_DIM 8 1 ECU_ADDRESS_EXTENSION 1
 /begin IF_DATA XCP
  /begin DAQ_EVENT VARIABLE /begin DEFAULT_EVENT_LIST EVENT 0x0 /end DEFAULT_EVENT_LIST /end DAQ_EVENT
 /end IF_DATA
/end CHARACTERISTIC
/begin CHARACTERISTIC gPtpC.gm.addr "grandmaster IP address" VAL_BLK 0x40325 U8 0 NO_COMPU_METHOD 0 255 MATRIX_DIM 4 1 ECU_ADDRESS_EXTENSION 1
 /begin IF_DATA XCP
  /begin DAQ_EVENT VARIABLE /begin DEFAULT_EVENT_LIST EVENT 0x0 /end DEFAULT_EVENT_LIST /end DAQ_EVENT
 /end IF_DATA
/end CHARACTERISTIC
/begin MEASUREMENT gPtpC.sync_local_time "SYNC RX timestamp" A_UINT64 NO_COMPU_METHOD 0 0 0 1e+12 ECU_ADDRESS 0x40340 ECU_ADDRESS_EXTENSION 1 READ_WRITE
 /begin IF_DATA XCP
  /begin DAQ_EVENT VARIABLE /begin DEFAULT_EVENT_LIST EVENT 0x0 /end DEFAULT_EVENT_LIST /end DAQ_EVENT
 /end IF_DATA
/end MEASUREMENT
/begin MEASUREMENT gPtpC.sync_master_time "SYNC timestamp" A_UINT64 NO_COMPU_METHOD 0 0 0 1e+12 ECU_ADDRESS 0x40348 ECU_ADDRESS_EXTENSION 1 READ_WRITE
 /begin IF_DATA XCP
  /begin DAQ_EVENT VARIABLE /begin DEFAULT_EVENT_LIST EVENT 0x0 /end DEFAULT_EVENT_LIST /end DAQ_EVENT
 /end IF_DATA
/end MEASUREMENT
/begin MEASUREMENT gPtpC.sync_correction "SYNC correction" ULONG NO_COMPU_METHOD 0 0 0 1e+06 ECU_ADDRESS 0x40350 ECU_ADDRESS_EXTENSION 1 PHYS_UNIT "ns" READ_WRITE
 /begin IF_DATA XCP
  /begin DAQ_EVENT VARIABLE /begin DEFAULT_EVENT_LIST EVENT 0x0 /end DEFAULT_EVENT_LIST /end DAQ_EVENT
 /end IF_DATA
/end MEASUREMENT
/begin MEASUREMENT gPtpC.sync_sequenceId "SYNC sequence counter" UWORD NO_COMPU_METHOD 0 0 0 65535 ECU_ADDRESS 0x40354 ECU_ADDRESS_EXTENSION 1 READ_WRITE
 /begin IF_DATA XCP
  /begin DAQ_EVENT VARIABLE /begin DEFAULT_EVENT_LIST EVENT 0x0 /end DEFAULT_EVENT_LIST /end DAQ_EVENT
 /end IF_DATA
/end MEASUREMENT
/begin MEASUREMENT gPtpC.sync_steps "SYNC mode" UBYTE NO_COMPU_METHOD 0 0 0 255 ECU_ADDRESS 0x40360 ECU_ADDRESS_EXTENSION 1 READ_WRITE
 /begin IF_DATA XCP
  /begin DAQ_EVENT VARIABLE /begin DEFAULT_EVENT_LIST EVENT 0x0 /end DEFAULT_EVENT_LIST /end DAQ_EVENT
 /end IF_DATA
/end MEASUREMENT
/begin MEASUREMENT gPtpC.sync_cycle_time "SYNC cycle time" A_UINT64 NO_COMPU_METHOD 0 0 1e+09 1e+09 ECU_ADDRESS 0x40358 ECU_ADDRESS_EXTENSION 1 PHYS_UNIT "ns" READ_WRITE
 /begin IF_DATA XCP
  /begin DAQ_EVENT VARIABLE /begin DEFAULT_EVENT_LIST EVENT 0x0 /end DEFAULT_EVENT_LIST /end DAQ_EVENT
 /end IF_DATA
/end MEASUREMENT
/begin MEASUREMENT gPtpC.flup_master_time "FOLLOW_UP timestamp" A_UINT64 NO_COMPU_METHOD 0 0 0 1e+12 ECU_ADDRESS 0x40368 ECU_ADDRESS_EXTENSION 1 READ_WRITE
 /begin IF_DATA XCP
  /begin DAQ_EVENT VARIABLE /begin DEFAULT_EVENT_LIST EVENT 0x0 /end DEFAULT_EVENT_LIST /end DAQ_EVENT
 /end IF_DATA
/end MEASUREMENT
/begin MEASUREMENT gPtpC.flup_sequenceId "FOLLOW_UP sequence counter" UWORD NO_COMPU_METHOD 0 0 0 65535 ECU_ADDRESS 0x40374 ECU_ADDRESS_EXTENSION 1 READ_WRITE
 /begin IF_DATA XCP
  /begin DAQ_EVENT VARIABLE /begin DEFAULT_EVENT_LIST EVENT 0x0 /end DEFAULT_EVENT_LIST /end DAQ_EVENT
 /end IF_DATA
/end MEASUREMENT
/begin MEASUREMENT gPtpC.flup_correction "FOLLOW_UP correction" ULONG NO_COMPU_METHOD 0 0 0 1e+06 ECU_ADDRESS 0x40370 ECU_ADDRESS_EXTENSION 1 PHYS_UNIT "ns" READ_WRITE
 /begin IF_DATA XCP
  /begin DAQ_EVENT VARIABLE /begin DEFAULT_EVENT_LIST EVENT 0x0 /end DEFAULT_EVENT_LIST /end DAQ_EVENT
 /end IF_DATA
/end MEASUREMENT
/begin MEASUREMENT gPtpC.t1_norm "t1 normalized to startup reference time t1_offset" A_INT64 NO_COMPU_METHOD 0 0 0 1e+06 ECU_ADDRESS 0x40398 ECU_ADDRESS_EXTENSION 1 PHYS_UNIT "ns" READ_WRITE
 /begin IF_DATA XCP
  /begin DAQ_EVENT VARIABLE /begin DEFAULT_EVENT_LIST EVENT 0x0 /end DEFAULT_EVENT_LIST /end DAQ_EVENT
 /end IF_DATA
/end MEASUREMENT
/begin MEASUREMENT gPtpC.t2_norm "t2 normalized to startup reference time t2_offset" A_INT64 NO_COMPU_METHOD 0 0 0 1e+06 ECU_ADDRESS 0x403A0 ECU_ADDRESS_EXTENSION 1 PHYS_UNIT "ns" READ_WRITE
 /begin IF_DATA XCP
  /begin DAQ_EVENT VARIABLE /begin DEFAULT_EVENT_LIST EVENT 0x0 /end DEFAULT_EVENT_LIST /end DAQ_EVENT
 /end IF_DATA
/end MEASUREMENT
/begin MEASUREMENT gPtpC.master_drift_raw "" FLOAT64_IEEE NO_COMPU_METHOD 0 0 -100 100 ECU_ADDRESS 0x403B0 ECU_ADDRESS_EXTENSION 1 PHYS_UNIT "ppm*1000" READ_WRITE
 /begin IF_DATA XCP
  /begin DAQ_EVENT VARIABLE /begin DEFAULT_EVENT_LIST EVENT 0x0 /end DEFAULT_EVENT_LIST /end DAQ_EVENT
 /end IF_DATA
/end MEASUREMENT
/begin MEASUREMENT gPtpC.master_drift "" FLOAT64_IEEE NO_COMPU_METHOD 0 0 -100 100 ECU_ADDRESS 0x403B8 ECU_ADDRESS_EXTENSION 1 PHYS_UNIT "ppm*1000" READ_WRITE
 /begin IF_DATA XCP
  /begin DAQ_EVENT VARIABLE /begin DEFAULT_EVENT_LIST EVENT 0x0 /end DEFAULT_EVENT_LIST /end DAQ_EVENT
 /end IF_DATA
/end MEASUREMENT
/begin MEASUREMENT gPtpC.master_drift_drift "" FLOAT64_IEEE NO_COMPU_METHOD 0 0 -10 10 ECU_ADDRESS 0x403C0 ECU_ADDRESS_EXTENSION 1 PHYS_UNIT "ppm*1000" READ_WRITE
 /begin IF_DATA XCP
  /begin DAQ_EVENT VARIABLE /begin DEFAULT_EVENT_LIST EVENT 0x0 /end DEFAULT_EVENT_LIST /end DAQ_EVENT
 /end IF_DATA
/end MEASUREMENT
/begin MEASUREMENT gPtpC.master_offset_raw "t1-t2 raw value (not used)" A_INT64 NO_COMPU_METHOD 0 0 -1e+06 1e+06 ECU_ADDRESS 0x40380 ECU_ADDRESS_EXTENSION 1 PHYS_UNIT "ns" READ_WRITE
 /begin IF_DATA XCP
  /begin DAQ_EVENT VARIABLE /begin DEFAULT_EVENT_LIST EVENT 0x0 /end DEFAULT_EVENT_LIST /end DAQ_EVENT
 /end IF_DATA
/end MEASUREMENT
/begin MEASUREMENT gPtpC.master_offset_compensation "offset for detrending" FLOAT64_IEEE NO_COMPU_METHOD 0 0 -1000 1000 ECU_ADDRESS 0x403C8 ECU_ADDRESS_EXTENSION 1 PHYS_UNIT "ns" READ_WRITE
 /begin IF_DATA XCP
  /begin DAQ_EVENT VARIABLE /begin DEFAULT_EVENT_LIST EVENT 0x0 /end DEFAULT_EVENT_LIST /end DAQ_EVENT
 /end IF_DATA
/end MEASUREMENT
/begin MEASUREMENT gPtpC.master_offset_detrended "detrended master offset" FLOAT64_IEEE NO_COMPU_METHOD 0 0 -1000 1000 ECU_ADDRESS 0x403D0 ECU_ADDRESS_EXTENSION 1 PHYS_UNIT "ns" READ_WRITE
 /begin IF_DATA XCP
  /begin DAQ_EVENT VARIABLE /begin DEFAULT_EVENT_LIST EVENT 0x0 /end DEFAULT_EVENT_LIST /end DAQ_EVENT
 /end IF_DATA
/end MEASUREMENT
/begin MEASUREMENT gPtpC.master_offset_detrended_filtered "filtered detrended master offset" FLOAT64_IEEE NO_COMPU_METHOD 0 0 -1000 1000 ECU_ADDRESS 0x403D8 ECU_ADDRESS_EXTENSION 1 PHYS_UNIT "ns" READ_WRITE
 /begin IF_DATA XCP
  /begin DAQ_EVENT VARIABLE /begin DEFAULT_EVENT_LIST EVENT 0x0 /end DEFAULT_EVENT_LIST /end DAQ_EVENT
 /end IF_DATA
/end MEASUREMENT
/begin MEASUREMENT gPtpC.master_jitter "offset jitter raw value" FLOAT64_IEEE NO_COMPU_METHOD 0 0 -1000 1000 ECU_ADDRESS 0x403E0 ECU_ADDRESS_EXTENSION 1 PHYS_UNIT "ns" READ_WRITE
 /begin IF_DATA XCP
  /begin DAQ_EVENT VARIABLE /begin DEFAULT_EVENT_LIST EVENT 0x0 /end DEFAULT_EVENT_LIST /end DAQ_EVENT
 /end IF_DATA
/end MEASUREMENT
/begin MEASUREMENT gPtpC.master_jitter_rms "Jitter root mean square" FLOAT64_IEEE NO_COMPU_METHOD 0 0 -1000 1000 ECU_ADDRESS 0x403E8 ECU_ADDRESS_EXTENSION 1 PHYS_UNIT "ns" READ_WRITE
 /begin IF_DATA XCP
  /begin DAQ_EVENT VARIABLE /begin DEFAULT_EVENT_LIST EVENT 0x0 /end DEFAULT_EVENT_LIST /end DAQ_EVENT
 /end IF_DATA
/end MEASUREMENT
/begin MEASUREMENT gPtpC.master_jitter_avg "Jitter average" FLOAT64_IEEE NO_COMPU_METHOD 0 0 -1000 1000 ECU_ADDRESS 0x403F0 ECU_ADDRESS_EXTENSION 1 PHYS_UNIT "ns" READ_WRITE
 /begin IF_DATA XCP
  /begin DAQ_EVENT VARIABLE /begin DEFAULT_EVENT_LIST EVENT 0x0 /end DEFAULT_EVENT_LIST /end DAQ_EVENT
 /end IF_DATA
/end MEASUREMENT
/begin MEASUREMENT gPtpC.servo_integral "Servo integral accumulator" FLOAT64_IEEE NO_COMPU_METHOD 0 0 -10000 10000 ECU_ADDRESS 0x403F8 ECU_ADDRESS_EXTENSION 1 PHYS_UNIT "ns" READ_WRITE
 /begin IF_DATA XCP
  /begin DAQ_EVENT VARIABLE /begin DEFAULT_EVENT_LIST EVENT 0x0 /end DEFAULT_EVENT_LIST /end DAQ_EVENT
 /end IF_DATA
/end MEASUREMENT
/* Typedefs */
/begin RECORD_LAYOUT U8 FNC_VALUES 1 UBYTE ROW_DIR DIRECT /end RECORD_LAYOUT
/begin RECORD_LAYOUT A_U8 AXIS_PTS_X 1 UBYTE INDEX_INCR DIRECT /end RECORD_LAYOUT
/begin TYPEDEF_MEASUREMENT M_U8 "" UBYTE NO_COMPU_METHOD 0 0 0 255 /end TYPEDEF_MEASUREMENT
/begin TYPEDEF_CHARACTERISTIC C_U8 "" VALUE U8 0 NO_COMPU_METHOD 0 255 /end TYPEDEF_CHARACTERISTIC
/begin RECORD_LAYOUT U16 FNC_VALUES 1 UWORD ROW_DIR DIRECT /end RECORD_LAYOUT
/begin RECORD_LAYOUT A_U16 AXIS_PTS_X 1 UWORD INDEX_INCR DIRECT /end RECORD_LAYOUT
/begin TYPEDEF_MEASUREMENT M_U16 "" UWORD NO_COMPU_METHOD 0 0 0 65535 /end TYPEDEF_MEASUREMENT
/begin TYPEDEF_CHARACTERISTIC C_U16 "" VALUE U16 0 NO_COMPU_METHOD 0 65535 /end TYPEDEF_CHARACTERISTIC
/begin RECORD_LAYOUT U32 FNC_VALUES 1 ULONG ROW_DIR DIRECT /end RECORD_LAYOUT
/begin RECORD_LAYOUT A_U32 AXIS_PTS_X 1 ULONG INDEX_INCR DIRECT /end RECORD_LAYOUT
/begin TYPEDEF_MEASUREMENT M_U32 "" ULONG NO_COMPU_METHOD 0 0 0 4294967295 /end TYPEDEF_MEASUREMENT
/begin TYPEDEF_CHARACTERISTIC C_U32 "" VALUE U32 0 NO_COMPU_METHOD 0 4.29497e+09 /end TYPEDEF_CHARACTERISTIC
/begin RECORD_LAYOUT U64 FNC_VALUES 1 A_UINT64 ROW_DIR DIRECT /end RECORD_LAYOUT
/begin RECORD_LAYOUT A_U64 AXIS_PTS_X 1 A_UINT64 INDEX_INCR DIRECT /end RECORD_LAYOUT
/begin TYPEDEF_MEASUREMENT M_U64 "" A_UINT64 NO_COMPU_METHOD 0 0 0 1000000000000 /end TYPEDEF_MEASUREMENT
/begin TYPEDEF_CHARACTERISTIC C_U64 "" VALUE U64 0 NO_COMPU_METHOD 0 1e+12 /end TYPEDEF_CHARACTERISTIC
/begin RECORD_LAYOUT I8 FNC_VALUES 1 SBYTE ROW_DIR DIRECT /end RECORD_LAYOUT
/begin RECORD_LAYOUT A_I8 AXIS_PTS_X 1 SBYTE INDEX_INCR DIRECT /end RECORD_LAYOUT
/begin TYPEDEF_MEASUREMENT M_I8 "" SBYTE NO_COMPU_METHOD 0 0 -128 127 /end TYPEDEF_MEASUREMENT
/begin TYPEDEF_CHARACTERISTIC C_I8 "" VALUE I8 0 NO_COMPU_METHOD -128 127 /end TYPEDEF_CHARACTERISTIC
/begin RECORD_LAYOUT I16 FNC_VALUES 1 SWORD ROW_DIR DIRECT /end RECORD_LAYOUT
/begin RECORD_LAYOUT A_I16 AXIS_PTS_X 1 SWORD INDEX_INCR DIRECT /end RECORD_LAYOUT
/begin TYPEDEF_MEASUREMENT M_I16 "" SWORD NO_COMPU_METHOD 0 0 -32768 32767 /end TYPEDEF_MEASUREMENT
/begin TYPEDEF_CHARACTERISTIC C_I16 "" VALUE I16 0 NO_COMPU_METHOD -32768 32767 /end TYPEDEF_CHARACTERISTIC
/begin RECORD_LAYOUT I32 FNC_VALUES 1 SLONG ROW_DIR DIRECT /end RECORD_LAYOUT
/begin RECORD_LAYOUT A_I32 AXIS_PTS_X 1 SLONG INDEX_INCR DIRECT /end RECORD_LAYOUT
/begin TYPEDEF_MEASUREMENT M_I32 "" SLONG NO_COMPU_METHOD 0 0 -2147483648 2147483647 /end TYPEDEF_MEASUREMENT
/begin TYPEDEF_CHARACTERISTIC C_I32 "" VALUE I32 0 NO_COMPU_METHOD -2.14748e+09 2.14748e+09 /end TYPEDEF_CHARACTERISTIC
/begin RECORD_LAYOUT I64 FNC_VALUES 1 A_INT64 ROW_DIR DIRECT /end RECORD_LAYOUT
/begin RECORD_LAYOUT A_I64 AXIS_PTS_X 1 A_INT64 INDEX_INCR DIRECT /end RECORD_LAYOUT
/begin TYPEDEF_MEASUREMENT M_I64 "" A_INT64 NO_COMPU_METHOD 0 0 -1000000000000 1000000000000 /end TYPEDEF_MEASUREMENT
/begin TYPEDEF_CHARACTERISTIC C_I64 "" VALUE I64 0 NO_COMPU_METHOD -1e+12 1e+12 /end TYPEDEF_CHARACTERISTIC
/begin RECORD_LAYOUT F32 FNC_VALUES 1 FLOAT32_IEEE ROW_DIR DIRECT /end RECORD_LAYOUT
/begin RECORD_LAYOUT A_F32 AXIS_PTS_X 1 FLOAT32_IEEE INDEX_INCR DIRECT /end RECORD_LAYOUT
/begin TYPEDEF_MEASUREMENT M_F32 "" FLOAT32_IEEE NO_COMPU_METHOD 0 0 -1e+12 1e+12 /end TYPEDEF_MEASUREMENT
/begin TYPEDEF_CHARACTERISTIC C_F32 "" VALUE F32 0 NO_COMPU_METHOD -1e+12 1e+12 /end TYPEDEF_CHARACTERISTIC
/begin RECORD_LAYOUT F64 FNC_VALUES 1 FLOAT64_IEEE ROW_DIR DIRECT /end RECORD_LAYOUT
/begin RECORD_LAYOUT A_F64 AXIS_PTS_X 1 FLOAT64_IEEE INDEX_INCR DIRECT /end RECORD_LAYOUT
/begin TYPEDEF_MEASUREMENT M_F64 "" FLOAT64_IEEE NO_COMPU_METHOD 0 0 -1e+12 1e+12 /end TYPEDEF_MEASUREMENT
/begin TYPEDEF_CHARACTERISTIC C_F64 "" VALUE F64 0 NO_COMPU_METHOD -1e+12 1e+12 /end TYPEDEF_CHARACTERISTIC
/* Groups */
/begin GROUP params "Calibration Segment" ROOT
 /begin REF_CHARACTERISTIC params.reset params.t1_correction params.drift_correction params.drift_filter_size params.jitter_rms_filter_size params.jitter_avg_filter_size params.max_correction params.servo_i_gain params.servo_p_gain /end REF_CHARACTERISTIC
/end GROUP
/begin GROUP PTP_SYNC "Measurement event group"
 /begin REF_MEASUREMENT gPtpC.gm.domain gPtpC.gm.uuid gPtpC.gm.addr gPtpC.sync_local_time gPtpC.sync_master_time gPtpC.sync_correction gPtpC.sync_sequenceId gPtpC.sync_steps gPtpC.sync_cycle_time gPtpC.flup_master_time gPtpC.flup_sequenceId gPtpC.flup_correction gPtpC.t1_norm gPtpC.t2_norm gPtpC.master_drift_raw gPtpC.master_drift gPtpC.master_drift_drift gPtpC.master_offset_raw gPtpC.master_offset_compensation gPtpC.master_offset_detrended gPtpC.master_offset_detrended_filtered gPtpC.master_jitter gPtpC.master_jitter_rms gPtpC.master_jitter_avg gPtpC.servo_integral /end REF_MEASUREMENT
/end GROUP
/begin GROUP Events "Events" ROOT /begin SUB_GROUP PTP_SYNC /end SUB_GROUP /end GROUP
/* Conversions */
/begin COMPU_METHOD conv.bool "" TAB_VERB "%.0" "" COMPU_TAB_REF conv.bool.table /end COMPU_METHOD
/begin COMPU_VTAB conv.bool.table "" TAB_VERB 2 0 "false" 1 "true" /end COMPU_VTAB
/begin COMPU_METHOD conv.events "" TAB_VERB "%.0 " "" COMPU_TAB_REF conv.events.table /end COMPU_METHOD
/begin COMPU_VTAB conv.events.table "" TAB_VERB 1 0 "PTP_SYNC" /end COMPU_VTAB
/begin MOD_PAR "" EPK "V1.1_17_26_18" ADDR_EPK 0x80000000
 /begin MEMORY_SEGMENT epk "" DATA FLASH INTERN 0x80000000 13 -1 -1 -1 -1 -1
  /begin IF_DATA XCP
   /begin SEGMENT 0 2 0 0 0 /begin CHECKSUM XCP_CRC_16_CITT MAX_BLOCK_SIZE 0xFFFF EXTERNAL_FUNCTION "" /end CHECKSUM
    /begin PAGE 0 ECU_ACCESS_DONT_CARE XCP_READ_ACCESS_DONT_CARE XCP_WRITE_ACCESS_DONT_CARE /end PAGE
    /begin PAGE 1 ECU_ACCESS_DONT_CARE XCP_READ_ACCESS_DONT_CARE XCP_WRITE_ACCESS_NOT_ALLOWED /end PAGE
   /end SEGMENT
  /end IF_DATA
 /end MEMORY_SEGMENT
 /begin MEMORY_SEGMENT params "" DATA FLASH INTERN 0x80010000 40 -1 -1 -1 -1 -1
  /begin IF_DATA XCP
   /begin SEGMENT 1 2 0 0 0 /begin CHECKSUM XCP_CRC_16_CITT MAX_BLOCK_SIZE 0xFFFF EXTERNAL_FUNCTION "" /end CHECKSUM
    /begin PAGE 0 ECU_ACCESS_DONT_CARE XCP_READ_ACCESS_DONT_CARE XCP_WRITE_ACCESS_DONT_CARE /end PAGE
    /begin PAGE 1 ECU_ACCESS_DONT_CARE XCP_READ_ACCESS_DONT_CARE XCP_WRITE_ACCESS_NOT_ALLOWED /end PAGE
   /end SEGMENT
  /end IF_DATA
 /end MEMORY_SEGMENT
/end MOD_PAR
/begin IF_DATA XCP
 /begin PROTOCOL_LAYER 0x104 1000 2000 0 0 0 0 0 248 1024 BYTE_ORDER_MSB_LAST ADDRESS_GRANULARITY_BYTE OPTIONAL_CMD GET_COMM_MODE_INFO OPTIONAL_CMD GET_ID OPTIONAL_CMD SET_REQUEST OPTIONAL_CMD SET_MTA OPTIONAL_CMD UPLOAD OPTIONAL_CMD SHORT_UPLOAD OPTIONAL_CMD DOWNLOAD OPTIONAL_CMD SHORT_DOWNLOAD OPTIONAL_CMD GET_CAL_PAGE OPTIONAL_CMD SET_CAL_PAGE OPTIONAL_CMD COPY_CAL_PAGE OPTIONAL_CMD GET_PAG_PROCESSOR_INFO OPTIONAL_CMD GET_SEGMENT_INFO OPTIONAL_CMD GET_PAGE_INFO OPTIONAL_CMD GET_SEGMENT_MODE OPTIONAL_CMD SET_SEGMENT_MODE OPTIONAL_CMD BUILD_CHECKSUM OPTIONAL_CMD USER_CMD OPTIONAL_CMD GET_DAQ_RESOLUTION_INFO OPTIONAL_CMD GET_DAQ_PROCESSOR_INFO OPTIONAL_CMD GET_DAQ_EVENT_INFO OPTIONAL_CMD FREE_DAQ OPTIONAL_CMD ALLOC_DAQ OPTIONAL_CMD ALLOC_ODT OPTIONAL_CMD ALLOC_ODT_ENTRY OPTIONAL_CMD SET_DAQ_PTR OPTIONAL_CMD WRITE_DAQ OPTIONAL_CMD GET_DAQ_LIST_MODE OPTIONAL_CMD SET_DAQ_LIST_MODE OPTIONAL_CMD START_STOP_SYNCH OPTIONAL_CMD START_STOP_DAQ_LIST OPTIONAL_CMD GET_DAQ_CLOCK OPTIONAL_CMD WRITE_DAQ_MULTIPLE OPTIONAL_CMD TIME_CORRELATION_PROPERTIES OPTIONAL_LEVEL1_CMD GET_VERSION /end PROTOCOL_LAYER
 /begin DAQ DYNAMIC 0 1 0 OPTIMISATION_TYPE_DEFAULT ADDRESS_EXTENSION_FREE IDENTIFICATION_FIELD_TYPE_RELATIVE_BYTE GRANULARITY_ODT_ENTRY_SIZE_DAQ_BYTE 0xF8 OVERLOAD_INDICATION_PID /begin TIMESTAMP_SUPPORTED 0x1 SIZE_DWORD UNIT_1NS TIMESTAMP_FIXED /end TIMESTAMP_SUPPORTED /begin EVENT "PTP_SYNC" "PTP_SYNC" 0x0 DAQ 0xFF 0 0 0 CONSISTENCY EVENT /end EVENT /end DAQ
/end IF_DATA
/end MODULE
/end PROJECT
