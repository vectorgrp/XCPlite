ASAP2_VERSION 1 71
/begin PROJECT ptp_demo ""
/begin HEADER "" VERSION "1.0" PROJECT_NO XCPLITE__CASDD /end HEADER
/begin MODULE ptp_demo ""
/include "XCP_104.aml"
/begin MOD_COMMON "" BYTE_ORDER MSB_LAST ALIGNMENT_BYTE 1 ALIGNMENT_WORD 1 ALIGNMENT_LONG 1 ALIGNMENT_FLOAT16_IEEE 1 ALIGNMENT_FLOAT32_IEEE 1 ALIGNMENT_FLOAT64_IEEE 1 ALIGNMENT_INT64 1 /end MOD_COMMON
/begin CHARACTERISTIC observer_params.reset "Reset PTP observer state" VALUE 0x80010000 U8 0 NO_COMPU_METHOD 0 1 /end CHARACTERISTIC
/begin CHARACTERISTIC observer_params.t1_correction "Correction for t1" VALUE 0x80010004 I32 0 NO_COMPU_METHOD -100 100 /end CHARACTERISTIC
/begin CHARACTERISTIC observer_params.drift_filter_size "Drift filter size" VALUE 0x80010008 U8 0 NO_COMPU_METHOD 1 300 /end CHARACTERISTIC
/begin CHARACTERISTIC observer_params.linreg_filter_size "Linear regression filter size" VALUE 0x80010009 U8 0 NO_COMPU_METHOD 1 300 /end CHARACTERISTIC
/begin CHARACTERISTIC observer_params.linreg_offset_filter_size "Linear regression offset filter size" VALUE 0x8001000A U8 0 NO_COMPU_METHOD 1 300 /end CHARACTERISTIC
/begin CHARACTERISTIC observer_params.linreg_jitter_filter_size "Linear regression jitter filter size" VALUE 0x8001000B U8 0 NO_COMPU_METHOD 1 300 /end CHARACTERISTIC
/begin CHARACTERISTIC observer_params.jitter_rms_filter_size "Jitter RMS filter size" VALUE 0x8001000C U8 0 NO_COMPU_METHOD 1 300 /end CHARACTERISTIC
/begin CHARACTERISTIC observer_params.jitter_avg_filter_size "Jitter average filter size" VALUE 0x8001000D U8 0 NO_COMPU_METHOD 1 300 /end CHARACTERISTIC
/begin MEASUREMENT obs_0.207_0.o.gm.domain "domain" UBYTE NO_COMPU_METHOD 0 0 0 255 ECU_ADDRESS 0x38 ECU_ADDRESS_EXTENSION 2 READ_WRITE
 /begin IF_DATA XCP
  /begin DAQ_EVENT FIXED_EVENT_LIST EVENT 0x0 /end DAQ_EVENT
 /end IF_DATA
/end MEASUREMENT
/begin CHARACTERISTIC obs_0.207_0.o.gm.uuid "Grandmaster UUID" VAL_BLK 0x39 U8 0 NO_COMPU_METHOD 0 255 MATRIX_DIM 8 1 ECU_ADDRESS_EXTENSION 2
 /begin IF_DATA XCP
  /begin DAQ_EVENT FIXED_EVENT_LIST EVENT 0x0 /end DAQ_EVENT
 /end IF_DATA
/end CHARACTERISTIC
/begin CHARACTERISTIC obs_0.207_0.o.gm.addr "Grandmaster IP address" VAL_BLK 0x41 U8 0 NO_COMPU_METHOD 0 255 MATRIX_DIM 4 1 ECU_ADDRESS_EXTENSION 2
 /begin IF_DATA XCP
  /begin DAQ_EVENT FIXED_EVENT_LIST EVENT 0x0 /end DAQ_EVENT
 /end IF_DATA
/end CHARACTERISTIC
/begin MEASUREMENT obs_0.207_0.o.sync_local_time "SYNC RX timestamp" A_UINT64 NO_COMPU_METHOD 0 0 0 1e+12 ECU_ADDRESS 0x70 ECU_ADDRESS_EXTENSION 2 READ_WRITE
 /begin IF_DATA XCP
  /begin DAQ_EVENT FIXED_EVENT_LIST EVENT 0x0 /end DAQ_EVENT
 /end IF_DATA
/end MEASUREMENT
/begin MEASUREMENT obs_0.207_0.o.sync_master_time "SYNC timestamp" A_UINT64 NO_COMPU_METHOD 0 0 0 1e+12 ECU_ADDRESS 0x78 ECU_ADDRESS_EXTENSION 2 READ_WRITE
 /begin IF_DATA XCP
  /begin DAQ_EVENT FIXED_EVENT_LIST EVENT 0x0 /end DAQ_EVENT
 /end IF_DATA
/end MEASUREMENT
/begin MEASUREMENT obs_0.207_0.o.sync_correction "SYNC correction" ULONG NO_COMPU_METHOD 0 0 0 1e+06 ECU_ADDRESS 0x80 ECU_ADDRESS_EXTENSION 2 PHYS_UNIT "ns" READ_WRITE
 /begin IF_DATA XCP
  /begin DAQ_EVENT FIXED_EVENT_LIST EVENT 0x0 /end DAQ_EVENT
 /end IF_DATA
/end MEASUREMENT
/begin MEASUREMENT obs_0.207_0.o.sync_sequenceId "SYNC sequence counter" UWORD NO_COMPU_METHOD 0 0 0 65535 ECU_ADDRESS 0x84 ECU_ADDRESS_EXTENSION 2 READ_WRITE
 /begin IF_DATA XCP
  /begin DAQ_EVENT FIXED_EVENT_LIST EVENT 0x0 /end DAQ_EVENT
 /end IF_DATA
/end MEASUREMENT
/begin MEASUREMENT obs_0.207_0.o.sync_steps "SYNC mode" UBYTE NO_COMPU_METHOD 0 0 0 255 ECU_ADDRESS 0x90 ECU_ADDRESS_EXTENSION 2 READ_WRITE
 /begin IF_DATA XCP
  /begin DAQ_EVENT FIXED_EVENT_LIST EVENT 0x0 /end DAQ_EVENT
 /end IF_DATA
/end MEASUREMENT
/begin MEASUREMENT obs_0.207_0.o.sync_cycle_time "SYNC cycle time" A_UINT64 NO_COMPU_METHOD 0 0 1e+09 1e+09 ECU_ADDRESS 0x88 ECU_ADDRESS_EXTENSION 2 PHYS_UNIT "ns" READ_WRITE
 /begin IF_DATA XCP
  /begin DAQ_EVENT FIXED_EVENT_LIST EVENT 0x0 /end DAQ_EVENT
 /end IF_DATA
/end MEASUREMENT
/begin MEASUREMENT obs_0.207_0.o.flup_master_time "FOLLOW_UP timestamp" A_UINT64 NO_COMPU_METHOD 0 0 0 1e+12 ECU_ADDRESS 0x98 ECU_ADDRESS_EXTENSION 2 READ_WRITE
 /begin IF_DATA XCP
  /begin DAQ_EVENT FIXED_EVENT_LIST EVENT 0x0 /end DAQ_EVENT
 /end IF_DATA
/end MEASUREMENT
/begin MEASUREMENT obs_0.207_0.o.flup_sequenceId "FOLLOW_UP sequence counter" UWORD NO_COMPU_METHOD 0 0 0 65535 ECU_ADDRESS 0xA4 ECU_ADDRESS_EXTENSION 2 READ_WRITE
 /begin IF_DATA XCP
  /begin DAQ_EVENT FIXED_EVENT_LIST EVENT 0x0 /end DAQ_EVENT
 /end IF_DATA
/end MEASUREMENT
/begin MEASUREMENT obs_0.207_0.o.flup_correction "FOLLOW_UP correction" ULONG NO_COMPU_METHOD 0 0 0 1e+06 ECU_ADDRESS 0xA0 ECU_ADDRESS_EXTENSION 2 PHYS_UNIT "ns" READ_WRITE
 /begin IF_DATA XCP
  /begin DAQ_EVENT FIXED_EVENT_LIST EVENT 0x0 /end DAQ_EVENT
 /end IF_DATA
/end MEASUREMENT
/begin MEASUREMENT obs_0.207_0.o.t1_norm "t1 normalized to startup reference time t1_offset" A_INT64 NO_COMPU_METHOD 0 0 0 1e+06 ECU_ADDRESS 0xD8 ECU_ADDRESS_EXTENSION 2 PHYS_UNIT "ns" READ_WRITE
 /begin IF_DATA XCP
  /begin DAQ_EVENT FIXED_EVENT_LIST EVENT 0x0 /end DAQ_EVENT
 /end IF_DATA
/end MEASUREMENT
/begin MEASUREMENT obs_0.207_0.o.t2_norm "t2 normalized to startup reference time t2_offset" A_INT64 NO_COMPU_METHOD 0 0 0 1e+06 ECU_ADDRESS 0xE0 ECU_ADDRESS_EXTENSION 2 PHYS_UNIT "ns" READ_WRITE
 /begin IF_DATA XCP
  /begin DAQ_EVENT FIXED_EVENT_LIST EVENT 0x0 /end DAQ_EVENT
 /end IF_DATA
/end MEASUREMENT
/begin MEASUREMENT obs_0.207_0.o.master_drift "" FLOAT64_IEEE NO_COMPU_METHOD 0 0 -100 100 ECU_ADDRESS 0x1840 ECU_ADDRESS_EXTENSION 2 PHYS_UNIT "ppm*1000" READ_WRITE
 /begin IF_DATA XCP
  /begin DAQ_EVENT FIXED_EVENT_LIST EVENT 0x0 /end DAQ_EVENT
 /end IF_DATA
/end MEASUREMENT
/begin MEASUREMENT obs_0.207_0.o.master_jitter "offset jitter raw value" FLOAT64_IEEE NO_COMPU_METHOD 0 0 -1000 1000 ECU_ADDRESS 0x1850 ECU_ADDRESS_EXTENSION 2 PHYS_UNIT "ns" READ_WRITE
 /begin IF_DATA XCP
  /begin DAQ_EVENT FIXED_EVENT_LIST EVENT 0x0 /end DAQ_EVENT
 /end IF_DATA
/end MEASUREMENT
/begin MEASUREMENT obs_0.207_0.o.master_jitter_rms "Jitter root mean square" FLOAT64_IEEE NO_COMPU_METHOD 0 0 -1000 1000 ECU_ADDRESS 0x1858 ECU_ADDRESS_EXTENSION 2 PHYS_UNIT "ns" READ_WRITE
 /begin IF_DATA XCP
  /begin DAQ_EVENT FIXED_EVENT_LIST EVENT 0x0 /end DAQ_EVENT
 /end IF_DATA
/end MEASUREMENT
/begin MEASUREMENT obs_0.207_0.o.master_jitter_avg "Jitter average" FLOAT64_IEEE NO_COMPU_METHOD 0 0 -1000 1000 ECU_ADDRESS 0x1860 ECU_ADDRESS_EXTENSION 2 PHYS_UNIT "ns" READ_WRITE
 /begin IF_DATA XCP
  /begin DAQ_EVENT FIXED_EVENT_LIST EVENT 0x0 /end DAQ_EVENT
 /end IF_DATA
/end MEASUREMENT
/begin CHARACTERISTIC obs_0.207_0.o.offset_to "Offset to other observers" VAL_BLK 0x2028 I64 0 NO_COMPU_METHOD -1e+12 1e+12 MATRIX_DIM 16 1 ECU_ADDRESS_EXTENSION 2
 /begin IF_DATA XCP
  /begin DAQ_EVENT FIXED_EVENT_LIST EVENT 0x0 /end DAQ_EVENT
 /end IF_DATA
/end CHARACTERISTIC
/begin CHARACTERISTIC obs_0.207_0.o.drift_to "Offset to other observers" VAL_BLK 0x20A8 F64 0 NO_COMPU_METHOD -1e+12 1e+12 MATRIX_DIM 16 1 ECU_ADDRESS_EXTENSION 2
 /begin IF_DATA XCP
  /begin DAQ_EVENT FIXED_EVENT_LIST EVENT 0x0 /end DAQ_EVENT
 /end IF_DATA
/end CHARACTERISTIC
/begin MEASUREMENT obs_3.10_1.o.gm.domain "domain" UBYTE NO_COMPU_METHOD 0 0 0 255 ECU_ADDRESS 0x10038 ECU_ADDRESS_EXTENSION 2 READ_WRITE
 /begin IF_DATA XCP
  /begin DAQ_EVENT FIXED_EVENT_LIST EVENT 0x1 /end DAQ_EVENT
 /end IF_DATA
/end MEASUREMENT
/begin CHARACTERISTIC obs_3.10_1.o.gm.uuid "Grandmaster UUID" VAL_BLK 0x10039 U8 0 NO_COMPU_METHOD 0 255 MATRIX_DIM 8 1 ECU_ADDRESS_EXTENSION 2
 /begin IF_DATA XCP
  /begin DAQ_EVENT FIXED_EVENT_LIST EVENT 0x1 /end DAQ_EVENT
 /end IF_DATA
/end CHARACTERISTIC
/begin CHARACTERISTIC obs_3.10_1.o.gm.addr "Grandmaster IP address" VAL_BLK 0x10041 U8 0 NO_COMPU_METHOD 0 255 MATRIX_DIM 4 1 ECU_ADDRESS_EXTENSION 2
 /begin IF_DATA XCP
  /begin DAQ_EVENT FIXED_EVENT_LIST EVENT 0x1 /end DAQ_EVENT
 /end IF_DATA
/end CHARACTERISTIC
/begin MEASUREMENT obs_3.10_1.o.sync_local_time "SYNC RX timestamp" A_UINT64 NO_COMPU_METHOD 0 0 0 1e+12 ECU_ADDRESS 0x10070 ECU_ADDRESS_EXTENSION 2 READ_WRITE
 /begin IF_DATA XCP
  /begin DAQ_EVENT FIXED_EVENT_LIST EVENT 0x1 /end DAQ_EVENT
 /end IF_DATA
/end MEASUREMENT
/begin MEASUREMENT obs_3.10_1.o.sync_master_time "SYNC timestamp" A_UINT64 NO_COMPU_METHOD 0 0 0 1e+12 ECU_ADDRESS 0x10078 ECU_ADDRESS_EXTENSION 2 READ_WRITE
 /begin IF_DATA XCP
  /begin DAQ_EVENT FIXED_EVENT_LIST EVENT 0x1 /end DAQ_EVENT
 /end IF_DATA
/end MEASUREMENT
/begin MEASUREMENT obs_3.10_1.o.sync_correction "SYNC correction" ULONG NO_COMPU_METHOD 0 0 0 1e+06 ECU_ADDRESS 0x10080 ECU_ADDRESS_EXTENSION 2 PHYS_UNIT "ns" READ_WRITE
 /begin IF_DATA XCP
  /begin DAQ_EVENT FIXED_EVENT_LIST EVENT 0x1 /end DAQ_EVENT
 /end IF_DATA
/end MEASUREMENT
/begin MEASUREMENT obs_3.10_1.o.sync_sequenceId "SYNC sequence counter" UWORD NO_COMPU_METHOD 0 0 0 65535 ECU_ADDRESS 0x10084 ECU_ADDRESS_EXTENSION 2 READ_WRITE
 /begin IF_DATA XCP
  /begin DAQ_EVENT FIXED_EVENT_LIST EVENT 0x1 /end DAQ_EVENT
 /end IF_DATA
/end MEASUREMENT
/begin MEASUREMENT obs_3.10_1.o.sync_steps "SYNC mode" UBYTE NO_COMPU_METHOD 0 0 0 255 ECU_ADDRESS 0x10090 ECU_ADDRESS_EXTENSION 2 READ_WRITE
 /begin IF_DATA XCP
  /begin DAQ_EVENT FIXED_EVENT_LIST EVENT 0x1 /end DAQ_EVENT
 /end IF_DATA
/end MEASUREMENT
/begin MEASUREMENT obs_3.10_1.o.sync_cycle_time "SYNC cycle time" A_UINT64 NO_COMPU_METHOD 0 0 1e+09 1e+09 ECU_ADDRESS 0x10088 ECU_ADDRESS_EXTENSION 2 PHYS_UNIT "ns" READ_WRITE
 /begin IF_DATA XCP
  /begin DAQ_EVENT FIXED_EVENT_LIST EVENT 0x1 /end DAQ_EVENT
 /end IF_DATA
/end MEASUREMENT
/begin MEASUREMENT obs_3.10_1.o.flup_master_time "FOLLOW_UP timestamp" A_UINT64 NO_COMPU_METHOD 0 0 0 1e+12 ECU_ADDRESS 0x10098 ECU_ADDRESS_EXTENSION 2 READ_WRITE
 /begin IF_DATA XCP
  /begin DAQ_EVENT FIXED_EVENT_LIST EVENT 0x1 /end DAQ_EVENT
 /end IF_DATA
/end MEASUREMENT
/begin MEASUREMENT obs_3.10_1.o.flup_sequenceId "FOLLOW_UP sequence counter" UWORD NO_COMPU_METHOD 0 0 0 65535 ECU_ADDRESS 0x100A4 ECU_ADDRESS_EXTENSION 2 READ_WRITE
 /begin IF_DATA XCP
  /begin DAQ_EVENT FIXED_EVENT_LIST EVENT 0x1 /end DAQ_EVENT
 /end IF_DATA
/end MEASUREMENT
/begin MEASUREMENT obs_3.10_1.o.flup_correction "FOLLOW_UP correction" ULONG NO_COMPU_METHOD 0 0 0 1e+06 ECU_ADDRESS 0x100A0 ECU_ADDRESS_EXTENSION 2 PHYS_UNIT "ns" READ_WRITE
 /begin IF_DATA XCP
  /begin DAQ_EVENT FIXED_EVENT_LIST EVENT 0x1 /end DAQ_EVENT
 /end IF_DATA
/end MEASUREMENT
/begin MEASUREMENT obs_3.10_1.o.t1_norm "t1 normalized to startup reference time t1_offset" A_INT64 NO_COMPU_METHOD 0 0 0 1e+06 ECU_ADDRESS 0x100D8 ECU_ADDRESS_EXTENSION 2 PHYS_UNIT "ns" READ_WRITE
 /begin IF_DATA XCP
  /begin DAQ_EVENT FIXED_EVENT_LIST EVENT 0x1 /end DAQ_EVENT
 /end IF_DATA
/end MEASUREMENT
/begin MEASUREMENT obs_3.10_1.o.t2_norm "t2 normalized to startup reference time t2_offset" A_INT64 NO_COMPU_METHOD 0 0 0 1e+06 ECU_ADDRESS 0x100E0 ECU_ADDRESS_EXTENSION 2 PHYS_UNIT "ns" READ_WRITE
 /begin IF_DATA XCP
  /begin DAQ_EVENT FIXED_EVENT_LIST EVENT 0x1 /end DAQ_EVENT
 /end IF_DATA
/end MEASUREMENT
/begin MEASUREMENT obs_3.10_1.o.master_drift "" FLOAT64_IEEE NO_COMPU_METHOD 0 0 -100 100 ECU_ADDRESS 0x11840 ECU_ADDRESS_EXTENSION 2 PHYS_UNIT "ppm*1000" READ_WRITE
 /begin IF_DATA XCP
  /begin DAQ_EVENT FIXED_EVENT_LIST EVENT 0x1 /end DAQ_EVENT
 /end IF_DATA
/end MEASUREMENT
/begin MEASUREMENT obs_3.10_1.o.master_jitter "offset jitter raw value" FLOAT64_IEEE NO_COMPU_METHOD 0 0 -1000 1000 ECU_ADDRESS 0x11850 ECU_ADDRESS_EXTENSION 2 PHYS_UNIT "ns" READ_WRITE
 /begin IF_DATA XCP
  /begin DAQ_EVENT FIXED_EVENT_LIST EVENT 0x1 /end DAQ_EVENT
 /end IF_DATA
/end MEASUREMENT
/begin MEASUREMENT obs_3.10_1.o.master_jitter_rms "Jitter root mean square" FLOAT64_IEEE NO_COMPU_METHOD 0 0 -1000 1000 ECU_ADDRESS 0x11858 ECU_ADDRESS_EXTENSION 2 PHYS_UNIT "ns" READ_WRITE
 /begin IF_DATA XCP
  /begin DAQ_EVENT FIXED_EVENT_LIST EVENT 0x1 /end DAQ_EVENT
 /end IF_DATA
/end MEASUREMENT
/begin MEASUREMENT obs_3.10_1.o.master_jitter_avg "Jitter average" FLOAT64_IEEE NO_COMPU_METHOD 0 0 -1000 1000 ECU_ADDRESS 0x11860 ECU_ADDRESS_EXTENSION 2 PHYS_UNIT "ns" READ_WRITE
 /begin IF_DATA XCP
  /begin DAQ_EVENT FIXED_EVENT_LIST EVENT 0x1 /end DAQ_EVENT
 /end IF_DATA
/end MEASUREMENT
/begin CHARACTERISTIC obs_3.10_1.o.offset_to "Offset to other observers" VAL_BLK 0x12028 I64 0 NO_COMPU_METHOD -1e+12 1e+12 MATRIX_DIM 16 1 ECU_ADDRESS_EXTENSION 2
 /begin IF_DATA XCP
  /begin DAQ_EVENT FIXED_EVENT_LIST EVENT 0x1 /end DAQ_EVENT
 /end IF_DATA
/end CHARACTERISTIC
/begin CHARACTERISTIC obs_3.10_1.o.drift_to "Offset to other observers" VAL_BLK 0x120A8 F64 0 NO_COMPU_METHOD -1e+12 1e+12 MATRIX_DIM 16 1 ECU_ADDRESS_EXTENSION 2
 /begin IF_DATA XCP
  /begin DAQ_EVENT FIXED_EVENT_LIST EVENT 0x1 /end DAQ_EVENT
 /end IF_DATA
/end CHARACTERISTIC
/begin MEASUREMENT obs_4.10_2.o.gm.domain "domain" UBYTE NO_COMPU_METHOD 0 0 0 255 ECU_ADDRESS 0x20038 ECU_ADDRESS_EXTENSION 2 READ_WRITE
 /begin IF_DATA XCP
  /begin DAQ_EVENT FIXED_EVENT_LIST EVENT 0x2 /end DAQ_EVENT
 /end IF_DATA
/end MEASUREMENT
/begin CHARACTERISTIC obs_4.10_2.o.gm.uuid "Grandmaster UUID" VAL_BLK 0x20039 U8 0 NO_COMPU_METHOD 0 255 MATRIX_DIM 8 1 ECU_ADDRESS_EXTENSION 2
 /begin IF_DATA XCP
  /begin DAQ_EVENT FIXED_EVENT_LIST EVENT 0x2 /end DAQ_EVENT
 /end IF_DATA
/end CHARACTERISTIC
/begin CHARACTERISTIC obs_4.10_2.o.gm.addr "Grandmaster IP address" VAL_BLK 0x20041 U8 0 NO_COMPU_METHOD 0 255 MATRIX_DIM 4 1 ECU_ADDRESS_EXTENSION 2
 /begin IF_DATA XCP
  /begin DAQ_EVENT FIXED_EVENT_LIST EVENT 0x2 /end DAQ_EVENT
 /end IF_DATA
/end CHARACTERISTIC
/begin MEASUREMENT obs_4.10_2.o.sync_local_time "SYNC RX timestamp" A_UINT64 NO_COMPU_METHOD 0 0 0 1e+12 ECU_ADDRESS 0x20070 ECU_ADDRESS_EXTENSION 2 READ_WRITE
 /begin IF_DATA XCP
  /begin DAQ_EVENT FIXED_EVENT_LIST EVENT 0x2 /end DAQ_EVENT
 /end IF_DATA
/end MEASUREMENT
/begin MEASUREMENT obs_4.10_2.o.sync_master_time "SYNC timestamp" A_UINT64 NO_COMPU_METHOD 0 0 0 1e+12 ECU_ADDRESS 0x20078 ECU_ADDRESS_EXTENSION 2 READ_WRITE
 /begin IF_DATA XCP
  /begin DAQ_EVENT FIXED_EVENT_LIST EVENT 0x2 /end DAQ_EVENT
 /end IF_DATA
/end MEASUREMENT
/begin MEASUREMENT obs_4.10_2.o.sync_correction "SYNC correction" ULONG NO_COMPU_METHOD 0 0 0 1e+06 ECU_ADDRESS 0x20080 ECU_ADDRESS_EXTENSION 2 PHYS_UNIT "ns" READ_WRITE
 /begin IF_DATA XCP
  /begin DAQ_EVENT FIXED_EVENT_LIST EVENT 0x2 /end DAQ_EVENT
 /end IF_DATA
/end MEASUREMENT
/begin MEASUREMENT obs_4.10_2.o.sync_sequenceId "SYNC sequence counter" UWORD NO_COMPU_METHOD 0 0 0 65535 ECU_ADDRESS 0x20084 ECU_ADDRESS_EXTENSION 2 READ_WRITE
 /begin IF_DATA XCP
  /begin DAQ_EVENT FIXED_EVENT_LIST EVENT 0x2 /end DAQ_EVENT
 /end IF_DATA
/end MEASUREMENT
/begin MEASUREMENT obs_4.10_2.o.sync_steps "SYNC mode" UBYTE NO_COMPU_METHOD 0 0 0 255 ECU_ADDRESS 0x20090 ECU_ADDRESS_EXTENSION 2 READ_WRITE
 /begin IF_DATA XCP
  /begin DAQ_EVENT FIXED_EVENT_LIST EVENT 0x2 /end DAQ_EVENT
 /end IF_DATA
/end MEASUREMENT
/begin MEASUREMENT obs_4.10_2.o.sync_cycle_time "SYNC cycle time" A_UINT64 NO_COMPU_METHOD 0 0 1e+09 1e+09 ECU_ADDRESS 0x20088 ECU_ADDRESS_EXTENSION 2 PHYS_UNIT "ns" READ_WRITE
 /begin IF_DATA XCP
  /begin DAQ_EVENT FIXED_EVENT_LIST EVENT 0x2 /end DAQ_EVENT
 /end IF_DATA
/end MEASUREMENT
/begin MEASUREMENT obs_4.10_2.o.flup_master_time "FOLLOW_UP timestamp" A_UINT64 NO_COMPU_METHOD 0 0 0 1e+12 ECU_ADDRESS 0x20098 ECU_ADDRESS_EXTENSION 2 READ_WRITE
 /begin IF_DATA XCP
  /begin DAQ_EVENT FIXED_EVENT_LIST EVENT 0x2 /end DAQ_EVENT
 /end IF_DATA
/end MEASUREMENT
/begin MEASUREMENT obs_4.10_2.o.flup_sequenceId "FOLLOW_UP sequence counter" UWORD NO_COMPU_METHOD 0 0 0 65535 ECU_ADDRESS 0x200A4 ECU_ADDRESS_EXTENSION 2 READ_WRITE
 /begin IF_DATA XCP
  /begin DAQ_EVENT FIXED_EVENT_LIST EVENT 0x2 /end DAQ_EVENT
 /end IF_DATA
/end MEASUREMENT
/begin MEASUREMENT obs_4.10_2.o.flup_correction "FOLLOW_UP correction" ULONG NO_COMPU_METHOD 0 0 0 1e+06 ECU_ADDRESS 0x200A0 ECU_ADDRESS_EXTENSION 2 PHYS_UNIT "ns" READ_WRITE
 /begin IF_DATA XCP
  /begin DAQ_EVENT FIXED_EVENT_LIST EVENT 0x2 /end DAQ_EVENT
 /end IF_DATA
/end MEASUREMENT
/begin MEASUREMENT obs_4.10_2.o.t1_norm "t1 normalized to startup reference time t1_offset" A_INT64 NO_COMPU_METHOD 0 0 0 1e+06 ECU_ADDRESS 0x200D8 ECU_ADDRESS_EXTENSION 2 PHYS_UNIT "ns" READ_WRITE
 /begin IF_DATA XCP
  /begin DAQ_EVENT FIXED_EVENT_LIST EVENT 0x2 /end DAQ_EVENT
 /end IF_DATA
/end MEASUREMENT
/begin MEASUREMENT obs_4.10_2.o.t2_norm "t2 normalized to startup reference time t2_offset" A_INT64 NO_COMPU_METHOD 0 0 0 1e+06 ECU_ADDRESS 0x200E0 ECU_ADDRESS_EXTENSION 2 PHYS_UNIT "ns" READ_WRITE
 /begin IF_DATA XCP
  /begin DAQ_EVENT FIXED_EVENT_LIST EVENT 0x2 /end DAQ_EVENT
 /end IF_DATA
/end MEASUREMENT
/begin MEASUREMENT obs_4.10_2.o.master_drift "" FLOAT64_IEEE NO_COMPU_METHOD 0 0 -100 100 ECU_ADDRESS 0x21840 ECU_ADDRESS_EXTENSION 2 PHYS_UNIT "ppm*1000" READ_WRITE
 /begin IF_DATA XCP
  /begin DAQ_EVENT FIXED_EVENT_LIST EVENT 0x2 /end DAQ_EVENT
 /end IF_DATA
/end MEASUREMENT
/begin MEASUREMENT obs_4.10_2.o.master_jitter "offset jitter raw value" FLOAT64_IEEE NO_COMPU_METHOD 0 0 -1000 1000 ECU_ADDRESS 0x21850 ECU_ADDRESS_EXTENSION 2 PHYS_UNIT "ns" READ_WRITE
 /begin IF_DATA XCP
  /begin DAQ_EVENT FIXED_EVENT_LIST EVENT 0x2 /end DAQ_EVENT
 /end IF_DATA
/end MEASUREMENT
/begin MEASUREMENT obs_4.10_2.o.master_jitter_rms "Jitter root mean square" FLOAT64_IEEE NO_COMPU_METHOD 0 0 -1000 1000 ECU_ADDRESS 0x21858 ECU_ADDRESS_EXTENSION 2 PHYS_UNIT "ns" READ_WRITE
 /begin IF_DATA XCP
  /begin DAQ_EVENT FIXED_EVENT_LIST EVENT 0x2 /end DAQ_EVENT
 /end IF_DATA
/end MEASUREMENT
/begin MEASUREMENT obs_4.10_2.o.master_jitter_avg "Jitter average" FLOAT64_IEEE NO_COMPU_METHOD 0 0 -1000 1000 ECU_ADDRESS 0x21860 ECU_ADDRESS_EXTENSION 2 PHYS_UNIT "ns" READ_WRITE
 /begin IF_DATA XCP
  /begin DAQ_EVENT FIXED_EVENT_LIST EVENT 0x2 /end DAQ_EVENT
 /end IF_DATA
/end MEASUREMENT
/begin CHARACTERISTIC obs_4.10_2.o.offset_to "Offset to other observers" VAL_BLK 0x22028 I64 0 NO_COMPU_METHOD -1e+12 1e+12 MATRIX_DIM 16 1 ECU_ADDRESS_EXTENSION 2
 /begin IF_DATA XCP
  /begin DAQ_EVENT FIXED_EVENT_LIST EVENT 0x2 /end DAQ_EVENT
 /end IF_DATA
/end CHARACTERISTIC
/begin CHARACTERISTIC obs_4.10_2.o.drift_to "Offset to other observers" VAL_BLK 0x220A8 F64 0 NO_COMPU_METHOD -1e+12 1e+12 MATRIX_DIM 16 1 ECU_ADDRESS_EXTENSION 2
 /begin IF_DATA XCP
  /begin DAQ_EVENT FIXED_EVENT_LIST EVENT 0x2 /end DAQ_EVENT
 /end IF_DATA
/end CHARACTERISTIC
/* Typedefs */
/begin RECORD_LAYOUT U8 FNC_VALUES 1 UBYTE ROW_DIR DIRECT /end RECORD_LAYOUT
/begin RECORD_LAYOUT A_U8 AXIS_PTS_X 1 UBYTE INDEX_INCR DIRECT /end RECORD_LAYOUT
/begin TYPEDEF_MEASUREMENT M_U8 "" UBYTE NO_COMPU_METHOD 0 0 0 255 /end TYPEDEF_MEASUREMENT
/begin TYPEDEF_CHARACTERISTIC C_U8 "" VALUE U8 0 NO_COMPU_METHOD 0 255 /end TYPEDEF_CHARACTERISTIC
/begin RECORD_LAYOUT U16 FNC_VALUES 1 UWORD ROW_DIR DIRECT /end RECORD_LAYOUT
/begin RECORD_LAYOUT A_U16 AXIS_PTS_X 1 UWORD INDEX_INCR DIRECT /end RECORD_LAYOUT
/begin TYPEDEF_MEASUREMENT M_U16 "" UWORD NO_COMPU_METHOD 0 0 0 65535 /end TYPEDEF_MEASUREMENT
/begin TYPEDEF_CHARACTERISTIC C_U16 "" VALUE U16 0 NO_COMPU_METHOD 0 65535 /end TYPEDEF_CHARACTERISTIC
/begin RECORD_LAYOUT U32 FNC_VALUES 1 ULONG ROW_DIR DIRECT /end RECORD_LAYOUT
/begin RECORD_LAYOUT A_U32 AXIS_PTS_X 1 ULONG INDEX_INCR DIRECT /end RECORD_LAYOUT
/begin TYPEDEF_MEASUREMENT M_U32 "" ULONG NO_COMPU_METHOD 0 0 0 4294967295 /end TYPEDEF_MEASUREMENT
/begin TYPEDEF_CHARACTERISTIC C_U32 "" VALUE U32 0 NO_COMPU_METHOD 0 4.29497e+09 /end TYPEDEF_CHARACTERISTIC
/begin RECORD_LAYOUT U64 FNC_VALUES 1 A_UINT64 ROW_DIR DIRECT /end RECORD_LAYOUT
/begin RECORD_LAYOUT A_U64 AXIS_PTS_X 1 A_UINT64 INDEX_INCR DIRECT /end RECORD_LAYOUT
/begin TYPEDEF_MEASUREMENT M_U64 "" A_UINT64 NO_COMPU_METHOD 0 0 0 1000000000000 /end TYPEDEF_MEASUREMENT
/begin TYPEDEF_CHARACTERISTIC C_U64 "" VALUE U64 0 NO_COMPU_METHOD 0 1e+12 /end TYPEDEF_CHARACTERISTIC
/begin RECORD_LAYOUT I8 FNC_VALUES 1 SBYTE ROW_DIR DIRECT /end RECORD_LAYOUT
/begin RECORD_LAYOUT A_I8 AXIS_PTS_X 1 SBYTE INDEX_INCR DIRECT /end RECORD_LAYOUT
/begin TYPEDEF_MEASUREMENT M_I8 "" SBYTE NO_COMPU_METHOD 0 0 -128 127 /end TYPEDEF_MEASUREMENT
/begin TYPEDEF_CHARACTERISTIC C_I8 "" VALUE I8 0 NO_COMPU_METHOD -128 127 /end TYPEDEF_CHARACTERISTIC
/begin RECORD_LAYOUT I16 FNC_VALUES 1 SWORD ROW_DIR DIRECT /end RECORD_LAYOUT
/begin RECORD_LAYOUT A_I16 AXIS_PTS_X 1 SWORD INDEX_INCR DIRECT /end RECORD_LAYOUT
/begin TYPEDEF_MEASUREMENT M_I16 "" SWORD NO_COMPU_METHOD 0 0 -32768 32767 /end TYPEDEF_MEASUREMENT
/begin TYPEDEF_CHARACTERISTIC C_I16 "" VALUE I16 0 NO_COMPU_METHOD -32768 32767 /end TYPEDEF_CHARACTERISTIC
/begin RECORD_LAYOUT I32 FNC_VALUES 1 SLONG ROW_DIR DIRECT /end RECORD_LAYOUT
/begin RECORD_LAYOUT A_I32 AXIS_PTS_X 1 SLONG INDEX_INCR DIRECT /end RECORD_LAYOUT
/begin TYPEDEF_MEASUREMENT M_I32 "" SLONG NO_COMPU_METHOD 0 0 -2147483648 2147483647 /end TYPEDEF_MEASUREMENT
/begin TYPEDEF_CHARACTERISTIC C_I32 "" VALUE I32 0 NO_COMPU_METHOD -2.14748e+09 2.14748e+09 /end TYPEDEF_CHARACTERISTIC
/begin RECORD_LAYOUT I64 FNC_VALUES 1 A_INT64 ROW_DIR DIRECT /end RECORD_LAYOUT
/begin RECORD_LAYOUT A_I64 AXIS_PTS_X 1 A_INT64 INDEX_INCR DIRECT /end RECORD_LAYOUT
/begin TYPEDEF_MEASUREMENT M_I64 "" A_INT64 NO_COMPU_METHOD 0 0 -1000000000000 1000000000000 /end TYPEDEF_MEASUREMENT
/begin TYPEDEF_CHARACTERISTIC C_I64 "" VALUE I64 0 NO_COMPU_METHOD -1e+12 1e+12 /end TYPEDEF_CHARACTERISTIC
/begin RECORD_LAYOUT F32 FNC_VALUES 1 FLOAT32_IEEE ROW_DIR DIRECT /end RECORD_LAYOUT
/begin RECORD_LAYOUT A_F32 AXIS_PTS_X 1 FLOAT32_IEEE INDEX_INCR DIRECT /end RECORD_LAYOUT
/begin TYPEDEF_MEASUREMENT M_F32 "" FLOAT32_IEEE NO_COMPU_METHOD 0 0 -1e+12 1e+12 /end TYPEDEF_MEASUREMENT
/begin TYPEDEF_CHARACTERISTIC C_F32 "" VALUE F32 0 NO_COMPU_METHOD -1e+12 1e+12 /end TYPEDEF_CHARACTERISTIC
/begin RECORD_LAYOUT F64 FNC_VALUES 1 FLOAT64_IEEE ROW_DIR DIRECT /end RECORD_LAYOUT
/begin RECORD_LAYOUT A_F64 AXIS_PTS_X 1 FLOAT64_IEEE INDEX_INCR DIRECT /end RECORD_LAYOUT
/begin TYPEDEF_MEASUREMENT M_F64 "" FLOAT64_IEEE NO_COMPU_METHOD 0 0 -1e+12 1e+12 /end TYPEDEF_MEASUREMENT
/begin TYPEDEF_CHARACTERISTIC C_F64 "" VALUE F64 0 NO_COMPU_METHOD -1e+12 1e+12 /end TYPEDEF_CHARACTERISTIC
/* Groups */
/begin GROUP observer_params "Calibration Segment" ROOT
 /begin REF_CHARACTERISTIC observer_params.reset observer_params.t1_correction observer_params.drift_filter_size observer_params.linreg_filter_size observer_params.linreg_offset_filter_size observer_params.linreg_jitter_filter_size observer_params.jitter_rms_filter_size observer_params.jitter_avg_filter_size /end REF_CHARACTERISTIC
/end GROUP
/begin GROUP obs_0.207_0 "Measurement event group"
 /begin REF_MEASUREMENT obs_0.207_0.o.gm.domain obs_0.207_0.o.gm.uuid obs_0.207_0.o.gm.addr obs_0.207_0.o.sync_local_time obs_0.207_0.o.sync_master_time obs_0.207_0.o.sync_correction obs_0.207_0.o.sync_sequenceId obs_0.207_0.o.sync_steps obs_0.207_0.o.sync_cycle_time obs_0.207_0.o.flup_master_time obs_0.207_0.o.flup_sequenceId obs_0.207_0.o.flup_correction obs_0.207_0.o.t1_norm obs_0.207_0.o.t2_norm obs_0.207_0.o.master_drift obs_0.207_0.o.master_jitter obs_0.207_0.o.master_jitter_rms obs_0.207_0.o.master_jitter_avg obs_0.207_0.o.offset_to obs_0.207_0.o.drift_to /end REF_MEASUREMENT
/end GROUP
/begin GROUP obs_3.10_1 "Measurement event group"
 /begin REF_MEASUREMENT obs_3.10_1.o.gm.domain obs_3.10_1.o.gm.uuid obs_3.10_1.o.gm.addr obs_3.10_1.o.sync_local_time obs_3.10_1.o.sync_master_time obs_3.10_1.o.sync_correction obs_3.10_1.o.sync_sequenceId obs_3.10_1.o.sync_steps obs_3.10_1.o.sync_cycle_time obs_3.10_1.o.flup_master_time obs_3.10_1.o.flup_sequenceId obs_3.10_1.o.flup_correction obs_3.10_1.o.t1_norm obs_3.10_1.o.t2_norm obs_3.10_1.o.master_drift obs_3.10_1.o.master_jitter obs_3.10_1.o.master_jitter_rms obs_3.10_1.o.master_jitter_avg obs_3.10_1.o.offset_to obs_3.10_1.o.drift_to /end REF_MEASUREMENT
/end GROUP
/begin GROUP obs_4.10_2 "Measurement event group"
 /begin REF_MEASUREMENT obs_4.10_2.o.gm.domain obs_4.10_2.o.gm.uuid obs_4.10_2.o.gm.addr obs_4.10_2.o.sync_local_time obs_4.10_2.o.sync_master_time obs_4.10_2.o.sync_correction obs_4.10_2.o.sync_sequenceId obs_4.10_2.o.sync_steps obs_4.10_2.o.sync_cycle_time obs_4.10_2.o.flup_master_time obs_4.10_2.o.flup_sequenceId obs_4.10_2.o.flup_correction obs_4.10_2.o.t1_norm obs_4.10_2.o.t2_norm obs_4.10_2.o.master_drift obs_4.10_2.o.master_jitter obs_4.10_2.o.master_jitter_rms obs_4.10_2.o.master_jitter_avg obs_4.10_2.o.offset_to obs_4.10_2.o.drift_to /end REF_MEASUREMENT
/end GROUP
/begin GROUP Events "Events" ROOT /begin SUB_GROUP obs_0.207_0 obs_3.10_1 obs_4.10_2 /end SUB_GROUP /end GROUP
/* Conversions */
/begin COMPU_METHOD conv.bool "" TAB_VERB "%.0" "" COMPU_TAB_REF conv.bool.table /end COMPU_METHOD
/begin COMPU_VTAB conv.bool.table "" TAB_VERB 2 0 "false" 1 "true" /end COMPU_VTAB
/begin COMPU_METHOD conv.events "" TAB_VERB "%.0 " "" COMPU_TAB_REF conv.events.table /end COMPU_METHOD
/begin COMPU_VTAB conv.events.table "" TAB_VERB 3 0 "obs_0.207_0" 1 "obs_3.10_1" 2 "obs_4.10_2" /end COMPU_VTAB
/begin MOD_PAR "" EPK "v1.4.120_24_27_observer_20_24_2" ADDR_EPK 0x80000000
 /begin MEMORY_SEGMENT epk "" DATA FLASH INTERN 0x80000000 31 -1 -1 -1 -1 -1
  /begin IF_DATA XCP
   /begin SEGMENT 0 2 0 0 0 /begin CHECKSUM XCP_CRC_16_CITT MAX_BLOCK_SIZE 0xFFFF EXTERNAL_FUNCTION "" /end CHECKSUM
    /begin PAGE 0 ECU_ACCESS_DONT_CARE XCP_READ_ACCESS_DONT_CARE XCP_WRITE_ACCESS_DONT_CARE /end PAGE
    /begin PAGE 1 ECU_ACCESS_DONT_CARE XCP_READ_ACCESS_DONT_CARE XCP_WRITE_ACCESS_NOT_ALLOWED /end PAGE
   /end SEGMENT
  /end IF_DATA
 /end MEMORY_SEGMENT
 /begin MEMORY_SEGMENT observer_params "" DATA FLASH INTERN 0x80010000 16 -1 -1 -1 -1 -1
  /begin IF_DATA XCP
   /begin SEGMENT 1 2 0 0 0 /begin CHECKSUM XCP_CRC_16_CITT MAX_BLOCK_SIZE 0xFFFF EXTERNAL_FUNCTION "" /end CHECKSUM
    /begin PAGE 0 ECU_ACCESS_DONT_CARE XCP_READ_ACCESS_DONT_CARE XCP_WRITE_ACCESS_DONT_CARE /end PAGE
    /begin PAGE 1 ECU_ACCESS_DONT_CARE XCP_READ_ACCESS_DONT_CARE XCP_WRITE_ACCESS_NOT_ALLOWED /end PAGE
   /end SEGMENT
  /end IF_DATA
 /end MEMORY_SEGMENT
/end MOD_PAR
/begin IF_DATA XCP
 /begin PROTOCOL_LAYER 0x104 1000 2000 0 0 0 0 0 248 1024 BYTE_ORDER_MSB_LAST ADDRESS_GRANULARITY_BYTE OPTIONAL_CMD GET_COMM_MODE_INFO OPTIONAL_CMD GET_ID OPTIONAL_CMD SET_REQUEST OPTIONAL_CMD SET_MTA OPTIONAL_CMD UPLOAD OPTIONAL_CMD SHORT_UPLOAD OPTIONAL_CMD DOWNLOAD OPTIONAL_CMD SHORT_DOWNLOAD OPTIONAL_CMD GET_CAL_PAGE OPTIONAL_CMD SET_CAL_PAGE OPTIONAL_CMD COPY_CAL_PAGE OPTIONAL_CMD GET_PAG_PROCESSOR_INFO OPTIONAL_CMD GET_SEGMENT_INFO OPTIONAL_CMD GET_PAGE_INFO OPTIONAL_CMD GET_SEGMENT_MODE OPTIONAL_CMD SET_SEGMENT_MODE OPTIONAL_CMD BUILD_CHECKSUM OPTIONAL_CMD USER_CMD OPTIONAL_CMD GET_DAQ_RESOLUTION_INFO OPTIONAL_CMD GET_DAQ_PROCESSOR_INFO OPTIONAL_CMD GET_DAQ_EVENT_INFO OPTIONAL_CMD FREE_DAQ OPTIONAL_CMD ALLOC_DAQ OPTIONAL_CMD ALLOC_ODT OPTIONAL_CMD ALLOC_ODT_ENTRY OPTIONAL_CMD SET_DAQ_PTR OPTIONAL_CMD WRITE_DAQ OPTIONAL_CMD GET_DAQ_LIST_MODE OPTIONAL_CMD SET_DAQ_LIST_MODE OPTIONAL_CMD START_STOP_SYNCH OPTIONAL_CMD START_STOP_DAQ_LIST OPTIONAL_CMD GET_DAQ_CLOCK OPTIONAL_CMD WRITE_DAQ_MULTIPLE OPTIONAL_CMD TIME_CORRELATION_PROPERTIES OPTIONAL_LEVEL1_CMD GET_VERSION /end PROTOCOL_LAYER
 /begin DAQ DYNAMIC 0 3 0 OPTIMISATION_TYPE_DEFAULT ADDRESS_EXTENSION_FREE IDENTIFICATION_FIELD_TYPE_RELATIVE_BYTE GRANULARITY_ODT_ENTRY_SIZE_DAQ_BYTE 0xF8 OVERLOAD_INDICATION_PID /begin TIMESTAMP_SUPPORTED 0x1 SIZE_DWORD UNIT_1NS TIMESTAMP_FIXED /end TIMESTAMP_SUPPORTED
  /begin EVENT "obs_0.207_0" "obs_0.20" 0x0 DAQ 0xFF 0 0 0 CONSISTENCY EVENT /end EVENT
  /begin EVENT "obs_3.10_1" "obs_3.10" 0x1 DAQ 0xFF 0 0 0 CONSISTENCY EVENT /end EVENT
  /begin EVENT "obs_4.10_2" "obs_4.10" 0x2 DAQ 0xFF 0 0 0 CONSISTENCY EVENT /end EVENT
 /end DAQ
/end IF_DATA
/end MODULE
/end PROJECT
