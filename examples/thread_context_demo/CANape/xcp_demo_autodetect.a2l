ASAP2_VERSION 1 71
/begin PROJECT thread_context_demo ""
/begin HEADER "" VERSION "1.0" PROJECT_NO XCPLITE__CASDD /end HEADER
/begin MODULE thread_context_demo ""
/include "XCP_104.aml"
/begin MOD_COMMON "" BYTE_ORDER MSB_LAST ALIGNMENT_BYTE 1 ALIGNMENT_WORD 1 ALIGNMENT_LONG 1 ALIGNMENT_FLOAT16_IEEE 1 ALIGNMENT_FLOAT32_IEEE 1 ALIGNMENT_FLOAT64_IEEE 1 ALIGNMENT_INT64 1 /end MOD_COMMON
/begin COMPU_METHOD conv.bool "" TAB_VERB "%.0" "" COMPU_TAB_REF conv.bool.table /end COMPU_METHOD
/begin COMPU_VTAB conv.bool.table "" TAB_VERB 2 0 "false" 1 "true" /end COMPU_VTAB
/begin RECORD_LAYOUT U8 FNC_VALUES 1 UBYTE ROW_DIR DIRECT /end RECORD_LAYOUT
/begin RECORD_LAYOUT A_U8 AXIS_PTS_X 1 UBYTE INDEX_INCR DIRECT /end RECORD_LAYOUT
/begin TYPEDEF_MEASUREMENT M_U8 "" UBYTE NO_COMPU_METHOD 0 0 0 255 /end TYPEDEF_MEASUREMENT
/begin TYPEDEF_CHARACTERISTIC C_U8 "" VALUE U8 0 NO_COMPU_METHOD 0 255 /end TYPEDEF_CHARACTERISTIC
/begin RECORD_LAYOUT U16 FNC_VALUES 1 UWORD ROW_DIR DIRECT /end RECORD_LAYOUT
/begin RECORD_LAYOUT A_U16 AXIS_PTS_X 1 UWORD INDEX_INCR DIRECT /end RECORD_LAYOUT
/begin TYPEDEF_MEASUREMENT M_U16 "" UWORD NO_COMPU_METHOD 0 0 0 65535 /end TYPEDEF_MEASUREMENT
/begin TYPEDEF_CHARACTERISTIC C_U16 "" VALUE U16 0 NO_COMPU_METHOD 0 65535 /end TYPEDEF_CHARACTERISTIC
/begin RECORD_LAYOUT U32 FNC_VALUES 1 ULONG ROW_DIR DIRECT /end RECORD_LAYOUT
/begin RECORD_LAYOUT A_U32 AXIS_PTS_X 1 ULONG INDEX_INCR DIRECT /end RECORD_LAYOUT
/begin TYPEDEF_MEASUREMENT M_U32 "" ULONG NO_COMPU_METHOD 0 0 0 4294967295 /end TYPEDEF_MEASUREMENT
/begin TYPEDEF_CHARACTERISTIC C_U32 "" VALUE U32 0 NO_COMPU_METHOD 0 4.29497e+09 /end TYPEDEF_CHARACTERISTIC
/begin RECORD_LAYOUT U64 FNC_VALUES 1 A_UINT64 ROW_DIR DIRECT /end RECORD_LAYOUT
/begin RECORD_LAYOUT A_U64 AXIS_PTS_X 1 A_UINT64 INDEX_INCR DIRECT /end RECORD_LAYOUT
/begin TYPEDEF_MEASUREMENT M_U64 "" A_UINT64 NO_COMPU_METHOD 0 0 0 1000000000000 /end TYPEDEF_MEASUREMENT
/begin TYPEDEF_CHARACTERISTIC C_U64 "" VALUE U64 0 NO_COMPU_METHOD 0 1e+12 /end TYPEDEF_CHARACTERISTIC
/begin RECORD_LAYOUT I8 FNC_VALUES 1 SBYTE ROW_DIR DIRECT /end RECORD_LAYOUT
/begin RECORD_LAYOUT A_I8 AXIS_PTS_X 1 SBYTE INDEX_INCR DIRECT /end RECORD_LAYOUT
/begin TYPEDEF_MEASUREMENT M_I8 "" SBYTE NO_COMPU_METHOD 0 0 -128 127 /end TYPEDEF_MEASUREMENT
/begin TYPEDEF_CHARACTERISTIC C_I8 "" VALUE I8 0 NO_COMPU_METHOD -128 127 /end TYPEDEF_CHARACTERISTIC
/begin RECORD_LAYOUT I16 FNC_VALUES 1 SWORD ROW_DIR DIRECT /end RECORD_LAYOUT
/begin RECORD_LAYOUT A_I16 AXIS_PTS_X 1 SWORD INDEX_INCR DIRECT /end RECORD_LAYOUT
/begin TYPEDEF_MEASUREMENT M_I16 "" SWORD NO_COMPU_METHOD 0 0 -32768 32767 /end TYPEDEF_MEASUREMENT
/begin TYPEDEF_CHARACTERISTIC C_I16 "" VALUE I16 0 NO_COMPU_METHOD -32768 32767 /end TYPEDEF_CHARACTERISTIC
/begin RECORD_LAYOUT I32 FNC_VALUES 1 SLONG ROW_DIR DIRECT /end RECORD_LAYOUT
/begin RECORD_LAYOUT A_I32 AXIS_PTS_X 1 SLONG INDEX_INCR DIRECT /end RECORD_LAYOUT
/begin TYPEDEF_MEASUREMENT M_I32 "" SLONG NO_COMPU_METHOD 0 0 -2147483648 2147483647 /end TYPEDEF_MEASUREMENT
/begin TYPEDEF_CHARACTERISTIC C_I32 "" VALUE I32 0 NO_COMPU_METHOD -2.14748e+09 2.14748e+09 /end TYPEDEF_CHARACTERISTIC
/begin RECORD_LAYOUT I64 FNC_VALUES 1 A_INT64 ROW_DIR DIRECT /end RECORD_LAYOUT
/begin RECORD_LAYOUT A_I64 AXIS_PTS_X 1 A_INT64 INDEX_INCR DIRECT /end RECORD_LAYOUT
/begin TYPEDEF_MEASUREMENT M_I64 "" A_INT64 NO_COMPU_METHOD 0 0 -1000000000000 1000000000000 /end TYPEDEF_MEASUREMENT
/begin TYPEDEF_CHARACTERISTIC C_I64 "" VALUE I64 0 NO_COMPU_METHOD -1e+12 1e+12 /end TYPEDEF_CHARACTERISTIC
/begin RECORD_LAYOUT F32 FNC_VALUES 1 FLOAT32_IEEE ROW_DIR DIRECT /end RECORD_LAYOUT
/begin RECORD_LAYOUT A_F32 AXIS_PTS_X 1 FLOAT32_IEEE INDEX_INCR DIRECT /end RECORD_LAYOUT
/begin TYPEDEF_MEASUREMENT M_F32 "" FLOAT32_IEEE NO_COMPU_METHOD 0 0 -1e+12 1e+12 /end TYPEDEF_MEASUREMENT
/begin TYPEDEF_CHARACTERISTIC C_F32 "" VALUE F32 0 NO_COMPU_METHOD -1e+12 1e+12 /end TYPEDEF_CHARACTERISTIC
/begin RECORD_LAYOUT F64 FNC_VALUES 1 FLOAT64_IEEE ROW_DIR DIRECT /end RECORD_LAYOUT
/begin RECORD_LAYOUT A_F64 AXIS_PTS_X 1 FLOAT64_IEEE INDEX_INCR DIRECT /end RECORD_LAYOUT
/begin TYPEDEF_MEASUREMENT M_F64 "" FLOAT64_IEEE NO_COMPU_METHOD 0 0 -1e+12 1e+12 /end TYPEDEF_MEASUREMENT
/begin TYPEDEF_CHARACTERISTIC C_F64 "" VALUE F64 0 NO_COMPU_METHOD -1e+12 1e+12 /end TYPEDEF_CHARACTERISTIC
/begin MEASUREMENT Main.span "Current span" UWORD conv.spans 0 0 0 9 ECU_ADDRESS 0x4 ECU_ADDRESS_EXTENSION 3 READ_WRITE
 /begin IF_DATA XCP
  /begin DAQ_EVENT FIXED_EVENT_LIST EVENT 0x0 /end DAQ_EVENT
 /end IF_DATA
/end MEASUREMENT
/begin MEASUREMENT Main.level "Current span nesting level" UWORD NO_COMPU_METHOD 0 0 0 255 ECU_ADDRESS 0x6 ECU_ADDRESS_EXTENSION 3 READ_WRITE
 /begin IF_DATA XCP
  /begin DAQ_EVENT FIXED_EVENT_LIST EVENT 0x0 /end DAQ_EVENT
 /end IF_DATA
/end MEASUREMENT
/begin MEASUREMENT Main.span_dt "Duration of the span that ended" ULONG NO_COMPU_METHOD 0 0 0 4.29497e+09 ECU_ADDRESS 0x0 ECU_ADDRESS_EXTENSION 3 PHYS_UNIT "ns" READ_WRITE
 /begin IF_DATA XCP
  /begin DAQ_EVENT FIXED_EVENT_LIST EVENT 0x0 /end DAQ_EVENT
 /end IF_DATA
/end MEASUREMENT
/begin MEASUREMENT SigGen1.span "Current span" UWORD conv.spans 0 0 0 9 ECU_ADDRESS 0x400004 ECU_ADDRESS_EXTENSION 3 READ_WRITE
 /begin IF_DATA XCP
  /begin DAQ_EVENT FIXED_EVENT_LIST EVENT 0x1 /end DAQ_EVENT
 /end IF_DATA
/end MEASUREMENT
/begin MEASUREMENT SigGen1.level "Current span nesting level" UWORD NO_COMPU_METHOD 0 0 0 255 ECU_ADDRESS 0x400006 ECU_ADDRESS_EXTENSION 3 READ_WRITE
 /begin IF_DATA XCP
  /begin DAQ_EVENT FIXED_EVENT_LIST EVENT 0x1 /end DAQ_EVENT
 /end IF_DATA
/end MEASUREMENT
/begin MEASUREMENT SigGen1.span_dt "Duration of the span that ended" ULONG NO_COMPU_METHOD 0 0 0 4.29497e+09 ECU_ADDRESS 0x400000 ECU_ADDRESS_EXTENSION 3 PHYS_UNIT "ns" READ_WRITE
 /begin IF_DATA XCP
  /begin DAQ_EVENT FIXED_EVENT_LIST EVENT 0x1 /end DAQ_EVENT
 /end IF_DATA
/end MEASUREMENT
/begin TYPEDEF_STRUCTURE SignalParametersT "A2L typedef for SignalParametersT" 0x38 /begin STRUCTURE_COMPONENT signal_type C_signal_type 0x34 /end STRUCTURE_COMPONENT /begin STRUCTURE_COMPONENT ampl C_ampl 0x0 /end STRUCTURE_COMPONENT /begin STRUCTURE_COMPONENT phase C_phase 0x8 /end STRUCTURE_COMPONENT /begin STRUCTURE_COMPONENT offset C_offset 0x10 /end STRUCTURE_COMPONENT /begin STRUCTURE_COMPONENT period C_period 0x18 /end STRUCTURE_COMPONENT /begin STRUCTURE_COMPONENT clip_min C_clip_min 0x20 /end STRUCTURE_COMPONENT /begin STRUCTURE_COMPONENT clip_max C_clip_max 0x28 /end STRUCTURE_COMPONENT /begin STRUCTURE_COMPONENT sample_time_us C_sample_time_us 0x30 /end STRUCTURE_COMPONENT /end TYPEDEF_STRUCTURE
/begin INSTANCE SigGen1 "Signal parameters for the signal generator" SignalParametersT 0x80010000 /end INSTANCE
/begin MEASUREMENT SigGen2.span "Current span" UWORD conv.spans 0 0 0 9 ECU_ADDRESS 0x800004 ECU_ADDRESS_EXTENSION 3 READ_WRITE
 /begin IF_DATA XCP
  /begin DAQ_EVENT FIXED_EVENT_LIST EVENT 0x2 /end DAQ_EVENT
 /end IF_DATA
/end MEASUREMENT
/begin MEASUREMENT SigGen2.level "Current span nesting level" UWORD NO_COMPU_METHOD 0 0 0 255 ECU_ADDRESS 0x800006 ECU_ADDRESS_EXTENSION 3 READ_WRITE
 /begin IF_DATA XCP
  /begin DAQ_EVENT FIXED_EVENT_LIST EVENT 0x2 /end DAQ_EVENT
 /end IF_DATA
/end MEASUREMENT
/begin MEASUREMENT SigGen2.span_dt "Duration of the span that ended" ULONG NO_COMPU_METHOD 0 0 0 4.29497e+09 ECU_ADDRESS 0x800000 ECU_ADDRESS_EXTENSION 3 PHYS_UNIT "ns" READ_WRITE
 /begin IF_DATA XCP
  /begin DAQ_EVENT FIXED_EVENT_LIST EVENT 0x2 /end DAQ_EVENT
 /end IF_DATA
/end MEASUREMENT
/begin INSTANCE SigGen2 "Signal parameters for the signal generator" SignalParametersT 0x80020000 /end INSTANCE
/begin TYPEDEF_STRUCTURE MainloopParametersT "Typedef for MainloopParametersT" 0x4 /begin STRUCTURE_COMPONENT idle_sleep_us C_idle_sleep_us 0x0 /end STRUCTURE_COMPONENT /end TYPEDEF_STRUCTURE
/begin INSTANCE Mainloop "Main loop parameters" MainloopParametersT 0x80030000 /end INSTANCE
/begin MEASUREMENT SigGen2.clipped "Clip function clipped input" UBYTE NO_COMPU_METHOD 0 0 0 255 ECU_ADDRESS 0xC00000 ECU_ADDRESS_EXTENSION 3 READ_WRITE
 /begin IF_DATA XCP
  /begin DAQ_EVENT FIXED_EVENT_LIST EVENT 0x3 /end DAQ_EVENT
 /end IF_DATA
/end MEASUREMENT
/begin MEASUREMENT output "Clip function clipped input" FLOAT64_IEEE NO_COMPU_METHOD 0 0 -1e+12 1e+12 ECU_ADDRESS 0x1000000 ECU_ADDRESS_EXTENSION 3 READ_WRITE
 /begin IF_DATA XCP
  /begin DAQ_EVENT FIXED_EVENT_LIST EVENT 0x4 /end DAQ_EVENT
 /end IF_DATA
/end MEASUREMENT
/begin MEASUREMENT SigGen2.value_ "Signal generator output" FLOAT64_IEEE NO_COMPU_METHOD 0 0 -100 100 ECU_ADDRESS 0x1400000 ECU_ADDRESS_EXTENSION 3 PHYS_UNIT "Volt" READ_WRITE
 /begin IF_DATA XCP
  /begin DAQ_EVENT FIXED_EVENT_LIST EVENT 0x5 /end DAQ_EVENT
 /end IF_DATA
/end MEASUREMENT
/begin MEASUREMENT SigGen2.time_us "Time stamp of the sample, clockGetMonotonicUs()" A_UINT64 NO_COMPU_METHOD 0 0 0 1e+18 ECU_ADDRESS 0x1400000 ECU_ADDRESS_EXTENSION 4 PHYS_UNIT "us" READ_WRITE
 /begin IF_DATA XCP
  /begin DAQ_EVENT FIXED_EVENT_LIST EVENT 0x5 /end DAQ_EVENT
 /end IF_DATA
/end MEASUREMENT
/begin MEASUREMENT SigGen2.queue_level "Number of unread samples in the output queue after the push" ULONG NO_COMPU_METHOD 0 0 0 4.29497e+09 ECU_ADDRESS 0x1400000 ECU_ADDRESS_EXTENSION 5 READ_WRITE
 /begin IF_DATA XCP
  /begin DAQ_EVENT FIXED_EVENT_LIST EVENT 0x5 /end DAQ_EVENT
 /end IF_DATA
/end MEASUREMENT
/begin MEASUREMENT SigGen2.overflows_ "Number of samples dropped because the output queue was full" ULONG NO_COMPU_METHOD 0 0 0 4.29497e+09 ECU_ADDRESS 0x1400000 ECU_ADDRESS_EXTENSION 6 READ_WRITE
 /begin IF_DATA XCP
  /begin DAQ_EVENT FIXED_EVENT_LIST EVENT 0x5 /end DAQ_EVENT
 /end IF_DATA
/end MEASUREMENT
/begin MEASUREMENT SigGen1.clipped "Clip function clipped input" UBYTE NO_COMPU_METHOD 0 0 0 255 ECU_ADDRESS 0x1800000 ECU_ADDRESS_EXTENSION 3 READ_WRITE
 /begin IF_DATA XCP
  /begin DAQ_EVENT FIXED_EVENT_LIST EVENT 0x6 /end DAQ_EVENT
 /end IF_DATA
/end MEASUREMENT
/begin MEASUREMENT SigGen1.value_ "Signal generator output" FLOAT64_IEEE NO_COMPU_METHOD 0 0 -100 100 ECU_ADDRESS 0x1C00000 ECU_ADDRESS_EXTENSION 3 PHYS_UNIT "Volt" READ_WRITE
 /begin IF_DATA XCP
  /begin DAQ_EVENT FIXED_EVENT_LIST EVENT 0x7 /end DAQ_EVENT
 /end IF_DATA
/end MEASUREMENT
/begin MEASUREMENT SigGen1.time_us "Time stamp of the sample, clockGetMonotonicUs()" A_UINT64 NO_COMPU_METHOD 0 0 0 1e+18 ECU_ADDRESS 0x1C00000 ECU_ADDRESS_EXTENSION 4 PHYS_UNIT "us" READ_WRITE
 /begin IF_DATA XCP
  /begin DAQ_EVENT FIXED_EVENT_LIST EVENT 0x7 /end DAQ_EVENT
 /end IF_DATA
/end MEASUREMENT
/begin MEASUREMENT SigGen1.queue_level "Number of unread samples in the output queue after the push" ULONG NO_COMPU_METHOD 0 0 0 4.29497e+09 ECU_ADDRESS 0x1C00000 ECU_ADDRESS_EXTENSION 5 READ_WRITE
 /begin IF_DATA XCP
  /begin DAQ_EVENT FIXED_EVENT_LIST EVENT 0x7 /end DAQ_EVENT
 /end IF_DATA
/end MEASUREMENT
/begin MEASUREMENT SigGen1.overflows_ "Number of samples dropped because the output queue was full" ULONG NO_COMPU_METHOD 0 0 0 4.29497e+09 ECU_ADDRESS 0x1C00000 ECU_ADDRESS_EXTENSION 6 READ_WRITE
 /begin IF_DATA XCP
  /begin DAQ_EVENT FIXED_EVENT_LIST EVENT 0x7 /end DAQ_EVENT
 /end IF_DATA
/end MEASUREMENT
/begin MEASUREMENT Mainloop.span "Current span" UWORD conv.spans 0 0 0 9 ECU_ADDRESS 0x2000004 ECU_ADDRESS_EXTENSION 3 READ_WRITE
 /begin IF_DATA XCP
  /begin DAQ_EVENT FIXED_EVENT_LIST EVENT 0x8 /end DAQ_EVENT
 /end IF_DATA
/end MEASUREMENT
/begin MEASUREMENT Mainloop.level "Current span nesting level" UWORD NO_COMPU_METHOD 0 0 0 255 ECU_ADDRESS 0x2000006 ECU_ADDRESS_EXTENSION 3 READ_WRITE
 /begin IF_DATA XCP
  /begin DAQ_EVENT FIXED_EVENT_LIST EVENT 0x8 /end DAQ_EVENT
 /end IF_DATA
/end MEASUREMENT
/begin MEASUREMENT Mainloop.span_dt "Duration of the span that ended" ULONG NO_COMPU_METHOD 0 0 0 4.29497e+09 ECU_ADDRESS 0x2000000 ECU_ADDRESS_EXTENSION 3 PHYS_UNIT "ns" READ_WRITE
 /begin IF_DATA XCP
  /begin DAQ_EVENT FIXED_EVENT_LIST EVENT 0x8 /end DAQ_EVENT
 /end IF_DATA
/end MEASUREMENT
/begin MEASUREMENT Mainloop.link_context "Context of the linked producer span" UWORD conv.contexts 0 0 0 8 ECU_ADDRESS 0x2400008 ECU_ADDRESS_EXTENSION 3 READ_WRITE
 /begin IF_DATA XCP
  /begin DAQ_EVENT FIXED_EVENT_LIST EVENT 0x9 /end DAQ_EVENT
 /end IF_DATA
/end MEASUREMENT
/begin MEASUREMENT Mainloop.link_span "Linked producer span" UWORD conv.spans 0 0 0 9 ECU_ADDRESS 0x240000A ECU_ADDRESS_EXTENSION 3 READ_WRITE
 /begin IF_DATA XCP
  /begin DAQ_EVENT FIXED_EVENT_LIST EVENT 0x9 /end DAQ_EVENT
 /end IF_DATA
/end MEASUREMENT
/begin MEASUREMENT Mainloop.link_time "Timestamp of the capture of the link in the producer span, in DAQ timestamp ticks" A_UINT64 NO_COMPU_METHOD 0 0 0 1.84467e+19 ECU_ADDRESS 0x2400000 ECU_ADDRESS_EXTENSION 3 READ_WRITE
 /begin IF_DATA XCP
  /begin DAQ_EVENT FIXED_EVENT_LIST EVENT 0x9 /end DAQ_EVENT
 /end IF_DATA
/end MEASUREMENT
/begin MEASUREMENT Mainloop.polled "Value polled by another thread" FLOAT64_IEEE NO_COMPU_METHOD 0 0 -100 100 ECU_ADDRESS 0x2800000 ECU_ADDRESS_EXTENSION 3 PHYS_UNIT "Volt" READ_WRITE
 /begin IF_DATA XCP
  /begin DAQ_EVENT FIXED_EVENT_LIST EVENT 0xA /end DAQ_EVENT
 /end IF_DATA
/end MEASUREMENT
/begin MEASUREMENT Mainloop.value1 "Sample value of signal generator 1" FLOAT64_IEEE NO_COMPU_METHOD 0 0 -100 100 ECU_ADDRESS 0x2C00000 ECU_ADDRESS_EXTENSION 3 PHYS_UNIT "Volt" READ_WRITE
 /begin IF_DATA XCP
  /begin DAQ_EVENT FIXED_EVENT_LIST EVENT 0xB /end DAQ_EVENT
 /end IF_DATA
/end MEASUREMENT
/begin MEASUREMENT Mainloop.latency1 "Sample latency of signal generator 1" ULONG NO_COMPU_METHOD 0 0 0 100000 ECU_ADDRESS 0x2C00000 ECU_ADDRESS_EXTENSION 4 PHYS_UNIT "us" READ_WRITE
 /begin IF_DATA XCP
  /begin DAQ_EVENT FIXED_EVENT_LIST EVENT 0xB /end DAQ_EVENT
 /end IF_DATA
/end MEASUREMENT
/begin MEASUREMENT Mainloop.dropped1 "Samples of signal generator 1 dropped before this sample" ULONG NO_COMPU_METHOD 0 0 0 4.29497e+09 ECU_ADDRESS 0x2C00000 ECU_ADDRESS_EXTENSION 5 READ_WRITE
 /begin IF_DATA XCP
  /begin DAQ_EVENT FIXED_EVENT_LIST EVENT 0xB /end DAQ_EVENT
 /end IF_DATA
/end MEASUREMENT
/begin MEASUREMENT Mainloop.value2 "Sample value of signal generator 2" FLOAT64_IEEE NO_COMPU_METHOD 0 0 -100 100 ECU_ADDRESS 0x3000000 ECU_ADDRESS_EXTENSION 3 PHYS_UNIT "Volt" READ_WRITE
 /begin IF_DATA XCP
  /begin DAQ_EVENT FIXED_EVENT_LIST EVENT 0xC /end DAQ_EVENT
 /end IF_DATA
/end MEASUREMENT
/begin MEASUREMENT Mainloop.latency2 "Sample latency of signal generator 2" ULONG NO_COMPU_METHOD 0 0 0 100000 ECU_ADDRESS 0x3000000 ECU_ADDRESS_EXTENSION 4 PHYS_UNIT "us" READ_WRITE
 /begin IF_DATA XCP
  /begin DAQ_EVENT FIXED_EVENT_LIST EVENT 0xC /end DAQ_EVENT
 /end IF_DATA
/end MEASUREMENT
/begin MEASUREMENT Mainloop.dropped2 "Samples of signal generator 2 dropped before this sample" ULONG NO_COMPU_METHOD 0 0 0 4.29497e+09 ECU_ADDRESS 0x3000000 ECU_ADDRESS_EXTENSION 5 READ_WRITE
 /begin IF_DATA XCP
  /begin DAQ_EVENT FIXED_EVENT_LIST EVENT 0xC /end DAQ_EVENT
 /end IF_DATA
/end MEASUREMENT
/begin MEASUREMENT Mainloop.channel1 "Latest value of signal generator 1" FLOAT64_IEEE NO_COMPU_METHOD 0 0 -100 100 ECU_ADDRESS 0x3400000 ECU_ADDRESS_EXTENSION 3 PHYS_UNIT "Volt" READ_WRITE
 /begin IF_DATA XCP
  /begin DAQ_EVENT FIXED_EVENT_LIST EVENT 0xD /end DAQ_EVENT
 /end IF_DATA
/end MEASUREMENT
/begin MEASUREMENT Mainloop.channel2 "Latest value of signal generator 2" FLOAT64_IEEE NO_COMPU_METHOD 0 0 -100 100 ECU_ADDRESS 0x3400000 ECU_ADDRESS_EXTENSION 4 PHYS_UNIT "Volt" READ_WRITE
 /begin IF_DATA XCP
  /begin DAQ_EVENT FIXED_EVENT_LIST EVENT 0xD /end DAQ_EVENT
 /end IF_DATA
/end MEASUREMENT
/* Typedefs */
/begin TYPEDEF_CHARACTERISTIC C_signal_type "Signal type" VALUE U8 0 conv.signal_type_enum 0 3 /end TYPEDEF_CHARACTERISTIC
/begin TYPEDEF_CHARACTERISTIC C_ampl "Amplitude" VALUE F64 0 NO_COMPU_METHOD 0 100 PHYS_UNIT "Volt" /end TYPEDEF_CHARACTERISTIC
/begin TYPEDEF_CHARACTERISTIC C_phase "Phase" VALUE F64 0 NO_COMPU_METHOD 0 6.28319 /end TYPEDEF_CHARACTERISTIC
/begin TYPEDEF_CHARACTERISTIC C_offset "Offset" VALUE F64 0 NO_COMPU_METHOD -100 100 PHYS_UNIT "Volt" /end TYPEDEF_CHARACTERISTIC
/begin TYPEDEF_CHARACTERISTIC C_period "Period" VALUE F64 0 NO_COMPU_METHOD 0.01 10 PHYS_UNIT "s" /end TYPEDEF_CHARACTERISTIC
/begin TYPEDEF_CHARACTERISTIC C_clip_min "Lower output limit" VALUE F64 0 NO_COMPU_METHOD -100 100 PHYS_UNIT "Volt" /end TYPEDEF_CHARACTERISTIC
/begin TYPEDEF_CHARACTERISTIC C_clip_max "Upper output limit" VALUE F64 0 NO_COMPU_METHOD -100 100 PHYS_UNIT "Volt" /end TYPEDEF_CHARACTERISTIC
/begin TYPEDEF_CHARACTERISTIC C_sample_time_us "Delay time in us" VALUE U32 0 NO_COMPU_METHOD 0 100000 PHYS_UNIT "us" /end TYPEDEF_CHARACTERISTIC
/begin TYPEDEF_CHARACTERISTIC C_idle_sleep_us "Main loop sleep time when there are no samples" VALUE U32 0 NO_COMPU_METHOD 0 100000 PHYS_UNIT "us" /end TYPEDEF_CHARACTERISTIC
/* Groups */
/begin GROUP Main.spans "Measurement event group" /begin REF_MEASUREMENT Main.span Main.level Main.span_dt /end REF_MEASUREMENT /end GROUP
/begin GROUP SigGen1 "Calibration Segment" ROOT /begin REF_CHARACTERISTIC /end REF_CHARACTERISTIC /end GROUP
/begin GROUP SigGen1.spans "Measurement event group" /begin REF_MEASUREMENT SigGen1.span SigGen1.level SigGen1.span_dt /end REF_MEASUREMENT /end GROUP
/begin GROUP SigGen1 "Calibration Segment" ROOT /begin REF_CHARACTERISTIC SigGen1 /end REF_CHARACTERISTIC /end GROUP
/begin GROUP SigGen2 "Calibration Segment" ROOT /begin REF_CHARACTERISTIC /end REF_CHARACTERISTIC /end GROUP
/begin GROUP SigGen2.spans "Measurement event group" /begin REF_MEASUREMENT SigGen2.span SigGen2.level SigGen2.span_dt /end REF_MEASUREMENT /end GROUP
/begin GROUP SigGen2 "Calibration Segment" ROOT /begin REF_CHARACTERISTIC SigGen2 /end REF_CHARACTERISTIC /end GROUP
/begin GROUP Mainloop "Calibration Segment" ROOT /begin REF_CHARACTERISTIC Mainloop /end REF_CHARACTERISTIC /end GROUP
/begin GROUP SigGen2.clip "Measurement event group" /begin REF_MEASUREMENT SigGen2.clipped /end REF_MEASUREMENT /end GROUP
/begin GROUP clip "Measurement event group" /begin REF_MEASUREMENT output /end REF_MEASUREMENT /end GROUP
/begin GROUP SigGen2.siggen "Measurement event group"
 /begin REF_MEASUREMENT SigGen2.value_ SigGen2.time_us SigGen2.queue_level SigGen2.overflows_ /end REF_MEASUREMENT
/end GROUP
/begin GROUP SigGen1.clip "Measurement event group" /begin REF_MEASUREMENT SigGen1.clipped /end REF_MEASUREMENT /end GROUP
/begin GROUP SigGen1.siggen "Measurement event group"
 /begin REF_MEASUREMENT SigGen1.value_ SigGen1.time_us SigGen1.queue_level SigGen1.overflows_ /end REF_MEASUREMENT
/end GROUP
/begin GROUP Mainloop.spans "Measurement event group" /begin REF_MEASUREMENT Mainloop.span Mainloop.level Mainloop.span_dt /end REF_MEASUREMENT /end GROUP
/begin GROUP Mainloop.links "Measurement event group"
 /begin REF_MEASUREMENT Mainloop.link_context Mainloop.link_span Mainloop.link_time /end REF_MEASUREMENT
/end GROUP
/begin GROUP Mainloop.poll "Measurement event group" /begin REF_MEASUREMENT Mainloop.polled /end REF_MEASUREMENT /end GROUP
/begin GROUP Mainloop.sample1 "Measurement event group" /begin REF_MEASUREMENT Mainloop.value1 Mainloop.latency1 Mainloop.dropped1 /end REF_MEASUREMENT /end GROUP
/begin GROUP Mainloop.sample2 "Measurement event group" /begin REF_MEASUREMENT Mainloop.value2 Mainloop.latency2 Mainloop.dropped2 /end REF_MEASUREMENT /end GROUP
/begin GROUP Mainloop.mainloop "Measurement event group" /begin REF_MEASUREMENT Mainloop.channel1 Mainloop.channel2 /end REF_MEASUREMENT /end GROUP
/* Conversions */
/begin COMPU_METHOD conv.signal_type_enum "" TAB_VERB "%.0 " "" COMPU_TAB_REF conv.signal_type_enum.table /end COMPU_METHOD
/begin COMPU_VTAB conv.signal_type_enum.table "" TAB_VERB 4 0 "SINE" 1 "SQUARE" 2 "TRIANGLE" 3 "SAWTOOTH" /end COMPU_VTAB
/begin GROUP Events "Events" ROOT
 /begin SUB_GROUP Main.spans SigGen1.spans SigGen2.spans SigGen2.clip clip SigGen2.siggen SigGen1.clip SigGen1.siggen Mainloop.spans Mainloop.links Mainloop.poll Mainloop.sample1 Mainloop.sample2 Mainloop.mainloop /end SUB_GROUP
/end GROUP
/begin COMPU_METHOD conv.contexts "" TAB_VERB "%.0 " "" COMPU_TAB_REF conv.contexts.table /end COMPU_METHOD
/begin COMPU_VTAB conv.contexts.table "" TAB_VERB 5 0 "none" 1 "Main" 2 "SigGen1" 3 "SigGen2" 4 "Mainloop" /end COMPU_VTAB
/begin COMPU_METHOD conv.spans "" TAB_VERB "%.0 " "" COMPU_TAB_REF conv.spans.table /end COMPU_METHOD
/begin COMPU_VTAB conv.spans.table "" TAB_VERB 10 0 "none" 1 "initialize" 2 "poll_loop" 3 "get_channel1" 4 "get_channel2" 5 "analyze" 6 "clip" 7 "poll" 8 "task" 9 "calc" /end COMPU_VTAB
/begin MOD_PAR "" EPK "V103" ADDR_EPK 0x80000000
 /begin MEMORY_SEGMENT epk "" DATA FLASH INTERN 0x80000000 32 -1 -1 -1 -1 -1
  /begin IF_DATA XCP
   /begin SEGMENT 0 2 0 0 0 /begin CHECKSUM XCP_CRC_16_CITT MAX_BLOCK_SIZE 0xFFFF EXTERNAL_FUNCTION "" /end CHECKSUM
    /begin PAGE 0 ECU_ACCESS_DONT_CARE XCP_READ_ACCESS_DONT_CARE XCP_WRITE_ACCESS_DONT_CARE /end PAGE
    /begin PAGE 1 ECU_ACCESS_DONT_CARE XCP_READ_ACCESS_DONT_CARE XCP_WRITE_ACCESS_NOT_ALLOWED /end PAGE
   /end SEGMENT
  /end IF_DATA
 /end MEMORY_SEGMENT
 /begin MEMORY_SEGMENT SigGen1 "" DATA FLASH INTERN 0x80010000 56 -1 -1 -1 -1 -1
  /begin IF_DATA XCP
   /begin SEGMENT 1 2 0 0 0 /begin CHECKSUM XCP_CRC_16_CITT MAX_BLOCK_SIZE 0xFFFF EXTERNAL_FUNCTION "" /end CHECKSUM
    /begin PAGE 0 ECU_ACCESS_DONT_CARE XCP_READ_ACCESS_DONT_CARE XCP_WRITE_ACCESS_DONT_CARE /end PAGE
    /begin PAGE 1 ECU_ACCESS_DONT_CARE XCP_READ_ACCESS_DONT_CARE XCP_WRITE_ACCESS_NOT_ALLOWED /end PAGE
   /end SEGMENT
  /end IF_DATA
 /end MEMORY_SEGMENT
 /begin MEMORY_SEGMENT SigGen2 "" DATA FLASH INTERN 0x80020000 56 -1 -1 -1 -1 -1
  /begin IF_DATA XCP
   /begin SEGMENT 2 2 0 0 0 /begin CHECKSUM XCP_CRC_16_CITT MAX_BLOCK_SIZE 0xFFFF EXTERNAL_FUNCTION "" /end CHECKSUM
    /begin PAGE 0 ECU_ACCESS_DONT_CARE XCP_READ_ACCESS_DONT_CARE XCP_WRITE_ACCESS_DONT_CARE /end PAGE
    /begin PAGE 1 ECU_ACCESS_DONT_CARE XCP_READ_ACCESS_DONT_CARE XCP_WRITE_ACCESS_NOT_ALLOWED /end PAGE
   /end SEGMENT
  /end IF_DATA
 /end MEMORY_SEGMENT
 /begin MEMORY_SEGMENT Mainloop "" DATA FLASH INTERN 0x80030000 4 -1 -1 -1 -1 -1
  /begin IF_DATA XCP
   /begin SEGMENT 3 2 0 0 0 /begin CHECKSUM XCP_CRC_16_CITT MAX_BLOCK_SIZE 0xFFFF EXTERNAL_FUNCTION "" /end CHECKSUM
    /begin PAGE 0 ECU_ACCESS_DONT_CARE XCP_READ_ACCESS_DONT_CARE XCP_WRITE_ACCESS_DONT_CARE /end PAGE
    /begin PAGE 1 ECU_ACCESS_DONT_CARE XCP_READ_ACCESS_DONT_CARE XCP_WRITE_ACCESS_NOT_ALLOWED /end PAGE
   /end SEGMENT
  /end IF_DATA
 /end MEMORY_SEGMENT
/end MOD_PAR
/begin IF_DATA XCP
 /begin PROTOCOL_LAYER 0x104 1000 2000 0 0 0 0 0 248 1024 BYTE_ORDER_MSB_LAST ADDRESS_GRANULARITY_BYTE OPTIONAL_CMD GET_COMM_MODE_INFO OPTIONAL_CMD GET_ID OPTIONAL_CMD SET_REQUEST OPTIONAL_CMD SET_MTA OPTIONAL_CMD UPLOAD OPTIONAL_CMD SHORT_UPLOAD OPTIONAL_CMD DOWNLOAD OPTIONAL_CMD SHORT_DOWNLOAD OPTIONAL_CMD GET_CAL_PAGE OPTIONAL_CMD SET_CAL_PAGE OPTIONAL_CMD COPY_CAL_PAGE OPTIONAL_CMD GET_PAG_PROCESSOR_INFO OPTIONAL_CMD GET_SEGMENT_INFO OPTIONAL_CMD GET_PAGE_INFO OPTIONAL_CMD GET_SEGMENT_MODE OPTIONAL_CMD SET_SEGMENT_MODE OPTIONAL_CMD BUILD_CHECKSUM OPTIONAL_CMD USER_CMD OPTIONAL_CMD GET_DAQ_RESOLUTION_INFO OPTIONAL_CMD GET_DAQ_PROCESSOR_INFO OPTIONAL_CMD GET_DAQ_EVENT_INFO OPTIONAL_CMD FREE_DAQ OPTIONAL_CMD ALLOC_DAQ OPTIONAL_CMD ALLOC_ODT OPTIONAL_CMD ALLOC_ODT_ENTRY OPTIONAL_CMD SET_DAQ_PTR OPTIONAL_CMD WRITE_DAQ OPTIONAL_CMD GET_DAQ_LIST_MODE OPTIONAL_CMD SET_DAQ_LIST_MODE OPTIONAL_CMD START_STOP_SYNCH OPTIONAL_CMD START_STOP_DAQ_LIST OPTIONAL_CMD GET_DAQ_CLOCK OPTIONAL_CMD WRITE_DAQ_MULTIPLE OPTIONAL_CMD TIME_CORRELATION_PROPERTIES OPTIONAL_LEVEL1_CMD GET_VERSION /end PROTOCOL_LAYER
 /begin DAQ DYNAMIC 0 14 0 OPTIMISATION_TYPE_DEFAULT ADDRESS_EXTENSION_FREE IDENTIFICATION_FIELD_TYPE_RELATIVE_BYTE GRANULARITY_ODT_ENTRY_SIZE_DAQ_BYTE 0xF8 OVERLOAD_INDICATION_PID /begin TIMESTAMP_SUPPORTED 0x1 SIZE_DWORD UNIT_1NS TIMESTAMP_FIXED /end TIMESTAMP_SUPPORTED /begin EVENT "Main.spans" "spans" 0x0 DAQ 0xFF 0 0 0 CONSISTENCY EVENT /end EVENT
  /begin EVENT "SigGen1.spans" "spans" 0x1 DAQ 0xFF 0 0 0 CONSISTENCY EVENT /end EVENT
  /begin EVENT "SigGen2.spans" "spans" 0x2 DAQ 0xFF 0 0 0 CONSISTENCY EVENT /end EVENT
  /begin EVENT "SigGen2.clip" "clip" 0x3 DAQ 0xFF 0 0 0 CONSISTENCY EVENT /end EVENT
  /begin EVENT "clip" "clip" 0x4 DAQ 0xFF 0 0 0 CONSISTENCY EVENT /end EVENT
  /begin EVENT "SigGen2.siggen" "siggen" 0x5 DAQ 0xFF 0 0 0 CONSISTENCY EVENT /end EVENT
  /begin EVENT "SigGen1.clip" "clip" 0x6 DAQ 0xFF 0 0 0 CONSISTENCY EVENT /end EVENT
  /begin EVENT "SigGen1.siggen" "siggen" 0x7 DAQ 0xFF 0 0 0 CONSISTENCY EVENT /end EVENT
  /begin EVENT "Mainloop.spans" "spans" 0x8 DAQ 0xFF 0 0 0 CONSISTENCY EVENT /end EVENT
  /begin EVENT "Mainloop.links" "links" 0x9 DAQ 0xFF 0 0 0 CONSISTENCY EVENT /end EVENT
  /begin EVENT "Mainloop.poll" "poll" 0xA DAQ 0xFF 0 0 0 CONSISTENCY EVENT /end EVENT
  /begin EVENT "Mainloop.sample1" "sample1" 0xB DAQ 0xFF 0 0 0 CONSISTENCY EVENT /end EVENT
  /begin EVENT "Mainloop.sample2" "sample2" 0xC DAQ 0xFF 0 0 0 CONSISTENCY EVENT /end EVENT
  /begin EVENT "Mainloop.mainloop" "mainloop" 0xD DAQ 0xFF 0 0 0 CONSISTENCY EVENT /end EVENT
 /end DAQ
/end IF_DATA
/end MODULE
/end PROJECT
