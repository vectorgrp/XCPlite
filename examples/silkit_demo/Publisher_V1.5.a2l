/begin TYPEDEF_STRUCTURE Publisher.GpsData "GPS data struct" 0x18 /begin STRUCTURE_COMPONENT latitude M_latitude 0x0 /end STRUCTURE_COMPONENT /begin STRUCTURE_COMPONENT longitude M_longitude 0x8 /end STRUCTURE_COMPONENT /begin STRUCTURE_COMPONENT signal M_signal 0x10 /end STRUCTURE_COMPONENT /end TYPEDEF_STRUCTURE
/begin TYPEDEF_STRUCTURE Publisher.ParametersT "A2L Typedef for ParametersT" 0x18 /begin STRUCTURE_COMPONENT counter_max C_counter_max 0x0 /end STRUCTURE_COMPONENT /begin STRUCTURE_COMPONENT delay_us C_delay_us 0x4 /end STRUCTURE_COMPONENT /begin STRUCTURE_COMPONENT signal_amplitude C_signal_amplitude 0x8 /end STRUCTURE_COMPONENT /begin STRUCTURE_COMPONENT use_simulated_time C_use_simulated_time 0x10 /end STRUCTURE_COMPONENT /end TYPEDEF_STRUCTURE
/begin INSTANCE Publisher.kParameters "Main parameters" Publisher.ParametersT 0x80010000 /end INSTANCE
/begin MEASUREMENT Publisher._counter "Simulation step counter" UWORD NO_COMPU_METHOD 0 0 0 65535 ECU_ADDRESS 0xC00000 ECU_ADDRESS_EXTENSION 3 READ_WRITE
 /begin IF_DATA XCP
  /begin DAQ_EVENT FIXED_EVENT_LIST EVENT 0x3 /end DAQ_EVENT
 /end IF_DATA
/end MEASUREMENT
/begin MEASUREMENT Publisher._temperature "Temperature in Celsius" FLOAT64_IEEE NO_COMPU_METHOD 0 0 -50 100 ECU_ADDRESS 0xC00000 ECU_ADDRESS_EXTENSION 4 PHYS_UNIT "C" READ_WRITE
 /begin IF_DATA XCP
  /begin DAQ_EVENT FIXED_EVENT_LIST EVENT 0x3 /end DAQ_EVENT
 /end IF_DATA
/end MEASUREMENT
/begin INSTANCE Publisher._gps_data "GPS position data struct" Publisher.GpsData 0xC00000 ECU_ADDRESS_EXTENSION 5 READ_WRITE
 /begin IF_DATA XCP
  /begin DAQ_EVENT FIXED_EVENT_LIST EVENT 0x3 /end DAQ_EVENT
 /end IF_DATA
/end INSTANCE
/* Typedefs */
/begin TYPEDEF_MEASUREMENT M_latitude "GPS latitude in degrees" FLOAT64_IEEE NO_COMPU_METHOD 0 0 -1e+12 1e+12 /end TYPEDEF_MEASUREMENT
/begin TYPEDEF_MEASUREMENT M_longitude "GPS longitude in degrees" FLOAT64_IEEE NO_COMPU_METHOD 0 0 -1e+12 1e+12 /end TYPEDEF_MEASUREMENT
/begin TYPEDEF_MEASUREMENT M_signal "GPS signal quality" FLOAT64_IEEE NO_COMPU_METHOD 0 0 -1e+12 1e+12 /end TYPEDEF_MEASUREMENT
/begin TYPEDEF_CHARACTERISTIC C_counter_max "Maximum counter value" VALUE U16 0 NO_COMPU_METHOD 0 2000 /end TYPEDEF_CHARACTERISTIC
/begin TYPEDEF_CHARACTERISTIC C_delay_us "Mainloop delay time in us" VALUE U32 0 NO_COMPU_METHOD 0 999999 PHYS_UNIT "us" /end TYPEDEF_CHARACTERISTIC
/begin TYPEDEF_CHARACTERISTIC C_signal_amplitude "Amplitude for the simulated GPS signal" VALUE F64 0 NO_COMPU_METHOD 0 10 /end TYPEDEF_CHARACTERISTIC
/begin TYPEDEF_CHARACTERISTIC C_use_simulated_time "Whether to use simulated time for XCP events or real time" VALUE U8 0 NO_COMPU_METHOD 0 1 /end TYPEDEF_CHARACTERISTIC
/* Groups */
/begin GROUP Publisher.kParameters "Calibration Segment" ROOT /begin REF_CHARACTERISTIC /end REF_CHARACTERISTIC /end GROUP
/begin GROUP Publisher.kParameters "Calibration Segment" ROOT /begin REF_CHARACTERISTIC Publisher.kParameters /end REF_CHARACTERISTIC /end GROUP
/begin GROUP Publisher.DoWorkSync "Measurement event group"
 /begin REF_MEASUREMENT Publisher._counter Publisher._temperature Publisher._gps_data /end REF_MEASUREMENT
/end GROUP
/* Conversions */
