/begin TYPEDEF_STRUCTURE Publisher.GpsData "GPS data struct" 0x18 /begin STRUCTURE_COMPONENT latitude M_latitude 0x0 /end STRUCTURE_COMPONENT /begin STRUCTURE_COMPONENT longitude M_longitude 0x8 /end STRUCTURE_COMPONENT /begin STRUCTURE_COMPONENT signal M_signal 0x10 /end STRUCTURE_COMPONENT /end TYPEDEF_STRUCTURE
/begin MEASUREMENT Publisher._counter "Simulation step counter" UWORD NO_COMPU_METHOD 0 0 0 65535 ECU_ADDRESS 0xC00000 ECU_ADDRESS_EXTENSION 3 READ_WRITE
 /begin IF_DATA XCP
  /begin DAQ_EVENT FIXED_EVENT_LIST EVENT 0x3 /end DAQ_EVENT
 /end IF_DATA
/end MEASUREMENT
/begin MEASUREMENT Publisher._temperature "Temperature in Celsius" FLOAT64_IEEE NO_COMPU_METHOD 0 0 -50 100 ECU_ADDRESS 0xC00000 ECU_ADDRESS_EXTENSION 4 PHYS_UNIT "C" READ_WRITE
 /begin IF_DATA XCP
  /begin DAQ_EVENT FIXED_EVENT_LIST EVENT 0x3 /end DAQ_EVENT
 /end IF_DATA
/end MEASUREMENT
/begin INSTANCE Publisher._gps_data "GPS position data struct" Publisher.GpsData 0xC00000 ECU_ADDRESS_EXTENSION 5 READ_WRITE
 /begin IF_DATA XCP
  /begin DAQ_EVENT FIXED_EVENT_LIST EVENT 0x3 /end DAQ_EVENT
 /end IF_DATA
/end INSTANCE
/* Typedefs */
/begin TYPEDEF_MEASUREMENT M_latitude "GPS latitude in degrees" FLOAT64_IEEE NO_COMPU_METHOD 0 0 -1e+12 1e+12 /end TYPEDEF_MEASUREMENT
/begin TYPEDEF_MEASUREMENT M_longitude "GPS longitude in degrees" FLOAT64_IEEE NO_COMPU_METHOD 0 0 -1e+12 1e+12 /end TYPEDEF_MEASUREMENT
/begin TYPEDEF_MEASUREMENT M_signal "GPS signal quality" FLOAT64_IEEE NO_COMPU_METHOD 0 0 -1e+12 1e+12 /end TYPEDEF_MEASUREMENT
/* Groups */
/* Conversions */
