/begin TYPEDEF_STRUCTURE Subscriber.GpsData "GPS data struct" 0x18 /begin STRUCTURE_COMPONENT latitude M_latitude 0x0 /end STRUCTURE_COMPONENT /begin STRUCTURE_COMPONENT longitude M_longitude 0x8 /end STRUCTURE_COMPONENT /begin STRUCTURE_COMPONENT signal M_signal 0x10 /end STRUCTURE_COMPONENT /end TYPEDEF_STRUCTURE
/begin MEASUREMENT Subscriber._counter "Simulation step counter" UWORD NO_COMPU_METHOD 0 0 0 65535 ECU_ADDRESS 0x120 ECU_ADDRESS_EXTENSION 3 READ_WRITE
 /begin IF_DATA XCP
  /begin DAQ_EVENT FIXED_EVENT_LIST EVENT 0x0 /end DAQ_EVENT
 /end IF_DATA
/end MEASUREMENT
/begin INSTANCE Subscriber._gps_data "GPS data struct" Subscriber.GpsData 0x400128 ECU_ADDRESS_EXTENSION 3 READ_WRITE
 /begin IF_DATA XCP
  /begin DAQ_EVENT FIXED_EVENT_LIST EVENT 0x1 /end DAQ_EVENT
 /end IF_DATA
/end INSTANCE
/begin MEASUREMENT Subscriber._temperature "Received temperature in Celsius" FLOAT64_IEEE NO_COMPU_METHOD 0 0 -1e+12 1e+12 ECU_ADDRESS 0x800140 ECU_ADDRESS_EXTENSION 3 READ_WRITE
 /begin IF_DATA XCP
  /begin DAQ_EVENT FIXED_EVENT_LIST EVENT 0x2 /end DAQ_EVENT
 /end IF_DATA
/end MEASUREMENT
/* Typedefs */
/begin TYPEDEF_MEASUREMENT M_latitude "GPS latitude in degrees" FLOAT64_IEEE NO_COMPU_METHOD 0 0 -1e+12 1e+12 /end TYPEDEF_MEASUREMENT
/begin TYPEDEF_MEASUREMENT M_longitude "GPS longitude in degrees" FLOAT64_IEEE NO_COMPU_METHOD 0 0 -1e+12 1e+12 /end TYPEDEF_MEASUREMENT
/begin TYPEDEF_MEASUREMENT M_signal "GPS signal quality" FLOAT64_IEEE NO_COMPU_METHOD 0 0 -1e+12 1e+12 /end TYPEDEF_MEASUREMENT
/* Groups */
/begin GROUP Subscriber.DoWorkSync "Measurement event group" /begin REF_MEASUREMENT Subscriber._counter /end REF_MEASUREMENT /end GROUP
/begin GROUP Subscriber.Gps "Measurement event group" /begin REF_MEASUREMENT Subscriber._gps_data /end REF_MEASUREMENT /end GROUP
/begin GROUP Subscriber.Temp "Measurement event group" /begin REF_MEASUREMENT Subscriber._temperature /end REF_MEASUREMENT /end GROUP
/* Conversions */
