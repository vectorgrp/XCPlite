ASAP2_VERSION 1 71
/begin PROJECT cpp_demo ""
/begin HEADER "" VERSION "1.0" PROJECT_NO VECTOR /end HEADER
/begin MODULE cpp_demo ""
/include "XCP_104.aml"
/begin MOD_COMMON "" BYTE_ORDER MSB_LAST ALIGNMENT_BYTE 1 ALIGNMENT_WORD 1 ALIGNMENT_LONG 1 ALIGNMENT_FLOAT16_IEEE 1 ALIGNMENT_FLOAT32_IEEE 1 ALIGNMENT_FLOAT64_IEEE 1 ALIGNMENT_INT64 1 /end MOD_COMMON
/begin TYPEDEF_STRUCTURE ParametersT "A2L Typedef for ParametersT" 0x8 /begin STRUCTURE_COMPONENT counter_max C_counter_max 0x0 /end STRUCTURE_COMPONENT /begin STRUCTURE_COMPONENT delay_us C_delay_us 0x4 /end STRUCTURE_COMPONENT /end TYPEDEF_STRUCTURE
/* Segment relative addressing mode: calseg=Parameters */
/begin INSTANCE Parameters "Main parameters" ParametersT 0x80010000 /end INSTANCE
/* Absolute addressing mode: default_event=mainloop (0), addr_ext=1 */
/begin MEASUREMENT temperature "Motor temperature in °C" UBYTE conv.temperature 0 0 -50 200 ECU_ADDRESS 0x28000 ECU_ADDRESS_EXTENSION 1 READ_WRITE
 /begin IF_DATA XCP
  /begin DAQ_EVENT VARIABLE /begin DEFAULT_EVENT_LIST EVENT 0x0 /end DEFAULT_EVENT_LIST /end DAQ_EVENT
 /end IF_DATA
/end MEASUREMENT
/begin MEASUREMENT speed "Speed in km/h" FLOAT64_IEEE NO_COMPU_METHOD 0 0 0 250 ECU_ADDRESS 0x280B0 ECU_ADDRESS_EXTENSION 1 PHYS_UNIT "km/h" READ_WRITE
 /begin IF_DATA XCP
  /begin DAQ_EVENT VARIABLE /begin DEFAULT_EVENT_LIST EVENT 0x0 /end DEFAULT_EVENT_LIST /end DAQ_EVENT
 /end IF_DATA
/end MEASUREMENT
/* Stack frame relative addressing mode: event=mainloop (0), addr_ext=3 */
/begin MEASUREMENT loop_counter "Loop counter, local measurement variable on stack" UWORD NO_COMPU_METHOD 0 0 0 65535 ECU_ADDRESS 0xFFFFFFCE ECU_ADDRESS_EXTENSION 3
 /begin IF_DATA XCP
  /begin DAQ_EVENT FIXED_EVENT_LIST EVENT 0x0 /end DAQ_EVENT
 /end IF_DATA
/end MEASUREMENT
/begin MEASUREMENT sum "Sum of SigGen1 and SigGen2 value" FLOAT64_IEEE NO_COMPU_METHOD 0 0 -1e+12 1e+12 ECU_ADDRESS 0xFFFFFFC0 ECU_ADDRESS_EXTENSION 3
 /begin IF_DATA XCP
  /begin DAQ_EVENT FIXED_EVENT_LIST EVENT 0x0 /end DAQ_EVENT
 /end IF_DATA
/end MEASUREMENT
/begin TYPEDEF_STRUCTURE SignalParametersT "A2L typedef for SignalParametersT" 0x28 /begin STRUCTURE_COMPONENT signal_type C_signal_type 0x24 /end STRUCTURE_COMPONENT /begin STRUCTURE_COMPONENT ampl C_ampl 0x0 /end STRUCTURE_COMPONENT /begin STRUCTURE_COMPONENT phase C_phase 0x8 /end STRUCTURE_COMPONENT /begin STRUCTURE_COMPONENT offset C_offset 0x10 /end STRUCTURE_COMPONENT /begin STRUCTURE_COMPONENT period C_period 0x18 /end STRUCTURE_COMPONENT /begin STRUCTURE_COMPONENT delay_us C_delay_us 0x20 /end STRUCTURE_COMPONENT /end TYPEDEF_STRUCTURE
/* Segment relative addressing mode: calseg=SigGen1 */
/begin INSTANCE SigGen1 "Signal parameters for the signal generator" SignalParametersT 0x80020000 /end INSTANCE
/begin TYPEDEF_STRUCTURE SignalParametersT "A2L typedef for SignalParametersT" 0x28 /begin STRUCTURE_COMPONENT signal_type C_signal_type 0x24 /end STRUCTURE_COMPONENT /begin STRUCTURE_COMPONENT ampl C_ampl 0x0 /end STRUCTURE_COMPONENT /begin STRUCTURE_COMPONENT phase C_phase 0x8 /end STRUCTURE_COMPONENT /begin STRUCTURE_COMPONENT offset C_offset 0x10 /end STRUCTURE_COMPONENT /begin STRUCTURE_COMPONENT period C_period 0x18 /end STRUCTURE_COMPONENT /begin STRUCTURE_COMPONENT delay_us C_delay_us 0x20 /end STRUCTURE_COMPONENT /end TYPEDEF_STRUCTURE
/* Segment relative addressing mode: calseg=SigGen2 */
/begin INSTANCE SigGen2 "Signal parameters for the signal generator" SignalParametersT 0x80030000 /end INSTANCE
/* Relative addressing mode: event=SigGen1 (1), addr_ext=2 */
/begin MEASUREMENT SigGen1.value_ "Signal generator output" FLOAT64_IEEE NO_COMPU_METHOD 0 0 -100 100 ECU_ADDRESS 0x10018 ECU_ADDRESS_EXTENSION 2 READ_WRITE
 /begin IF_DATA XCP
  /begin DAQ_EVENT FIXED_EVENT_LIST EVENT 0x1 /end DAQ_EVENT
 /end IF_DATA
/end MEASUREMENT
/* Stack frame relative addressing mode: event=SigGen1 (1), addr_ext=3 */
/begin MEASUREMENT SigGen1.time "Signal generator time" FLOAT64_IEEE NO_COMPU_METHOD 0 0 0 3600 ECU_ADDRESS 0xFFFFFFE0 ECU_ADDRESS_EXTENSION 3 PHYS_UNIT "s"
 /begin IF_DATA XCP
  /begin DAQ_EVENT FIXED_EVENT_LIST EVENT 0x1 /end DAQ_EVENT
 /end IF_DATA
/end MEASUREMENT
/* Relative addressing mode: event=SigGen2 (2), addr_ext=2 */
/begin MEASUREMENT SigGen2.value_ "Signal generator output" FLOAT64_IEEE NO_COMPU_METHOD 0 0 -100 100 ECU_ADDRESS 0x20018 ECU_ADDRESS_EXTENSION 2 READ_WRITE
 /begin IF_DATA XCP
  /begin DAQ_EVENT FIXED_EVENT_LIST EVENT 0x2 /end DAQ_EVENT
 /end IF_DATA
/end MEASUREMENT
/* Stack frame relative addressing mode: event=SigGen2 (2), addr_ext=3 */
/begin MEASUREMENT SigGen2.time "Signal generator time" FLOAT64_IEEE NO_COMPU_METHOD 0 0 0 3600 ECU_ADDRESS 0xFFFFFFE0 ECU_ADDRESS_EXTENSION 3 PHYS_UNIT "s"
 /begin IF_DATA XCP
  /begin DAQ_EVENT FIXED_EVENT_LIST EVENT 0x2 /end DAQ_EVENT
 /end IF_DATA
/end MEASUREMENT
/* Typedefs */
/begin RECORD_LAYOUT U8 FNC_VALUES 1 UBYTE ROW_DIR DIRECT /end RECORD_LAYOUT
/begin RECORD_LAYOUT A_U8 AXIS_PTS_X 1 UBYTE INDEX_INCR DIRECT /end RECORD_LAYOUT
/begin TYPEDEF_MEASUREMENT M_U8 "" UBYTE NO_COMPU_METHOD 0 0 0 255 /end TYPEDEF_MEASUREMENT
/begin TYPEDEF_CHARACTERISTIC C_U8 "" VALUE U8 0 NO_COMPU_METHOD 0 255 /end TYPEDEF_CHARACTERISTIC
/begin RECORD_LAYOUT U16 FNC_VALUES 1 UWORD ROW_DIR DIRECT /end RECORD_LAYOUT
/begin RECORD_LAYOUT A_U16 AXIS_PTS_X 1 UWORD INDEX_INCR DIRECT /end RECORD_LAYOUT
/begin TYPEDEF_MEASUREMENT M_U16 "" UWORD NO_COMPU_METHOD 0 0 0 65535 /end TYPEDEF_MEASUREMENT
/begin TYPEDEF_CHARACTERISTIC C_U16 "" VALUE U16 0 NO_COMPU_METHOD 0 65535 /end TYPEDEF_CHARACTERISTIC
/begin RECORD_LAYOUT U32 FNC_VALUES 1 ULONG ROW_DIR DIRECT /end RECORD_LAYOUT
/begin RECORD_LAYOUT A_U32 AXIS_PTS_X 1 ULONG INDEX_INCR DIRECT /end RECORD_LAYOUT
/begin TYPEDEF_MEASUREMENT M_U32 "" ULONG NO_COMPU_METHOD 0 0 0 4.29497e+09 /end TYPEDEF_MEASUREMENT
/begin TYPEDEF_CHARACTERISTIC C_U32 "" VALUE U32 0 NO_COMPU_METHOD 0 4.29497e+09 /end TYPEDEF_CHARACTERISTIC
/begin RECORD_LAYOUT U64 FNC_VALUES 1 A_UINT64 ROW_DIR DIRECT /end RECORD_LAYOUT
/begin RECORD_LAYOUT A_U64 AXIS_PTS_X 1 A_UINT64 INDEX_INCR DIRECT /end RECORD_LAYOUT
/begin TYPEDEF_MEASUREMENT M_U64 "" A_UINT64 NO_COMPU_METHOD 0 0 0 1e+12 /end TYPEDEF_MEASUREMENT
/begin TYPEDEF_CHARACTERISTIC C_U64 "" VALUE U64 0 NO_COMPU_METHOD 0 1e+12 /end TYPEDEF_CHARACTERISTIC
/begin RECORD_LAYOUT I8 FNC_VALUES 1 SBYTE ROW_DIR DIRECT /end RECORD_LAYOUT
/begin RECORD_LAYOUT A_I8 AXIS_PTS_X 1 SBYTE INDEX_INCR DIRECT /end RECORD_LAYOUT
/begin TYPEDEF_MEASUREMENT M_I8 "" SBYTE NO_COMPU_METHOD 0 0 -128 127 /end TYPEDEF_MEASUREMENT
/begin TYPEDEF_CHARACTERISTIC C_I8 "" VALUE I8 0 NO_COMPU_METHOD -128 127 /end TYPEDEF_CHARACTERISTIC
/begin RECORD_LAYOUT I16 FNC_VALUES 1 SWORD ROW_DIR DIRECT /end RECORD_LAYOUT
/begin RECORD_LAYOUT A_I16 AXIS_PTS_X 1 SWORD INDEX_INCR DIRECT /end RECORD_LAYOUT
/begin TYPEDEF_MEASUREMENT M_I16 "" SWORD NO_COMPU_METHOD 0 0 -32768 32767 /end TYPEDEF_MEASUREMENT
/begin TYPEDEF_CHARACTERISTIC C_I16 "" VALUE I16 0 NO_COMPU_METHOD -32768 32767 /end TYPEDEF_CHARACTERISTIC
/begin RECORD_LAYOUT I32 FNC_VALUES 1 SLONG ROW_DIR DIRECT /end RECORD_LAYOUT
/begin RECORD_LAYOUT A_I32 AXIS_PTS_X 1 SLONG INDEX_INCR DIRECT /end RECORD_LAYOUT
/begin TYPEDEF_MEASUREMENT M_I32 "" SLONG NO_COMPU_METHOD 0 0 -2.14748e+09 2.14748e+09 /end TYPEDEF_MEASUREMENT
/begin TYPEDEF_CHARACTERISTIC C_I32 "" VALUE I32 0 NO_COMPU_METHOD -2.14748e+09 2.14748e+09 /end TYPEDEF_CHARACTERISTIC
/begin RECORD_LAYOUT I64 FNC_VALUES 1 A_INT64 ROW_DIR DIRECT /end RECORD_LAYOUT
/begin RECORD_LAYOUT A_I64 AXIS_PTS_X 1 A_INT64 INDEX_INCR DIRECT /end RECORD_LAYOUT
/begin TYPEDEF_MEASUREMENT M_I64 "" A_INT64 NO_COMPU_METHOD 0 0 -1e+12 1e+12 /end TYPEDEF_MEASUREMENT
/begin TYPEDEF_CHARACTERISTIC C_I64 "" VALUE I64 0 NO_COMPU_METHOD -1e+12 1e+12 /end TYPEDEF_CHARACTERISTIC
/begin RECORD_LAYOUT F32 FNC_VALUES 1 FLOAT32_IEEE ROW_DIR DIRECT /end RECORD_LAYOUT
/begin RECORD_LAYOUT A_F32 AXIS_PTS_X 1 FLOAT32_IEEE INDEX_INCR DIRECT /end RECORD_LAYOUT
/begin TYPEDEF_MEASUREMENT M_F32 "" FLOAT32_IEEE NO_COMPU_METHOD 0 0 -1e+12 1e+12 /end TYPEDEF_MEASUREMENT
/begin TYPEDEF_CHARACTERISTIC C_F32 "" VALUE F32 0 NO_COMPU_METHOD -1e+12 1e+12 /end TYPEDEF_CHARACTERISTIC
/begin RECORD_LAYOUT F64 FNC_VALUES 1 FLOAT64_IEEE ROW_DIR DIRECT /end RECORD_LAYOUT
/begin RECORD_LAYOUT A_F64 AXIS_PTS_X 1 FLOAT64_IEEE INDEX_INCR DIRECT /end RECORD_LAYOUT
/begin TYPEDEF_MEASUREMENT M_F64 "" FLOAT64_IEEE NO_COMPU_METHOD 0 0 -1e+12 1e+12 /end TYPEDEF_MEASUREMENT
/begin TYPEDEF_CHARACTERISTIC C_F64 "" VALUE F64 0 NO_COMPU_METHOD -1e+12 1e+12 /end TYPEDEF_CHARACTERISTIC
/begin TYPEDEF_CHARACTERISTIC C_counter_max "Maximum counter value" VALUE U16 0 NO_COMPU_METHOD 0 2000 /end TYPEDEF_CHARACTERISTIC
/begin TYPEDEF_CHARACTERISTIC C_delay_us "Mainloop delay time in us" VALUE U32 0 NO_COMPU_METHOD 0 999999 PHYS_UNIT "us" /end TYPEDEF_CHARACTERISTIC
/begin TYPEDEF_CHARACTERISTIC C_signal_type "Signal type" VALUE U8 0 conv.signal_type_enum 0 4 /end TYPEDEF_CHARACTERISTIC
/begin TYPEDEF_CHARACTERISTIC C_ampl "Amplitude" VALUE F64 0 NO_COMPU_METHOD 0 100 PHYS_UNIT "Volt" /end TYPEDEF_CHARACTERISTIC
/begin TYPEDEF_CHARACTERISTIC C_phase "Phase" VALUE F64 0 NO_COMPU_METHOD 0 6.28319 /end TYPEDEF_CHARACTERISTIC
/begin TYPEDEF_CHARACTERISTIC C_offset "Offset" VALUE F64 0 NO_COMPU_METHOD -100 100 PHYS_UNIT "Volt" /end TYPEDEF_CHARACTERISTIC
/begin TYPEDEF_CHARACTERISTIC C_period "Period" VALUE F64 0 NO_COMPU_METHOD 0.01 10 PHYS_UNIT "s" /end TYPEDEF_CHARACTERISTIC
/begin TYPEDEF_CHARACTERISTIC C_delay_us "Delay time in us" VALUE U32 0 NO_COMPU_METHOD 0 100000 PHYS_UNIT "us" /end TYPEDEF_CHARACTERISTIC
/begin TYPEDEF_CHARACTERISTIC C_signal_type "Signal type" VALUE U8 0 conv.signal_type_enum 0 4 /end TYPEDEF_CHARACTERISTIC
/begin TYPEDEF_CHARACTERISTIC C_ampl "Amplitude" VALUE F64 0 NO_COMPU_METHOD 0 100 PHYS_UNIT "Volt" /end TYPEDEF_CHARACTERISTIC
/begin TYPEDEF_CHARACTERISTIC C_phase "Phase" VALUE F64 0 NO_COMPU_METHOD 0 6.28319 /end TYPEDEF_CHARACTERISTIC
/begin TYPEDEF_CHARACTERISTIC C_offset "Offset" VALUE F64 0 NO_COMPU_METHOD -100 100 PHYS_UNIT "Volt" /end TYPEDEF_CHARACTERISTIC
/begin TYPEDEF_CHARACTERISTIC C_period "Period" VALUE F64 0 NO_COMPU_METHOD 0.01 10 PHYS_UNIT "s" /end TYPEDEF_CHARACTERISTIC
/begin TYPEDEF_CHARACTERISTIC C_delay_us "Delay time in us" VALUE U32 0 NO_COMPU_METHOD 0 100000 PHYS_UNIT "us" /end TYPEDEF_CHARACTERISTIC
/* Groups */
/begin GROUP Parameters "Calibration Segment" /begin REF_CHARACTERISTIC /end REF_CHARACTERISTIC /end GROUP
/begin GROUP mainloop "Measurement event group" /begin REF_MEASUREMENT temperature speed loop_counter sum /end REF_MEASUREMENT /end GROUP
/begin GROUP SigGen1 "Calibration Segment" /begin REF_CHARACTERISTIC /end REF_CHARACTERISTIC /end GROUP
/begin GROUP SigGen2 "Calibration Segment" /begin REF_CHARACTERISTIC /end REF_CHARACTERISTIC /end GROUP
/begin GROUP SigGen1 "Measurement event group" /begin REF_MEASUREMENT SigGen1.value_ SigGen1.time /end REF_MEASUREMENT /end GROUP
/begin GROUP SigGen2 "Measurement event group" /begin REF_MEASUREMENT /end REF_MEASUREMENT /end GROUP
/begin GROUP SigGen2 "Measurement event group" /begin REF_MEASUREMENT SigGen2.time /end REF_MEASUREMENT /end GROUP
/begin GROUP Events "Events" ROOT /begin SUB_GROUP mainloop SigGen1 SigGen2 /end SUB_GROUP /end GROUP
/* Conversions */
/begin COMPU_METHOD conv.bool "" TAB_VERB "%.0" "" COMPU_TAB_REF conv.bool.table /end COMPU_METHOD
/begin COMPU_VTAB conv.bool.table "" TAB_VERB 2 0 "false" 1 "true" /end COMPU_VTAB
/begin COMPU_METHOD conv.temperature "Temperature in °C from unsigned byte" LINEAR "%6.3" "°C" COEFFS_LINEAR 1 -50 /end COMPU_METHOD
/begin COMPU_METHOD conv.signal_type_enum "" TAB_VERB "%.0 " "" COMPU_TAB_REF conv.signal_type_enum.table /end COMPU_METHOD
/begin COMPU_VTAB conv.signal_type_enum.table "" TAB_VERB 5 0 "SINE" 1 "SQUARE" 2 "TRIANGLE" 3 "SAWTOOTH" 4 "ARBITRARY" /end COMPU_VTAB
/begin COMPU_METHOD conv.signal_type_enum "" TAB_VERB "%.0 " "" COMPU_TAB_REF conv.signal_type_enum.table /end COMPU_METHOD
/begin COMPU_VTAB conv.signal_type_enum.table "" TAB_VERB 5 0 "SINE" 1 "SQUARE" 2 "TRIANGLE" 3 "SAWTOOTH" 4 "ARBITRARY" /end COMPU_VTAB
/begin COMPU_METHOD conv.events "" TAB_VERB "%.0 " "" COMPU_TAB_REF conv.events.table /end COMPU_METHOD
/begin COMPU_VTAB conv.events.table "" TAB_VERB 3 0 "mainloop" 1 "SigGen1" 2 "SigGen2" /end COMPU_VTAB
/begin MOD_PAR "" EPK "_Aug_12_202513_39_09" ADDR_EPK 0x80000000
 /begin MEMORY_SEGMENT epk "" DATA FLASH INTERN 0x80000000 20 -1 -1 -1 -1 -1
  /begin IF_DATA XCP
   /begin SEGMENT 0 2 0 0 0 /begin CHECKSUM XCP_CRC_16_CITT MAX_BLOCK_SIZE 0xFFFF EXTERNAL_FUNCTION "" /end CHECKSUM
    /begin PAGE 0 ECU_ACCESS_DONT_CARE XCP_READ_ACCESS_DONT_CARE XCP_WRITE_ACCESS_DONT_CARE /end PAGE
    /begin PAGE 1 ECU_ACCESS_DONT_CARE XCP_READ_ACCESS_DONT_CARE XCP_WRITE_ACCESS_NOT_ALLOWED /end PAGE
   /end SEGMENT
  /end IF_DATA
 /end MEMORY_SEGMENT
 /begin MEMORY_SEGMENT Parameters "" DATA FLASH INTERN 0x80010000 0x8 -1 -1 -1 -1 -1
  /begin IF_DATA XCP
   /begin SEGMENT 1 2 0 0 0 /begin CHECKSUM XCP_CRC_16_CITT MAX_BLOCK_SIZE 0xFFFF EXTERNAL_FUNCTION "" /end CHECKSUM
    /begin PAGE 0 ECU_ACCESS_DONT_CARE XCP_READ_ACCESS_DONT_CARE XCP_WRITE_ACCESS_DONT_CARE /end PAGE
    /begin PAGE 1 ECU_ACCESS_DONT_CARE XCP_READ_ACCESS_DONT_CARE XCP_WRITE_ACCESS_NOT_ALLOWED /end PAGE
   /end SEGMENT
  /end IF_DATA
 /end MEMORY_SEGMENT
 /begin MEMORY_SEGMENT SigGen1 "" DATA FLASH INTERN 0x80020000 0x28 -1 -1 -1 -1 -1
  /begin IF_DATA XCP
   /begin SEGMENT 2 2 0 0 0 /begin CHECKSUM XCP_CRC_16_CITT MAX_BLOCK_SIZE 0xFFFF EXTERNAL_FUNCTION "" /end CHECKSUM
    /begin PAGE 0 ECU_ACCESS_DONT_CARE XCP_READ_ACCESS_DONT_CARE XCP_WRITE_ACCESS_DONT_CARE /end PAGE
    /begin PAGE 1 ECU_ACCESS_DONT_CARE XCP_READ_ACCESS_DONT_CARE XCP_WRITE_ACCESS_NOT_ALLOWED /end PAGE
   /end SEGMENT
  /end IF_DATA
 /end MEMORY_SEGMENT
 /begin MEMORY_SEGMENT SigGen2 "" DATA FLASH INTERN 0x80030000 0x28 -1 -1 -1 -1 -1
  /begin IF_DATA XCP
   /begin SEGMENT 3 2 0 0 0 /begin CHECKSUM XCP_CRC_16_CITT MAX_BLOCK_SIZE 0xFFFF EXTERNAL_FUNCTION "" /end CHECKSUM
    /begin PAGE 0 ECU_ACCESS_DONT_CARE XCP_READ_ACCESS_DONT_CARE XCP_WRITE_ACCESS_DONT_CARE /end PAGE
    /begin PAGE 1 ECU_ACCESS_DONT_CARE XCP_READ_ACCESS_DONT_CARE XCP_WRITE_ACCESS_NOT_ALLOWED /end PAGE
   /end SEGMENT
  /end IF_DATA
 /end MEMORY_SEGMENT
/end MOD_PAR
/begin IF_DATA XCP
 /begin PROTOCOL_LAYER 0x104 1000 2000 0 0 0 0 0 248 1024 BYTE_ORDER_MSB_LAST ADDRESS_GRANULARITY_BYTE OPTIONAL_CMD GET_COMM_MODE_INFO OPTIONAL_CMD GET_ID OPTIONAL_CMD SET_REQUEST OPTIONAL_CMD SET_MTA OPTIONAL_CMD UPLOAD OPTIONAL_CMD SHORT_UPLOAD OPTIONAL_CMD DOWNLOAD OPTIONAL_CMD SHORT_DOWNLOAD OPTIONAL_CMD GET_CAL_PAGE OPTIONAL_CMD SET_CAL_PAGE OPTIONAL_CMD COPY_CAL_PAGE OPTIONAL_CMD GET_PAG_PROCESSOR_INFO OPTIONAL_CMD GET_SEGMENT_MODE OPTIONAL_CMD SET_SEGMENT_MODE OPTIONAL_CMD BUILD_CHECKSUM OPTIONAL_CMD USER_CMD OPTIONAL_CMD GET_DAQ_RESOLUTION_INFO OPTIONAL_CMD GET_DAQ_PROCESSOR_INFO OPTIONAL_CMD FREE_DAQ OPTIONAL_CMD ALLOC_DAQ OPTIONAL_CMD ALLOC_ODT OPTIONAL_CMD ALLOC_ODT_ENTRY OPTIONAL_CMD SET_DAQ_PTR OPTIONAL_CMD WRITE_DAQ OPTIONAL_CMD GET_DAQ_LIST_MODE OPTIONAL_CMD SET_DAQ_LIST_MODE OPTIONAL_CMD START_STOP_SYNCH OPTIONAL_CMD START_STOP_DAQ_LIST OPTIONAL_CMD GET_DAQ_CLOCK OPTIONAL_CMD WRITE_DAQ_MULTIPLE OPTIONAL_CMD TIME_CORRELATION_PROPERTIES OPTIONAL_LEVEL1_CMD GET_VERSION /end PROTOCOL_LAYER
 /begin DAQ DYNAMIC 0 3 0 OPTIMISATION_TYPE_DEFAULT ADDRESS_EXTENSION_FREE IDENTIFICATION_FIELD_TYPE_RELATIVE_BYTE GRANULARITY_ODT_ENTRY_SIZE_DAQ_BYTE 0xF8 OVERLOAD_INDICATION_PID /begin TIMESTAMP_SUPPORTED 0x1 SIZE_DWORD UNIT_1US TIMESTAMP_FIXED /end TIMESTAMP_SUPPORTED /begin EVENT "mainloop" "mainloop" 0x0 DAQ 0xFF 0 0 0 CONSISTENCY EVENT /end EVENT /begin EVENT "SigGen1" "SigGen1" 0x1 DAQ 0xFF 0 0 0 CONSISTENCY EVENT /end EVENT /begin EVENT "SigGen2" "SigGen2" 0x2 DAQ 0xFF 0 0 0 CONSISTENCY EVENT /end EVENT /end DAQ
 /begin XCP_ON_UDP_IP 0x104 5555 ADDRESS "192.168.0.128" /end XCP_ON_UDP_IP
/end IF_DATA
/end MODULE
/end PROJECT
