ASAP2_VERSION 1 71
/begin PROJECT point_cloud_demo ""
/begin HEADER "" VERSION "1.0" PROJECT_NO XCPLITE__CASDD /end HEADER
/begin MODULE point_cloud_demo ""
/include "XCP_104.aml"
/begin MOD_COMMON "" BYTE_ORDER MSB_LAST ALIGNMENT_BYTE 1 ALIGNMENT_WORD 1 ALIGNMENT_LONG 1 ALIGNMENT_FLOAT16_IEEE 1 ALIGNMENT_FLOAT32_IEEE 1 ALIGNMENT_FLOAT64_IEEE 1 ALIGNMENT_INT64 1 /end MOD_COMMON
/begin TYPEDEF_STRUCTURE ParametersT "Typedef for ParametersT" 0x28 /begin STRUCTURE_COMPONENT point_count C_point_count 0x0 /end STRUCTURE_COMPONENT /begin STRUCTURE_COMPONENT boundary C_boundary 0x8 /end STRUCTURE_COMPONENT /begin STRUCTURE_COMPONENT max_radius C_max_radius 0x10 /end STRUCTURE_COMPONENT /begin STRUCTURE_COMPONENT max_velocity C_max_velocity 0x18 /end STRUCTURE_COMPONENT /begin STRUCTURE_COMPONENT delay_us C_delay_us 0x20 /end STRUCTURE_COMPONENT /end TYPEDEF_STRUCTURE
/* Segment relative addressing mode: calseg=Parameters */
/begin INSTANCE Parameters "Random number generator parameters" ParametersT 0x80010000 /end INSTANCE
/begin TYPEDEF_STRUCTURE Point "Typedef for Point" 0x1C /begin STRUCTURE_COMPONENT x M_x 0x0 /end STRUCTURE_COMPONENT /begin STRUCTURE_COMPONENT y M_y 0x4 /end STRUCTURE_COMPONENT /begin STRUCTURE_COMPONENT z M_z 0x8 /end STRUCTURE_COMPONENT /begin STRUCTURE_COMPONENT r M_r 0xC /end STRUCTURE_COMPONENT /begin STRUCTURE_COMPONENT v_x M_v_x 0x10 /end STRUCTURE_COMPONENT /begin STRUCTURE_COMPONENT v_y M_v_y 0x14 /end STRUCTURE_COMPONENT /begin STRUCTURE_COMPONENT v_z M_v_z 0x18 /end STRUCTURE_COMPONENT /end TYPEDEF_STRUCTURE
/begin TYPEDEF_STRUCTURE PointCloud "Typedef for PointCloud" 0x718 /begin STRUCTURE_COMPONENT count_ M_count_ 0x0 /end STRUCTURE_COMPONENT /begin STRUCTURE_COMPONENT points_ Point 0x4 MATRIX_DIM 64 /end STRUCTURE_COMPONENT /end TYPEDEF_STRUCTURE
/* Relative addressing mode: event=step_1 (1), addr_ext=3 */
/begin MEASUREMENT count_ "Current point count" UWORD NO_COMPU_METHOD 0 0 0 65535 ECU_ADDRESS 0x10000 ECU_ADDRESS_EXTENSION 3 READ_WRITE
 /begin IF_DATA XCP
  /begin DAQ_EVENT FIXED_EVENT_LIST EVENT 0x1 /end DAQ_EVENT
 /end IF_DATA
/end MEASUREMENT
/* Relative addressing mode: event=step_1 (1), addr_ext=4 */
/begin INSTANCE points_ "Points in the cloud" Point 0x10000 ECU_ADDRESS_EXTENSION 4 MATRIX_DIM 64 READ_WRITE
 /begin IF_DATA XCP
  /begin DAQ_EVENT FIXED_EVENT_LIST EVENT 0x1 /end DAQ_EVENT
 /end IF_DATA
/end INSTANCE
/* Relative addressing mode: event=mainloop_1 (2), addr_ext=3 */
/begin MEASUREMENT global_counter "Global counter variable" UWORD NO_COMPU_METHOD 0 0 0 65535 ECU_ADDRESS 0x20000 ECU_ADDRESS_EXTENSION 3 READ_WRITE
 /begin IF_DATA XCP
  /begin DAQ_EVENT FIXED_EVENT_LIST EVENT 0x2 /end DAQ_EVENT
 /end IF_DATA
/end MEASUREMENT
/* Typedefs */
/begin RECORD_LAYOUT U8 FNC_VALUES 1 UBYTE ROW_DIR DIRECT /end RECORD_LAYOUT
/begin RECORD_LAYOUT A_U8 AXIS_PTS_X 1 UBYTE INDEX_INCR DIRECT /end RECORD_LAYOUT
/begin TYPEDEF_MEASUREMENT M_U8 "" UBYTE NO_COMPU_METHOD 0 0 0 255 /end TYPEDEF_MEASUREMENT
/begin TYPEDEF_CHARACTERISTIC C_U8 "" VALUE U8 0 NO_COMPU_METHOD 0 255 /end TYPEDEF_CHARACTERISTIC
/begin RECORD_LAYOUT U16 FNC_VALUES 1 UWORD ROW_DIR DIRECT /end RECORD_LAYOUT
/begin RECORD_LAYOUT A_U16 AXIS_PTS_X 1 UWORD INDEX_INCR DIRECT /end RECORD_LAYOUT
/begin TYPEDEF_MEASUREMENT M_U16 "" UWORD NO_COMPU_METHOD 0 0 0 65535 /end TYPEDEF_MEASUREMENT
/begin TYPEDEF_CHARACTERISTIC C_U16 "" VALUE U16 0 NO_COMPU_METHOD 0 65535 /end TYPEDEF_CHARACTERISTIC
/begin RECORD_LAYOUT U32 FNC_VALUES 1 ULONG ROW_DIR DIRECT /end RECORD_LAYOUT
/begin RECORD_LAYOUT A_U32 AXIS_PTS_X 1 ULONG INDEX_INCR DIRECT /end RECORD_LAYOUT
/begin TYPEDEF_MEASUREMENT M_U32 "" ULONG NO_COMPU_METHOD 0 0 0 4294967295 /end TYPEDEF_MEASUREMENT
/begin TYPEDEF_CHARACTERISTIC C_U32 "" VALUE U32 0 NO_COMPU_METHOD 0 4.29497e+09 /end TYPEDEF_CHARACTERISTIC
/begin RECORD_LAYOUT U64 FNC_VALUES 1 A_UINT64 ROW_DIR DIRECT /end RECORD_LAYOUT
/begin RECORD_LAYOUT A_U64 AXIS_PTS_X 1 A_UINT64 INDEX_INCR DIRECT /end RECORD_LAYOUT
/begin TYPEDEF_MEASUREMENT M_U64 "" A_UINT64 NO_COMPU_METHOD 0 0 0 1000000000000 /end TYPEDEF_MEASUREMENT
/begin TYPEDEF_CHARACTERISTIC C_U64 "" VALUE U64 0 NO_COMPU_METHOD 0 1e+12 /end TYPEDEF_CHARACTERISTIC
/begin RECORD_LAYOUT I8 FNC_VALUES 1 SBYTE ROW_DIR DIRECT /end RECORD_LAYOUT
/begin RECORD_LAYOUT A_I8 AXIS_PTS_X 1 SBYTE INDEX_INCR DIRECT /end RECORD_LAYOUT
/begin TYPEDEF_MEASUREMENT M_I8 "" SBYTE NO_COMPU_METHOD 0 0 -128 127 /end TYPEDEF_MEASUREMENT
/begin TYPEDEF_CHARACTERISTIC C_I8 "" VALUE I8 0 NO_COMPU_METHOD -128 127 /end TYPEDEF_CHARACTERISTIC
/begin RECORD_LAYOUT I16 FNC_VALUES 1 SWORD ROW_DIR DIRECT /end RECORD_LAYOUT
/begin RECORD_LAYOUT A_I16 AXIS_PTS_X 1 SWORD INDEX_INCR DIRECT /end RECORD_LAYOUT
/begin TYPEDEF_MEASUREMENT M_I16 "" SWORD NO_COMPU_METHOD 0 0 -32768 32767 /end TYPEDEF_MEASUREMENT
/begin TYPEDEF_CHARACTERISTIC C_I16 "" VALUE I16 0 NO_COMPU_METHOD -32768 32767 /end TYPEDEF_CHARACTERISTIC
/begin RECORD_LAYOUT I32 FNC_VALUES 1 SLONG ROW_DIR DIRECT /end RECORD_LAYOUT
/begin RECORD_LAYOUT A_I32 AXIS_PTS_X 1 SLONG INDEX_INCR DIRECT /end RECORD_LAYOUT
/begin TYPEDEF_MEASUREMENT M_I32 "" SLONG NO_COMPU_METHOD 0 0 -2147483648 2147483647 /end TYPEDEF_MEASUREMENT
/begin TYPEDEF_CHARACTERISTIC C_I32 "" VALUE I32 0 NO_COMPU_METHOD -2.14748e+09 2.14748e+09 /end TYPEDEF_CHARACTERISTIC
/begin RECORD_LAYOUT I64 FNC_VALUES 1 A_INT64 ROW_DIR DIRECT /end RECORD_LAYOUT
/begin RECORD_LAYOUT A_I64 AXIS_PTS_X 1 A_INT64 INDEX_INCR DIRECT /end RECORD_LAYOUT
/begin TYPEDEF_MEASUREMENT M_I64 "" A_INT64 NO_COMPU_METHOD 0 0 -1000000000000 1000000000000 /end TYPEDEF_MEASUREMENT
/begin TYPEDEF_CHARACTERISTIC C_I64 "" VALUE I64 0 NO_COMPU_METHOD -1e+12 1e+12 /end TYPEDEF_CHARACTERISTIC
/begin RECORD_LAYOUT F32 FNC_VALUES 1 FLOAT32_IEEE ROW_DIR DIRECT /end RECORD_LAYOUT
/begin RECORD_LAYOUT A_F32 AXIS_PTS_X 1 FLOAT32_IEEE INDEX_INCR DIRECT /end RECORD_LAYOUT
/begin TYPEDEF_MEASUREMENT M_F32 "" FLOAT32_IEEE NO_COMPU_METHOD 0 0 -1e+12 1e+12 /end TYPEDEF_MEASUREMENT
/begin TYPEDEF_CHARACTERISTIC C_F32 "" VALUE F32 0 NO_COMPU_METHOD -1e+12 1e+12 /end TYPEDEF_CHARACTERISTIC
/begin RECORD_LAYOUT F64 FNC_VALUES 1 FLOAT64_IEEE ROW_DIR DIRECT /end RECORD_LAYOUT
/begin RECORD_LAYOUT A_F64 AXIS_PTS_X 1 FLOAT64_IEEE INDEX_INCR DIRECT /end RECORD_LAYOUT
/begin TYPEDEF_MEASUREMENT M_F64 "" FLOAT64_IEEE NO_COMPU_METHOD 0 0 -1e+12 1e+12 /end TYPEDEF_MEASUREMENT
/begin TYPEDEF_CHARACTERISTIC C_F64 "" VALUE F64 0 NO_COMPU_METHOD -1e+12 1e+12 /end TYPEDEF_CHARACTERISTIC
/begin TYPEDEF_CHARACTERISTIC C_point_count "Number of points in the cloud" VALUE U16 0 NO_COMPU_METHOD 1 10000 PHYS_UNIT "count" /end TYPEDEF_CHARACTERISTIC
/begin TYPEDEF_CHARACTERISTIC C_boundary "Boundary box size in meters" VALUE F64 0 NO_COMPU_METHOD 0.1 1000 PHYS_UNIT "m" /end TYPEDEF_CHARACTERISTIC
/begin TYPEDEF_CHARACTERISTIC C_max_radius "Maximum point radius in meters" VALUE F64 0 NO_COMPU_METHOD 0.01 10 PHYS_UNIT "m" /end TYPEDEF_CHARACTERISTIC
/begin TYPEDEF_CHARACTERISTIC C_max_velocity "Maximum point velocity in meters per second" VALUE F64 0 NO_COMPU_METHOD 0.1 1000 PHYS_UNIT "m/s" /end TYPEDEF_CHARACTERISTIC
/begin TYPEDEF_CHARACTERISTIC C_delay_us "Delay per simulation step in microseconds" VALUE U32 0 NO_COMPU_METHOD 0 1e+06 PHYS_UNIT "us" /end TYPEDEF_CHARACTERISTIC
/begin TYPEDEF_MEASUREMENT M_x "X coordinate of the point" FLOAT32_IEEE NO_COMPU_METHOD 0 0 0 0 /end TYPEDEF_MEASUREMENT
/begin TYPEDEF_MEASUREMENT M_y "Y coordinate of the point" FLOAT32_IEEE NO_COMPU_METHOD 0 0 0 0 /end TYPEDEF_MEASUREMENT
/begin TYPEDEF_MEASUREMENT M_z "Z coordinate of the point" FLOAT32_IEEE NO_COMPU_METHOD 0 0 0 0 /end TYPEDEF_MEASUREMENT
/begin TYPEDEF_MEASUREMENT M_r "Radius of the point" FLOAT32_IEEE NO_COMPU_METHOD 0 0 0 0 /end TYPEDEF_MEASUREMENT
/begin TYPEDEF_MEASUREMENT M_v_x "X velocity of the point" FLOAT32_IEEE NO_COMPU_METHOD 0 0 0 0 /end TYPEDEF_MEASUREMENT
/begin TYPEDEF_MEASUREMENT M_v_y "Y velocity of the point" FLOAT32_IEEE NO_COMPU_METHOD 0 0 0 0 /end TYPEDEF_MEASUREMENT
/begin TYPEDEF_MEASUREMENT M_v_z "Z velocity of the point" FLOAT32_IEEE NO_COMPU_METHOD 0 0 0 0 /end TYPEDEF_MEASUREMENT
/begin TYPEDEF_MEASUREMENT M_count_ "Current number of points in the cloud" UWORD NO_COMPU_METHOD 0 0 0 0 /end TYPEDEF_MEASUREMENT
/* Groups */
/begin GROUP Parameters "Calibration Segment" ROOT /begin REF_CHARACTERISTIC Parameters /end REF_CHARACTERISTIC /end GROUP
/begin GROUP step_1 "Measurement event group" /begin REF_MEASUREMENT count_ points_ /end REF_MEASUREMENT /end GROUP
/begin GROUP mainloop_1 "Measurement event group" /begin REF_MEASUREMENT global_counter /end REF_MEASUREMENT /end GROUP
/begin GROUP Events "Events" ROOT /begin SUB_GROUP step_1 mainloop_1 /end SUB_GROUP /end GROUP
/* Conversions */
/begin COMPU_METHOD conv.bool "" TAB_VERB "%.0" "" COMPU_TAB_REF conv.bool.table /end COMPU_METHOD
/begin COMPU_VTAB conv.bool.table "" TAB_VERB 2 0 "false" 1 "true" /end COMPU_VTAB
/begin COMPU_METHOD conv.events "" TAB_VERB "%.0 " "" COMPU_TAB_REF conv.events.table /end COMPU_METHOD
/begin COMPU_VTAB conv.events.table "" TAB_VERB 3 0 "async" 1 "step_1" 2 "mainloop_1" /end COMPU_VTAB
/begin MOD_PAR "" EPK "17_19_38" ADDR_EPK 0x80000000
 /begin MEMORY_SEGMENT epk "" DATA FLASH INTERN 0x80000000 8 -1 -1 -1 -1 -1
  /begin IF_DATA XCP
   /begin SEGMENT 0 2 0 0 0 /begin CHECKSUM XCP_CRC_16_CITT MAX_BLOCK_SIZE 0xFFFF EXTERNAL_FUNCTION "" /end CHECKSUM
    /begin PAGE 0 ECU_ACCESS_DONT_CARE XCP_READ_ACCESS_DONT_CARE XCP_WRITE_ACCESS_DONT_CARE /end PAGE
    /begin PAGE 1 ECU_ACCESS_DONT_CARE XCP_READ_ACCESS_DONT_CARE XCP_WRITE_ACCESS_NOT_ALLOWED /end PAGE
   /end SEGMENT
  /end IF_DATA
 /end MEMORY_SEGMENT
 /begin MEMORY_SEGMENT Parameters "" DATA FLASH INTERN 0x80010000 40 -1 -1 -1 -1 -1
  /begin IF_DATA XCP
   /begin SEGMENT 1 2 0 0 0 /begin CHECKSUM XCP_CRC_16_CITT MAX_BLOCK_SIZE 0xFFFF EXTERNAL_FUNCTION "" /end CHECKSUM
    /begin PAGE 0 ECU_ACCESS_DONT_CARE XCP_READ_ACCESS_DONT_CARE XCP_WRITE_ACCESS_DONT_CARE /end PAGE
    /begin PAGE 1 ECU_ACCESS_DONT_CARE XCP_READ_ACCESS_DONT_CARE XCP_WRITE_ACCESS_NOT_ALLOWED /end PAGE
   /end SEGMENT
  /end IF_DATA
 /end MEMORY_SEGMENT
/end MOD_PAR
/begin IF_DATA XCP
 /begin PROTOCOL_LAYER 0x104 1000 2000 0 0 0 0 0 248 1024 BYTE_ORDER_MSB_LAST ADDRESS_GRANULARITY_BYTE OPTIONAL_CMD GET_COMM_MODE_INFO OPTIONAL_CMD GET_ID OPTIONAL_CMD SET_REQUEST OPTIONAL_CMD SET_MTA OPTIONAL_CMD UPLOAD OPTIONAL_CMD SHORT_UPLOAD OPTIONAL_CMD DOWNLOAD OPTIONAL_CMD SHORT_DOWNLOAD OPTIONAL_CMD GET_CAL_PAGE OPTIONAL_CMD SET_CAL_PAGE OPTIONAL_CMD COPY_CAL_PAGE OPTIONAL_CMD GET_PAG_PROCESSOR_INFO OPTIONAL_CMD GET_SEGMENT_INFO OPTIONAL_CMD GET_PAGE_INFO OPTIONAL_CMD GET_SEGMENT_MODE OPTIONAL_CMD SET_SEGMENT_MODE OPTIONAL_CMD BUILD_CHECKSUM OPTIONAL_CMD USER_CMD OPTIONAL_CMD GET_DAQ_RESOLUTION_INFO OPTIONAL_CMD GET_DAQ_PROCESSOR_INFO OPTIONAL_CMD GET_DAQ_EVENT_INFO OPTIONAL_CMD FREE_DAQ OPTIONAL_CMD ALLOC_DAQ OPTIONAL_CMD ALLOC_ODT OPTIONAL_CMD ALLOC_ODT_ENTRY OPTIONAL_CMD SET_DAQ_PTR OPTIONAL_CMD WRITE_DAQ OPTIONAL_CMD GET_DAQ_LIST_MODE OPTIONAL_CMD SET_DAQ_LIST_MODE OPTIONAL_CMD START_STOP_SYNCH OPTIONAL_CMD START_STOP_DAQ_LIST OPTIONAL_CMD GET_DAQ_CLOCK OPTIONAL_CMD WRITE_DAQ_MULTIPLE OPTIONAL_CMD TIME_CORRELATION_PROPERTIES OPTIONAL_LEVEL1_CMD GET_VERSION /end PROTOCOL_LAYER
 /begin DAQ DYNAMIC 0 3 0 OPTIMISATION_TYPE_DEFAULT ADDRESS_EXTENSION_FREE IDENTIFICATION_FIELD_TYPE_RELATIVE_BYTE GRANULARITY_ODT_ENTRY_SIZE_DAQ_BYTE 0xF8 OVERLOAD_INDICATION_PID PRESCALER_SUPPORTED /begin TIMESTAMP_SUPPORTED 0x1 SIZE_DWORD UNIT_1NS TIMESTAMP_FIXED /end TIMESTAMP_SUPPORTED /begin EVENT "async" "async" 0x0 DAQ 0xFF 100 5 0 CONSISTENCY EVENT /end EVENT /begin EVENT "step_1" "step_1" 0x1 DAQ 0xFF 0 0 0 CONSISTENCY EVENT /end EVENT
  /begin EVENT "mainloop_1" "mainloop" 0x2 DAQ 0xFF 0 0 0 CONSISTENCY EVENT /end EVENT
 /end DAQ
 /begin XCP_ON_TCP_IP 0x104 5555 ADDRESS "172.31.31.11" /end XCP_ON_TCP_IP
/end IF_DATA
/end MODULE
/end PROJECT
