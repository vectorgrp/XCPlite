ASAP2_VERSION 1 71
/begin PROJECT multi_thread_demo ""
/begin HEADER "" VERSION "1.0" PROJECT_NO XCPLITE__CASDD /end HEADER
/begin MODULE multi_thread_demo ""
/include "XCP_104.aml"
/begin MOD_COMMON "" BYTE_ORDER MSB_LAST ALIGNMENT_BYTE 1 ALIGNMENT_WORD 1 ALIGNMENT_LONG 1 ALIGNMENT_FLOAT16_IEEE 1 ALIGNMENT_FLOAT32_IEEE 1 ALIGNMENT_FLOAT64_IEEE 1 ALIGNMENT_INT64 1 /end MOD_COMMON
/* Segment relative addressing mode: calseg=params */
/begin CHARACTERISTIC params.counter_max "Max counter value, wrap around" VALUE 0x80010000 U16 0 NO_COMPU_METHOD 0 10000 /end CHARACTERISTIC
/begin CHARACTERISTIC params.ampl "Amplitude" VALUE 0x80010008 F64 0 NO_COMPU_METHOD 0 100 PHYS_UNIT "Volt" /end CHARACTERISTIC
/begin CHARACTERISTIC params.period "Period" VALUE 0x80010010 F64 0 NO_COMPU_METHOD 0.1 10 PHYS_UNIT "s" /end CHARACTERISTIC
/begin CHARACTERISTIC params.filter "Filter coefficient" VALUE 0x80010018 F64 0 NO_COMPU_METHOD 0 1 /end CHARACTERISTIC
/begin CHARACTERISTIC params.clip_max "Maximum value for clipping function" VALUE 0x80010020 F64 0 NO_COMPU_METHOD -100 100 PHYS_UNIT "Volt" /end CHARACTERISTIC
/begin CHARACTERISTIC params.clip_min "Minimum value for clipping function" VALUE 0x80010028 F64 0 NO_COMPU_METHOD -100 100 PHYS_UNIT "Volt" /end CHARACTERISTIC
/begin CHARACTERISTIC params.delay_us "task delay time in us" VALUE 0x80010030 U32 0 NO_COMPU_METHOD 0 1e+06 PHYS_UNIT "us" /end CHARACTERISTIC
/begin CHARACTERISTIC params.run "stop task" VALUE 0x80010034 U8 0 NO_COMPU_METHOD 0 1 /end CHARACTERISTIC
/* Stack frame relative addressing mode: event=task_1 (1), addr_ext=2 */
/begin MEASUREMENT task_1.counter "task loop counter" UWORD NO_COMPU_METHOD 0 0 0 65535 ECU_ADDRESS 0x1FB9E ECU_ADDRESS_EXTENSION 2 READ_WRITE
 /begin IF_DATA XCP
  /begin DAQ_EVENT FIXED_EVENT_LIST EVENT 0x1 /end DAQ_EVENT
 /end IF_DATA
/end MEASUREMENT
/begin MEASUREMENT task_1.channel1 "task sine wave signal" FLOAT64_IEEE NO_COMPU_METHOD 0 0 -1e+12 1e+12 ECU_ADDRESS 0x1FB88 ECU_ADDRESS_EXTENSION 2 READ_WRITE
 /begin IF_DATA XCP
  /begin DAQ_EVENT FIXED_EVENT_LIST EVENT 0x1 /end DAQ_EVENT
 /end IF_DATA
/end MEASUREMENT
/begin MEASUREMENT task_1.channel2 "task square wave signal" FLOAT64_IEEE NO_COMPU_METHOD 0 0 -1e+12 1e+12 ECU_ADDRESS 0x1FB80 ECU_ADDRESS_EXTENSION 2 READ_WRITE
 /begin IF_DATA XCP
  /begin DAQ_EVENT FIXED_EVENT_LIST EVENT 0x1 /end DAQ_EVENT
 /end IF_DATA
/end MEASUREMENT
/begin MEASUREMENT task_1.channel3 "task sawtooth signal" FLOAT64_IEEE NO_COMPU_METHOD 0 0 -1e+12 1e+12 ECU_ADDRESS 0x1FB78 ECU_ADDRESS_EXTENSION 2 READ_WRITE
 /begin IF_DATA XCP
  /begin DAQ_EVENT FIXED_EVENT_LIST EVENT 0x1 /end DAQ_EVENT
 /end IF_DATA
/end MEASUREMENT
/begin CHARACTERISTIC task_1.array "task array (to increase measurement workload)" VAL_BLK 0x1FBE8 U32 0 NO_COMPU_METHOD 0 4.29497e+09 MATRIX_DIM 256 1 ECU_ADDRESS_EXTENSION 2
 /begin IF_DATA XCP
  /begin DAQ_EVENT FIXED_EVENT_LIST EVENT 0x1 /end DAQ_EVENT
 /end IF_DATA
/end CHARACTERISTIC
/begin TYPEDEF_STRUCTURE tXcpContext "A2L typedef for tXcpContext" 0x2C /begin STRUCTURE_COMPONENT span_id M_span_id 0x24 /end STRUCTURE_COMPONENT /begin STRUCTURE_COMPONENT level M_level 0x28 /end STRUCTURE_COMPONENT /end TYPEDEF_STRUCTURE
/* Stack frame relative addressing mode: event=task_3 (3), addr_ext=2 */
/begin MEASUREMENT task_3.counter "task loop counter" UWORD NO_COMPU_METHOD 0 0 0 65535 ECU_ADDRESS 0x3FB9E ECU_ADDRESS_EXTENSION 2 READ_WRITE
 /begin IF_DATA XCP
  /begin DAQ_EVENT FIXED_EVENT_LIST EVENT 0x3 /end DAQ_EVENT
 /end IF_DATA
/end MEASUREMENT
/begin MEASUREMENT task_3.channel1 "task sine wave signal" FLOAT64_IEEE NO_COMPU_METHOD 0 0 -1e+12 1e+12 ECU_ADDRESS 0x3FB88 ECU_ADDRESS_EXTENSION 2 READ_WRITE
 /begin IF_DATA XCP
  /begin DAQ_EVENT FIXED_EVENT_LIST EVENT 0x3 /end DAQ_EVENT
 /end IF_DATA
/end MEASUREMENT
/begin MEASUREMENT task_3.channel2 "task square wave signal" FLOAT64_IEEE NO_COMPU_METHOD 0 0 -1e+12 1e+12 ECU_ADDRESS 0x3FB80 ECU_ADDRESS_EXTENSION 2 READ_WRITE
 /begin IF_DATA XCP
  /begin DAQ_EVENT FIXED_EVENT_LIST EVENT 0x3 /end DAQ_EVENT
 /end IF_DATA
/end MEASUREMENT
/begin MEASUREMENT task_3.channel3 "task sawtooth signal" FLOAT64_IEEE NO_COMPU_METHOD 0 0 -1e+12 1e+12 ECU_ADDRESS 0x3FB78 ECU_ADDRESS_EXTENSION 2 READ_WRITE
 /begin IF_DATA XCP
  /begin DAQ_EVENT FIXED_EVENT_LIST EVENT 0x3 /end DAQ_EVENT
 /end IF_DATA
/end MEASUREMENT
/begin CHARACTERISTIC task_3.array "task array (to increase measurement workload)" VAL_BLK 0x3FBE8 U32 0 NO_COMPU_METHOD 0 4.29497e+09 MATRIX_DIM 256 1 ECU_ADDRESS_EXTENSION 2
 /begin IF_DATA XCP
  /begin DAQ_EVENT FIXED_EVENT_LIST EVENT 0x3 /end DAQ_EVENT
 /end IF_DATA
/end CHARACTERISTIC
/* Relative addressing mode: event=ctx_3 (10), addr_ext=3 */
/begin INSTANCE ctx_3 "Thread local context" tXcpContext 0xA0000 ECU_ADDRESS_EXTENSION 3 READ_WRITE
 /begin IF_DATA XCP
  /begin DAQ_EVENT FIXED_EVENT_LIST EVENT 0xA /end DAQ_EVENT
 /end IF_DATA
/end INSTANCE
/* Stack frame relative addressing mode: event=clip (11), addr_ext=2 */
/begin MEASUREMENT clip.span_dt "Span runtime" A_UINT64 NO_COMPU_METHOD 0 0 0 0.1 ECU_ADDRESS 0xBFFC0 ECU_ADDRESS_EXTENSION 2 PHYS_UNIT "ns" READ_WRITE
 /begin IF_DATA XCP
  /begin DAQ_EVENT FIXED_EVENT_LIST EVENT 0xB /end DAQ_EVENT
 /end IF_DATA
/end MEASUREMENT
/* Stack frame relative addressing mode: event=task_5 (5), addr_ext=2 */
/begin MEASUREMENT task_5.counter "task loop counter" UWORD NO_COMPU_METHOD 0 0 0 65535 ECU_ADDRESS 0x5FB9E ECU_ADDRESS_EXTENSION 2 READ_WRITE
 /begin IF_DATA XCP
  /begin DAQ_EVENT FIXED_EVENT_LIST EVENT 0x5 /end DAQ_EVENT
 /end IF_DATA
/end MEASUREMENT
/begin MEASUREMENT task_5.channel1 "task sine wave signal" FLOAT64_IEEE NO_COMPU_METHOD 0 0 -1e+12 1e+12 ECU_ADDRESS 0x5FB88 ECU_ADDRESS_EXTENSION 2 READ_WRITE
 /begin IF_DATA XCP
  /begin DAQ_EVENT FIXED_EVENT_LIST EVENT 0x5 /end DAQ_EVENT
 /end IF_DATA
/end MEASUREMENT
/begin MEASUREMENT task_5.channel2 "task square wave signal" FLOAT64_IEEE NO_COMPU_METHOD 0 0 -1e+12 1e+12 ECU_ADDRESS 0x5FB80 ECU_ADDRESS_EXTENSION 2 READ_WRITE
 /begin IF_DATA XCP
  /begin DAQ_EVENT FIXED_EVENT_LIST EVENT 0x5 /end DAQ_EVENT
 /end IF_DATA
/end MEASUREMENT
/begin MEASUREMENT task_5.channel3 "task sawtooth signal" FLOAT64_IEEE NO_COMPU_METHOD 0 0 -1e+12 1e+12 ECU_ADDRESS 0x5FB78 ECU_ADDRESS_EXTENSION 2 READ_WRITE
 /begin IF_DATA XCP
  /begin DAQ_EVENT FIXED_EVENT_LIST EVENT 0x5 /end DAQ_EVENT
 /end IF_DATA
/end MEASUREMENT
/begin CHARACTERISTIC task_5.array "task array (to increase measurement workload)" VAL_BLK 0x5FBE8 U32 0 NO_COMPU_METHOD 0 4.29497e+09 MATRIX_DIM 256 1 ECU_ADDRESS_EXTENSION 2
 /begin IF_DATA XCP
  /begin DAQ_EVENT FIXED_EVENT_LIST EVENT 0x5 /end DAQ_EVENT
 /end IF_DATA
/end CHARACTERISTIC
/* Relative addressing mode: event=ctx_5 (12), addr_ext=3 */
/begin INSTANCE ctx_5 "Thread local context" tXcpContext 0xC0000 ECU_ADDRESS_EXTENSION 3 READ_WRITE
 /begin IF_DATA XCP
  /begin DAQ_EVENT FIXED_EVENT_LIST EVENT 0xC /end DAQ_EVENT
 /end IF_DATA
/end INSTANCE
/* Relative addressing mode: event=ctx_1 (6), addr_ext=3 */
/begin INSTANCE ctx_1 "Thread local context" tXcpContext 0x60000 ECU_ADDRESS_EXTENSION 3 READ_WRITE
 /begin IF_DATA XCP
  /begin DAQ_EVENT FIXED_EVENT_LIST EVENT 0x6 /end DAQ_EVENT
 /end IF_DATA
/end INSTANCE
/* Stack frame relative addressing mode: event=task_6 (7), addr_ext=2 */
/begin MEASUREMENT task_6.counter "task loop counter" UWORD NO_COMPU_METHOD 0 0 0 65535 ECU_ADDRESS 0x7FB9E ECU_ADDRESS_EXTENSION 2 READ_WRITE
 /begin IF_DATA XCP
  /begin DAQ_EVENT FIXED_EVENT_LIST EVENT 0x7 /end DAQ_EVENT
 /end IF_DATA
/end MEASUREMENT
/begin MEASUREMENT task_6.channel1 "task sine wave signal" FLOAT64_IEEE NO_COMPU_METHOD 0 0 -1e+12 1e+12 ECU_ADDRESS 0x7FB88 ECU_ADDRESS_EXTENSION 2 READ_WRITE
 /begin IF_DATA XCP
  /begin DAQ_EVENT FIXED_EVENT_LIST EVENT 0x7 /end DAQ_EVENT
 /end IF_DATA
/end MEASUREMENT
/begin MEASUREMENT task_6.channel2 "task square wave signal" FLOAT64_IEEE NO_COMPU_METHOD 0 0 -1e+12 1e+12 ECU_ADDRESS 0x7FB80 ECU_ADDRESS_EXTENSION 2 READ_WRITE
 /begin IF_DATA XCP
  /begin DAQ_EVENT FIXED_EVENT_LIST EVENT 0x7 /end DAQ_EVENT
 /end IF_DATA
/end MEASUREMENT
/begin MEASUREMENT task_6.channel3 "task sawtooth signal" FLOAT64_IEEE NO_COMPU_METHOD 0 0 -1e+12 1e+12 ECU_ADDRESS 0x7FB78 ECU_ADDRESS_EXTENSION 2 READ_WRITE
 /begin IF_DATA XCP
  /begin DAQ_EVENT FIXED_EVENT_LIST EVENT 0x7 /end DAQ_EVENT
 /end IF_DATA
/end MEASUREMENT
/begin CHARACTERISTIC task_6.array "task array (to increase measurement workload)" VAL_BLK 0x7FBE8 U32 0 NO_COMPU_METHOD 0 4.29497e+09 MATRIX_DIM 256 1 ECU_ADDRESS_EXTENSION 2
 /begin IF_DATA XCP
  /begin DAQ_EVENT FIXED_EVENT_LIST EVENT 0x7 /end DAQ_EVENT
 /end IF_DATA
/end CHARACTERISTIC
/* Relative addressing mode: event=ctx_6 (13), addr_ext=3 */
/begin INSTANCE ctx_6 "Thread local context" tXcpContext 0xD0000 ECU_ADDRESS_EXTENSION 3 READ_WRITE
 /begin IF_DATA XCP
  /begin DAQ_EVENT FIXED_EVENT_LIST EVENT 0xD /end DAQ_EVENT
 /end IF_DATA
/end INSTANCE
/* Stack frame relative addressing mode: event=task_2 (2), addr_ext=2 */
/begin MEASUREMENT task_2.counter "task loop counter" UWORD NO_COMPU_METHOD 0 0 0 65535 ECU_ADDRESS 0x2FB9E ECU_ADDRESS_EXTENSION 2 READ_WRITE
 /begin IF_DATA XCP
  /begin DAQ_EVENT FIXED_EVENT_LIST EVENT 0x2 /end DAQ_EVENT
 /end IF_DATA
/end MEASUREMENT
/begin MEASUREMENT task_2.channel1 "task sine wave signal" FLOAT64_IEEE NO_COMPU_METHOD 0 0 -1e+12 1e+12 ECU_ADDRESS 0x2FB88 ECU_ADDRESS_EXTENSION 2 READ_WRITE
 /begin IF_DATA XCP
  /begin DAQ_EVENT FIXED_EVENT_LIST EVENT 0x2 /end DAQ_EVENT
 /end IF_DATA
/end MEASUREMENT
/begin MEASUREMENT task_2.channel2 "task square wave signal" FLOAT64_IEEE NO_COMPU_METHOD 0 0 -1e+12 1e+12 ECU_ADDRESS 0x2FB80 ECU_ADDRESS_EXTENSION 2 READ_WRITE
 /begin IF_DATA XCP
  /begin DAQ_EVENT FIXED_EVENT_LIST EVENT 0x2 /end DAQ_EVENT
 /end IF_DATA
/end MEASUREMENT
/begin MEASUREMENT task_2.channel3 "task sawtooth signal" FLOAT64_IEEE NO_COMPU_METHOD 0 0 -1e+12 1e+12 ECU_ADDRESS 0x2FB78 ECU_ADDRESS_EXTENSION 2 READ_WRITE
 /begin IF_DATA XCP
  /begin DAQ_EVENT FIXED_EVENT_LIST EVENT 0x2 /end DAQ_EVENT
 /end IF_DATA
/end MEASUREMENT
/begin CHARACTERISTIC task_2.array "task array (to increase measurement workload)" VAL_BLK 0x2FBE8 U32 0 NO_COMPU_METHOD 0 4.29497e+09 MATRIX_DIM 256 1 ECU_ADDRESS_EXTENSION 2
 /begin IF_DATA XCP
  /begin DAQ_EVENT FIXED_EVENT_LIST EVENT 0x2 /end DAQ_EVENT
 /end IF_DATA
/end CHARACTERISTIC
/* Relative addressing mode: event=ctx_2 (14), addr_ext=3 */
/begin INSTANCE ctx_2 "Thread local context" tXcpContext 0xE0000 ECU_ADDRESS_EXTENSION 3 READ_WRITE
 /begin IF_DATA XCP
  /begin DAQ_EVENT FIXED_EVENT_LIST EVENT 0xE /end DAQ_EVENT
 /end IF_DATA
/end INSTANCE
/* Stack frame relative addressing mode: event=task_4 (4), addr_ext=2 */
/begin MEASUREMENT task_4.counter "task loop counter" UWORD NO_COMPU_METHOD 0 0 0 65535 ECU_ADDRESS 0x4FB9E ECU_ADDRESS_EXTENSION 2 READ_WRITE
 /begin IF_DATA XCP
  /begin DAQ_EVENT FIXED_EVENT_LIST EVENT 0x4 /end DAQ_EVENT
 /end IF_DATA
/end MEASUREMENT
/begin MEASUREMENT task_4.channel1 "task sine wave signal" FLOAT64_IEEE NO_COMPU_METHOD 0 0 -1e+12 1e+12 ECU_ADDRESS 0x4FB88 ECU_ADDRESS_EXTENSION 2 READ_WRITE
 /begin IF_DATA XCP
  /begin DAQ_EVENT FIXED_EVENT_LIST EVENT 0x4 /end DAQ_EVENT
 /end IF_DATA
/end MEASUREMENT
/begin MEASUREMENT task_4.channel2 "task square wave signal" FLOAT64_IEEE NO_COMPU_METHOD 0 0 -1e+12 1e+12 ECU_ADDRESS 0x4FB80 ECU_ADDRESS_EXTENSION 2 READ_WRITE
 /begin IF_DATA XCP
  /begin DAQ_EVENT FIXED_EVENT_LIST EVENT 0x4 /end DAQ_EVENT
 /end IF_DATA
/end MEASUREMENT
/begin MEASUREMENT task_4.channel3 "task sawtooth signal" FLOAT64_IEEE NO_COMPU_METHOD 0 0 -1e+12 1e+12 ECU_ADDRESS 0x4FB78 ECU_ADDRESS_EXTENSION 2 READ_WRITE
 /begin IF_DATA XCP
  /begin DAQ_EVENT FIXED_EVENT_LIST EVENT 0x4 /end DAQ_EVENT
 /end IF_DATA
/end MEASUREMENT
/begin CHARACTERISTIC task_4.array "task array (to increase measurement workload)" VAL_BLK 0x4FBE8 U32 0 NO_COMPU_METHOD 0 4.29497e+09 MATRIX_DIM 256 1 ECU_ADDRESS_EXTENSION 2
 /begin IF_DATA XCP
  /begin DAQ_EVENT FIXED_EVENT_LIST EVENT 0x4 /end DAQ_EVENT
 /end IF_DATA
/end CHARACTERISTIC
/* Relative addressing mode: event=ctx_4 (15), addr_ext=3 */
/begin INSTANCE ctx_4 "Thread local context" tXcpContext 0xF0000 ECU_ADDRESS_EXTENSION 3 READ_WRITE
 /begin IF_DATA XCP
  /begin DAQ_EVENT FIXED_EVENT_LIST EVENT 0xF /end DAQ_EVENT
 /end IF_DATA
/end INSTANCE
/* Stack frame relative addressing mode: event=task_7 (8), addr_ext=2 */
/begin MEASUREMENT task_7.counter "task loop counter" UWORD NO_COMPU_METHOD 0 0 0 65535 ECU_ADDRESS 0x8FB9E ECU_ADDRESS_EXTENSION 2 READ_WRITE
 /begin IF_DATA XCP
  /begin DAQ_EVENT FIXED_EVENT_LIST EVENT 0x8 /end DAQ_EVENT
 /end IF_DATA
/end MEASUREMENT
/begin MEASUREMENT task_7.channel1 "task sine wave signal" FLOAT64_IEEE NO_COMPU_METHOD 0 0 -1e+12 1e+12 ECU_ADDRESS 0x8FB88 ECU_ADDRESS_EXTENSION 2 READ_WRITE
 /begin IF_DATA XCP
  /begin DAQ_EVENT FIXED_EVENT_LIST EVENT 0x8 /end DAQ_EVENT
 /end IF_DATA
/end MEASUREMENT
/begin MEASUREMENT task_7.channel2 "task square wave signal" FLOAT64_IEEE NO_COMPU_METHOD 0 0 -1e+12 1e+12 ECU_ADDRESS 0x8FB80 ECU_ADDRESS_EXTENSION 2 READ_WRITE
 /begin IF_DATA XCP
  /begin DAQ_EVENT FIXED_EVENT_LIST EVENT 0x8 /end DAQ_EVENT
 /end IF_DATA
/end MEASUREMENT
/begin MEASUREMENT task_7.channel3 "task sawtooth signal" FLOAT64_IEEE NO_COMPU_METHOD 0 0 -1e+12 1e+12 ECU_ADDRESS 0x8FB78 ECU_ADDRESS_EXTENSION 2 READ_WRITE
 /begin IF_DATA XCP
  /begin DAQ_EVENT FIXED_EVENT_LIST EVENT 0x8 /end DAQ_EVENT
 /end IF_DATA
/end MEASUREMENT
/begin CHARACTERISTIC task_7.array "task array (to increase measurement workload)" VAL_BLK 0x8FBE8 U32 0 NO_COMPU_METHOD 0 4.29497e+09 MATRIX_DIM 256 1 ECU_ADDRESS_EXTENSION 2
 /begin IF_DATA XCP
  /begin DAQ_EVENT FIXED_EVENT_LIST EVENT 0x8 /end DAQ_EVENT
 /end IF_DATA
/end CHARACTERISTIC
/* Stack frame relative addressing mode: event=task_8 (9), addr_ext=2 */
/begin MEASUREMENT task_8.counter "task loop counter" UWORD NO_COMPU_METHOD 0 0 0 65535 ECU_ADDRESS 0x9FB9E ECU_ADDRESS_EXTENSION 2 READ_WRITE
 /begin IF_DATA XCP
  /begin DAQ_EVENT FIXED_EVENT_LIST EVENT 0x9 /end DAQ_EVENT
 /end IF_DATA
/end MEASUREMENT
/begin MEASUREMENT task_8.channel1 "task sine wave signal" FLOAT64_IEEE NO_COMPU_METHOD 0 0 -1e+12 1e+12 ECU_ADDRESS 0x9FB88 ECU_ADDRESS_EXTENSION 2 READ_WRITE
 /begin IF_DATA XCP
  /begin DAQ_EVENT FIXED_EVENT_LIST EVENT 0x9 /end DAQ_EVENT
 /end IF_DATA
/end MEASUREMENT
/begin MEASUREMENT task_8.channel2 "task square wave signal" FLOAT64_IEEE NO_COMPU_METHOD 0 0 -1e+12 1e+12 ECU_ADDRESS 0x9FB80 ECU_ADDRESS_EXTENSION 2 READ_WRITE
 /begin IF_DATA XCP
  /begin DAQ_EVENT FIXED_EVENT_LIST EVENT 0x9 /end DAQ_EVENT
 /end IF_DATA
/end MEASUREMENT
/begin MEASUREMENT task_8.channel3 "task sawtooth signal" FLOAT64_IEEE NO_COMPU_METHOD 0 0 -1e+12 1e+12 ECU_ADDRESS 0x9FB78 ECU_ADDRESS_EXTENSION 2 READ_WRITE
 /begin IF_DATA XCP
  /begin DAQ_EVENT FIXED_EVENT_LIST EVENT 0x9 /end DAQ_EVENT
 /end IF_DATA
/end MEASUREMENT
/begin CHARACTERISTIC task_8.array "task array (to increase measurement workload)" VAL_BLK 0x9FBE8 U32 0 NO_COMPU_METHOD 0 4.29497e+09 MATRIX_DIM 256 1 ECU_ADDRESS_EXTENSION 2
 /begin IF_DATA XCP
  /begin DAQ_EVENT FIXED_EVENT_LIST EVENT 0x9 /end DAQ_EVENT
 /end IF_DATA
/end CHARACTERISTIC
/* Stack frame relative addressing mode: event=filter (18), addr_ext=2 */
/begin MEASUREMENT filter.span_dt "Span runtime" A_UINT64 NO_COMPU_METHOD 0 0 0 0.1 ECU_ADDRESS 0x12FFB0 ECU_ADDRESS_EXTENSION 2 PHYS_UNIT "ns" READ_WRITE
 /begin IF_DATA XCP
  /begin DAQ_EVENT FIXED_EVENT_LIST EVENT 0x12 /end DAQ_EVENT
 /end IF_DATA
/end MEASUREMENT
/* Stack frame relative addressing mode: event=task_1 (1), addr_ext=2 */
/begin MEASUREMENT filtered_input "Filter result" FLOAT64_IEEE NO_COMPU_METHOD 0 0 -1e+12 1e+12 ECU_ADDRESS 0x1FFC8 ECU_ADDRESS_EXTENSION 2 READ_WRITE
 /begin IF_DATA XCP
  /begin DAQ_EVENT FIXED_EVENT_LIST EVENT 0x1 /end DAQ_EVENT
 /end IF_DATA
/end MEASUREMENT
/* Relative addressing mode: event=ctx_7 (16), addr_ext=3 */
/begin INSTANCE ctx_7 "Thread local context" tXcpContext 0x100000 ECU_ADDRESS_EXTENSION 3 READ_WRITE
 /begin IF_DATA XCP
  /begin DAQ_EVENT FIXED_EVENT_LIST EVENT 0x10 /end DAQ_EVENT
 /end IF_DATA
/end INSTANCE
/* Relative addressing mode: event=ctx_8 (17), addr_ext=3 */
/begin INSTANCE ctx_8 "Thread local context" tXcpContext 0x110000 ECU_ADDRESS_EXTENSION 3 READ_WRITE
 /begin IF_DATA XCP
  /begin DAQ_EVENT FIXED_EVENT_LIST EVENT 0x11 /end DAQ_EVENT
 /end IF_DATA
/end INSTANCE
/* Typedefs */
/begin RECORD_LAYOUT U8 FNC_VALUES 1 UBYTE ROW_DIR DIRECT /end RECORD_LAYOUT
/begin RECORD_LAYOUT A_U8 AXIS_PTS_X 1 UBYTE INDEX_INCR DIRECT /end RECORD_LAYOUT
/begin TYPEDEF_MEASUREMENT M_U8 "" UBYTE NO_COMPU_METHOD 0 0 0 255 /end TYPEDEF_MEASUREMENT
/begin TYPEDEF_CHARACTERISTIC C_U8 "" VALUE U8 0 NO_COMPU_METHOD 0 255 /end TYPEDEF_CHARACTERISTIC
/begin RECORD_LAYOUT U16 FNC_VALUES 1 UWORD ROW_DIR DIRECT /end RECORD_LAYOUT
/begin RECORD_LAYOUT A_U16 AXIS_PTS_X 1 UWORD INDEX_INCR DIRECT /end RECORD_LAYOUT
/begin TYPEDEF_MEASUREMENT M_U16 "" UWORD NO_COMPU_METHOD 0 0 0 65535 /end TYPEDEF_MEASUREMENT
/begin TYPEDEF_CHARACTERISTIC C_U16 "" VALUE U16 0 NO_COMPU_METHOD 0 65535 /end TYPEDEF_CHARACTERISTIC
/begin RECORD_LAYOUT U32 FNC_VALUES 1 ULONG ROW_DIR DIRECT /end RECORD_LAYOUT
/begin RECORD_LAYOUT A_U32 AXIS_PTS_X 1 ULONG INDEX_INCR DIRECT /end RECORD_LAYOUT
/begin TYPEDEF_MEASUREMENT M_U32 "" ULONG NO_COMPU_METHOD 0 0 0 4294967295 /end TYPEDEF_MEASUREMENT
/begin TYPEDEF_CHARACTERISTIC C_U32 "" VALUE U32 0 NO_COMPU_METHOD 0 4.29497e+09 /end TYPEDEF_CHARACTERISTIC
/begin RECORD_LAYOUT U64 FNC_VALUES 1 A_UINT64 ROW_DIR DIRECT /end RECORD_LAYOUT
/begin RECORD_LAYOUT A_U64 AXIS_PTS_X 1 A_UINT64 INDEX_INCR DIRECT /end RECORD_LAYOUT
/begin TYPEDEF_MEASUREMENT M_U64 "" A_UINT64 NO_COMPU_METHOD 0 0 0 1000000000000 /end TYPEDEF_MEASUREMENT
/begin TYPEDEF_CHARACTERISTIC C_U64 "" VALUE U64 0 NO_COMPU_METHOD 0 1e+12 /end TYPEDEF_CHARACTERISTIC
/begin RECORD_LAYOUT I8 FNC_VALUES 1 SBYTE ROW_DIR DIRECT /end RECORD_LAYOUT
/begin RECORD_LAYOUT A_I8 AXIS_PTS_X 1 SBYTE INDEX_INCR DIRECT /end RECORD_LAYOUT
/begin TYPEDEF_MEASUREMENT M_I8 "" SBYTE NO_COMPU_METHOD 0 0 -128 127 /end TYPEDEF_MEASUREMENT
/begin TYPEDEF_CHARACTERISTIC C_I8 "" VALUE I8 0 NO_COMPU_METHOD -128 127 /end TYPEDEF_CHARACTERISTIC
/begin RECORD_LAYOUT I16 FNC_VALUES 1 SWORD ROW_DIR DIRECT /end RECORD_LAYOUT
/begin RECORD_LAYOUT A_I16 AXIS_PTS_X 1 SWORD INDEX_INCR DIRECT /end RECORD_LAYOUT
/begin TYPEDEF_MEASUREMENT M_I16 "" SWORD NO_COMPU_METHOD 0 0 -32768 32767 /end TYPEDEF_MEASUREMENT
/begin TYPEDEF_CHARACTERISTIC C_I16 "" VALUE I16 0 NO_COMPU_METHOD -32768 32767 /end TYPEDEF_CHARACTERISTIC
/begin RECORD_LAYOUT I32 FNC_VALUES 1 SLONG ROW_DIR DIRECT /end RECORD_LAYOUT
/begin RECORD_LAYOUT A_I32 AXIS_PTS_X 1 SLONG INDEX_INCR DIRECT /end RECORD_LAYOUT
/begin TYPEDEF_MEASUREMENT M_I32 "" SLONG NO_COMPU_METHOD 0 0 -2147483648 2147483647 /end TYPEDEF_MEASUREMENT
/begin TYPEDEF_CHARACTERISTIC C_I32 "" VALUE I32 0 NO_COMPU_METHOD -2.14748e+09 2.14748e+09 /end TYPEDEF_CHARACTERISTIC
/begin RECORD_LAYOUT I64 FNC_VALUES 1 A_INT64 ROW_DIR DIRECT /end RECORD_LAYOUT
/begin RECORD_LAYOUT A_I64 AXIS_PTS_X 1 A_INT64 INDEX_INCR DIRECT /end RECORD_LAYOUT
/begin TYPEDEF_MEASUREMENT M_I64 "" A_INT64 NO_COMPU_METHOD 0 0 -1000000000000 1000000000000 /end TYPEDEF_MEASUREMENT
/begin TYPEDEF_CHARACTERISTIC C_I64 "" VALUE I64 0 NO_COMPU_METHOD -1e+12 1e+12 /end TYPEDEF_CHARACTERISTIC
/begin RECORD_LAYOUT F32 FNC_VALUES 1 FLOAT32_IEEE ROW_DIR DIRECT /end RECORD_LAYOUT
/begin RECORD_LAYOUT A_F32 AXIS_PTS_X 1 FLOAT32_IEEE INDEX_INCR DIRECT /end RECORD_LAYOUT
/begin TYPEDEF_MEASUREMENT M_F32 "" FLOAT32_IEEE NO_COMPU_METHOD 0 0 -1e+12 1e+12 /end TYPEDEF_MEASUREMENT
/begin TYPEDEF_CHARACTERISTIC C_F32 "" VALUE F32 0 NO_COMPU_METHOD -1e+12 1e+12 /end TYPEDEF_CHARACTERISTIC
/begin RECORD_LAYOUT F64 FNC_VALUES 1 FLOAT64_IEEE ROW_DIR DIRECT /end RECORD_LAYOUT
/begin RECORD_LAYOUT A_F64 AXIS_PTS_X 1 FLOAT64_IEEE INDEX_INCR DIRECT /end RECORD_LAYOUT
/begin TYPEDEF_MEASUREMENT M_F64 "" FLOAT64_IEEE NO_COMPU_METHOD 0 0 -1e+12 1e+12 /end TYPEDEF_MEASUREMENT
/begin TYPEDEF_CHARACTERISTIC C_F64 "" VALUE F64 0 NO_COMPU_METHOD -1e+12 1e+12 /end TYPEDEF_CHARACTERISTIC
/begin TYPEDEF_MEASUREMENT M_span_id "function span id" UWORD conv.events 0 0 0 32 /end TYPEDEF_MEASUREMENT
/begin TYPEDEF_MEASUREMENT M_level "function span nesting level" ULONG NO_COMPU_METHOD 0 0 0 0 /end TYPEDEF_MEASUREMENT
/* Groups */
/begin GROUP params "Calibration Segment" ROOT
 /begin REF_CHARACTERISTIC params.counter_max params.ampl params.period params.filter params.clip_max params.clip_min params.delay_us params.run /end REF_CHARACTERISTIC
/end GROUP
/begin GROUP task_1 "Measurement event group"
 /begin REF_MEASUREMENT task_1.counter task_1.channel1 task_1.channel2 task_1.channel3 task_1.array /end REF_MEASUREMENT
/end GROUP
/begin GROUP task_3 "Measurement event group"
 /begin REF_MEASUREMENT task_3.counter task_3.channel1 task_3.channel2 task_3.channel3 task_3.array /end REF_MEASUREMENT
/end GROUP
/begin GROUP ctx_3 "Measurement event group" /begin REF_MEASUREMENT ctx_3 /end REF_MEASUREMENT /end GROUP
/begin GROUP clip "Measurement event group" /begin REF_MEASUREMENT clip.span_dt /end REF_MEASUREMENT /end GROUP
/begin GROUP task_5 "Measurement event group"
 /begin REF_MEASUREMENT task_5.counter task_5.channel1 task_5.channel2 task_5.channel3 task_5.array /end REF_MEASUREMENT
/end GROUP
/begin GROUP ctx_5 "Measurement event group" /begin REF_MEASUREMENT ctx_5 /end REF_MEASUREMENT /end GROUP
/begin GROUP ctx_1 "Measurement event group" /begin REF_MEASUREMENT ctx_1 /end REF_MEASUREMENT /end GROUP
/begin GROUP task_6 "Measurement event group"
 /begin REF_MEASUREMENT task_6.counter task_6.channel1 task_6.channel2 task_6.channel3 task_6.array /end REF_MEASUREMENT
/end GROUP
/begin GROUP ctx_6 "Measurement event group" /begin REF_MEASUREMENT ctx_6 /end REF_MEASUREMENT /end GROUP
/begin GROUP task_2 "Measurement event group"
 /begin REF_MEASUREMENT task_2.counter task_2.channel1 task_2.channel2 task_2.channel3 task_2.array /end REF_MEASUREMENT
/end GROUP
/begin GROUP ctx_2 "Measurement event group" /begin REF_MEASUREMENT ctx_2 /end REF_MEASUREMENT /end GROUP
/begin GROUP task_4 "Measurement event group"
 /begin REF_MEASUREMENT task_4.counter task_4.channel1 task_4.channel2 task_4.channel3 task_4.array /end REF_MEASUREMENT
/end GROUP
/begin GROUP ctx_4 "Measurement event group" /begin REF_MEASUREMENT ctx_4 /end REF_MEASUREMENT /end GROUP
/begin GROUP task_7 "Measurement event group"
 /begin REF_MEASUREMENT task_7.counter task_7.channel1 task_7.channel2 task_7.channel3 task_7.array /end REF_MEASUREMENT
/end GROUP
/begin GROUP task_8 "Measurement event group"
 /begin REF_MEASUREMENT task_8.counter task_8.channel1 task_8.channel2 task_8.channel3 task_8.array /end REF_MEASUREMENT
/end GROUP
/begin GROUP filter "Measurement event group" /begin REF_MEASUREMENT filter.span_dt /end REF_MEASUREMENT /end GROUP
/begin GROUP task_1 "Measurement event group" /begin REF_MEASUREMENT filtered_input /end REF_MEASUREMENT /end GROUP
/begin GROUP ctx_7 "Measurement event group" /begin REF_MEASUREMENT ctx_7 /end REF_MEASUREMENT /end GROUP
/begin GROUP ctx_8 "Measurement event group" /begin REF_MEASUREMENT ctx_8 /end REF_MEASUREMENT /end GROUP
/begin GROUP Events "Events" ROOT
 /begin SUB_GROUP task_1 task_2 task_3 task_4 task_5 ctx_1 task_6 task_7 task_8 ctx_3 clip ctx_5 ctx_6 ctx_2 ctx_4 ctx_7 ctx_8 filter /end SUB_GROUP
/end GROUP
/* Conversions */
/begin COMPU_METHOD conv.bool "" TAB_VERB "%.0" "" COMPU_TAB_REF conv.bool.table /end COMPU_METHOD
/begin COMPU_VTAB conv.bool.table "" TAB_VERB 2 0 "false" 1 "true" /end COMPU_VTAB
/begin COMPU_METHOD conv.events "" TAB_VERB "%.0 " "" COMPU_TAB_REF conv.events.table /end COMPU_METHOD
/begin COMPU_VTAB conv.events.table "" TAB_VERB 19 0 "async" 1 "task_1" 2 "task_2" 3 "task_3" 4 "task_4" 5 "task_5" 6 "ctx_1" 7 "task_6" 8 "task_7" 9 "task_8" 10 "ctx_3" 11 "clip" 12 "ctx_5" 13 "ctx_6" 14 "ctx_2" 15 "ctx_4" 16 "ctx_7" 17 "ctx_8" 18 "filter" /end COMPU_VTAB
/begin MOD_PAR "" EPK "14_51_40" ADDR_EPK 0x80000000
 /begin MEMORY_SEGMENT epk "" DATA FLASH INTERN 0x80000000 8 -1 -1 -1 -1 -1
  /begin IF_DATA XCP
   /begin SEGMENT 0 2 0 0 0 /begin CHECKSUM XCP_CRC_16_CITT MAX_BLOCK_SIZE 0xFFFF EXTERNAL_FUNCTION "" /end CHECKSUM
    /begin PAGE 0 ECU_ACCESS_DONT_CARE XCP_READ_ACCESS_DONT_CARE XCP_WRITE_ACCESS_DONT_CARE /end PAGE
    /begin PAGE 1 ECU_ACCESS_DONT_CARE XCP_READ_ACCESS_DONT_CARE XCP_WRITE_ACCESS_NOT_ALLOWED /end PAGE
   /end SEGMENT
  /end IF_DATA
 /end MEMORY_SEGMENT
 /begin MEMORY_SEGMENT params "" DATA FLASH INTERN 0x80010000 56 -1 -1 -1 -1 -1
  /begin IF_DATA XCP
   /begin SEGMENT 1 2 0 0 0 /begin CHECKSUM XCP_CRC_16_CITT MAX_BLOCK_SIZE 0xFFFF EXTERNAL_FUNCTION "" /end CHECKSUM
    /begin PAGE 0 ECU_ACCESS_DONT_CARE XCP_READ_ACCESS_DONT_CARE XCP_WRITE_ACCESS_DONT_CARE /end PAGE
    /begin PAGE 1 ECU_ACCESS_DONT_CARE XCP_READ_ACCESS_DONT_CARE XCP_WRITE_ACCESS_NOT_ALLOWED /end PAGE
   /end SEGMENT
  /end IF_DATA
 /end MEMORY_SEGMENT
/end MOD_PAR
/begin IF_DATA XCP
 /begin PROTOCOL_LAYER 0x104 1000 2000 0 0 0 0 0 248 1024 BYTE_ORDER_MSB_LAST ADDRESS_GRANULARITY_BYTE OPTIONAL_CMD GET_COMM_MODE_INFO OPTIONAL_CMD GET_ID OPTIONAL_CMD SET_REQUEST OPTIONAL_CMD SET_MTA OPTIONAL_CMD UPLOAD OPTIONAL_CMD SHORT_UPLOAD OPTIONAL_CMD DOWNLOAD OPTIONAL_CMD SHORT_DOWNLOAD OPTIONAL_CMD GET_CAL_PAGE OPTIONAL_CMD SET_CAL_PAGE OPTIONAL_CMD COPY_CAL_PAGE OPTIONAL_CMD GET_PAG_PROCESSOR_INFO OPTIONAL_CMD GET_SEGMENT_INFO OPTIONAL_CMD GET_PAGE_INFO OPTIONAL_CMD GET_SEGMENT_MODE OPTIONAL_CMD SET_SEGMENT_MODE OPTIONAL_CMD BUILD_CHECKSUM OPTIONAL_CMD USER_CMD OPTIONAL_CMD GET_DAQ_RESOLUTION_INFO OPTIONAL_CMD GET_DAQ_PROCESSOR_INFO OPTIONAL_CMD GET_DAQ_EVENT_INFO OPTIONAL_CMD FREE_DAQ OPTIONAL_CMD ALLOC_DAQ OPTIONAL_CMD ALLOC_ODT OPTIONAL_CMD ALLOC_ODT_ENTRY OPTIONAL_CMD SET_DAQ_PTR OPTIONAL_CMD WRITE_DAQ OPTIONAL_CMD GET_DAQ_LIST_MODE OPTIONAL_CMD SET_DAQ_LIST_MODE OPTIONAL_CMD START_STOP_SYNCH OPTIONAL_CMD START_STOP_DAQ_LIST OPTIONAL_CMD GET_DAQ_CLOCK OPTIONAL_CMD WRITE_DAQ_MULTIPLE OPTIONAL_CMD TIME_CORRELATION_PROPERTIES OPTIONAL_LEVEL1_CMD GET_VERSION /end PROTOCOL_LAYER
 /begin DAQ DYNAMIC 0 19 0 OPTIMISATION_TYPE_DEFAULT ADDRESS_EXTENSION_FREE IDENTIFICATION_FIELD_TYPE_RELATIVE_BYTE GRANULARITY_ODT_ENTRY_SIZE_DAQ_BYTE 0xF8 OVERLOAD_INDICATION_PID PRESCALER_SUPPORTED /begin TIMESTAMP_SUPPORTED 0x1 SIZE_DWORD UNIT_1NS TIMESTAMP_FIXED /end TIMESTAMP_SUPPORTED /begin EVENT "async" "async" 0x0 DAQ 0xFF 100 4 0 CONSISTENCY EVENT /end EVENT /begin EVENT "task_1" "task_1" 0x1 DAQ 0xFF 0 0 0 CONSISTENCY EVENT /end EVENT /begin EVENT "task_2" "task_2" 0x2 DAQ 0xFF 0 0 0 CONSISTENCY EVENT /end EVENT /begin EVENT "task_3" "task_3" 0x3 DAQ 0xFF 0 0 0 CONSISTENCY EVENT /end EVENT /begin EVENT "task_4" "task_4" 0x4 DAQ 0xFF 0 0 0 CONSISTENCY EVENT /end EVENT /begin EVENT "task_5" "task_5" 0x5 DAQ 0xFF 0 0 0 CONSISTENCY EVENT /end EVENT /begin EVENT "ctx_1" "ctx_1" 0x6 DAQ 0xFF 0 0 0 CONSISTENCY EVENT /end EVENT /begin EVENT "task_6" "task_6" 0x7 DAQ 0xFF 0 0 0 CONSISTENCY EVENT /end EVENT /begin EVENT "task_7" "task_7" 0x8 DAQ 0xFF 0 0 0 CONSISTENCY EVENT /end EVENT /begin EVENT "task_8" "task_8" 0x9 DAQ 0xFF 0 0 0 CONSISTENCY EVENT /end EVENT /begin EVENT "ctx_3" "ctx_3" 0xA DAQ 0xFF 0 0 0 CONSISTENCY EVENT /end EVENT /begin EVENT "clip" "clip" 0xB DAQ 0xFF 0 0 0 CONSISTENCY EVENT /end EVENT /begin EVENT "ctx_5" "ctx_5" 0xC DAQ 0xFF 0 0 0 CONSISTENCY EVENT /end EVENT /begin EVENT "ctx_6" "ctx_6" 0xD DAQ 0xFF 0 0 0 CONSISTENCY EVENT /end EVENT /begin EVENT "ctx_2" "ctx_2" 0xE DAQ 0xFF 0 0 0 CONSISTENCY EVENT /end EVENT /begin EVENT "ctx_4" "ctx_4" 0xF DAQ 0xFF 0 0 0 CONSISTENCY EVENT /end EVENT /begin EVENT "ctx_7" "ctx_7" 0x10 DAQ 0xFF 0 0 0 CONSISTENCY EVENT /end EVENT /begin EVENT "ctx_8" "ctx_8" 0x11 DAQ 0xFF 0 0 0 CONSISTENCY EVENT /end EVENT /begin EVENT "filter" "filter" 0x12 DAQ 0xFF 0 0 0 CONSISTENCY EVENT /end EVENT /end DAQ
 /begin XCP_ON_UDP_IP 0x104 5555 ADDRESS "192.168.0.101" /end XCP_ON_UDP_IP
/end IF_DATA
/end MODULE
/end PROJECT
