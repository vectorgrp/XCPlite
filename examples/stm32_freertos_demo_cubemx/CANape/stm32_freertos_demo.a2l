/* Created by xcp_client with ELF/DWARF information only, offline mode - 2026-06-12 09:55:26 */ ASAP2_VERSION 1 71
/begin PROJECT project_name ""
/begin HEADER "" VERSION "1.0" PROJECT_NO XCPLITE__ACSDD /end HEADER
/begin MODULE project_name ""
/include "XCP_104.aml"
/begin MOD_COMMON "" BYTE_ORDER MSB_LAST ALIGNMENT_BYTE 1 ALIGNMENT_WORD 1 ALIGNMENT_LONG 1 ALIGNMENT_FLOAT16_IEEE 1 ALIGNMENT_FLOAT32_IEEE 1 ALIGNMENT_FLOAT64_IEEE 1 ALIGNMENT_INT64 1 /end MOD_COMMON
/* Predefined conversion rule for bool */
/begin COMPU_METHOD BOOL "" TAB_VERB "%.0" "" COMPU_TAB_REF BOOL.table /end COMPU_METHOD
/begin COMPU_VTAB BOOL.table "" TAB_VERB 2 0 "false" 1 "true" /end COMPU_VTAB
/* Predefined conversion rule identity with no phys unit and zero decimal places */
/begin COMPU_METHOD IDENTITY "" IDENTICAL "%.0" "" /end COMPU_METHOD
/* Predefined characteristic record layouts for standard types */
/begin RECORD_LAYOUT BOOL FNC_VALUES 1 UBYTE ROW_DIR DIRECT /end RECORD_LAYOUT
/begin RECORD_LAYOUT U8 FNC_VALUES 1 UBYTE ROW_DIR DIRECT /end RECORD_LAYOUT
/begin RECORD_LAYOUT U16 FNC_VALUES 1 UWORD ROW_DIR DIRECT /end RECORD_LAYOUT
/begin RECORD_LAYOUT U32 FNC_VALUES 1 ULONG ROW_DIR DIRECT /end RECORD_LAYOUT
/begin RECORD_LAYOUT U64 FNC_VALUES 1 A_UINT64 ROW_DIR DIRECT /end RECORD_LAYOUT
/begin RECORD_LAYOUT I8 FNC_VALUES 1 SBYTE ROW_DIR DIRECT /end RECORD_LAYOUT
/begin RECORD_LAYOUT I16 FNC_VALUES 1 SWORD ROW_DIR DIRECT /end RECORD_LAYOUT
/begin RECORD_LAYOUT I32 FNC_VALUES 1 SLONG ROW_DIR DIRECT /end RECORD_LAYOUT
/begin RECORD_LAYOUT I64 FNC_VALUES 1 A_INT64 ROW_DIR DIRECT /end RECORD_LAYOUT
/begin RECORD_LAYOUT F32 FNC_VALUES 1 FLOAT32_IEEE ROW_DIR DIRECT /end RECORD_LAYOUT
/begin RECORD_LAYOUT F64 FNC_VALUES 1 FLOAT64_IEEE ROW_DIR DIRECT /end RECORD_LAYOUT
/* Predefined axis record layouts for standard types */
/begin RECORD_LAYOUT A_U8 AXIS_PTS_X 1 UBYTE INDEX_INCR DIRECT /end RECORD_LAYOUT
/begin RECORD_LAYOUT A_U16 AXIS_PTS_X 1 UWORD INDEX_INCR DIRECT /end RECORD_LAYOUT
/begin RECORD_LAYOUT A_U32 AXIS_PTS_X 1 ULONG INDEX_INCR DIRECT /end RECORD_LAYOUT
/begin RECORD_LAYOUT A_U64 AXIS_PTS_X 1 A_UINT64 INDEX_INCR DIRECT /end RECORD_LAYOUT
/begin RECORD_LAYOUT A_I8 AXIS_PTS_X 1 SBYTE INDEX_INCR DIRECT /end RECORD_LAYOUT
/begin RECORD_LAYOUT A_I16 AXIS_PTS_X 1 SWORD INDEX_INCR DIRECT /end RECORD_LAYOUT
/begin RECORD_LAYOUT A_I32 AXIS_PTS_X 1 SLONG INDEX_INCR DIRECT /end RECORD_LAYOUT
/begin RECORD_LAYOUT A_I64 AXIS_PTS_X 1 A_INT64 INDEX_INCR DIRECT /end RECORD_LAYOUT
/begin RECORD_LAYOUT A_F32 AXIS_PTS_X 1 FLOAT32_IEEE INDEX_INCR DIRECT /end RECORD_LAYOUT
/begin RECORD_LAYOUT A_F64 AXIS_PTS_X 1 FLOAT64_IEEE INDEX_INCR DIRECT /end RECORD_LAYOUT
/* Predefined measurement and characteristic typedefs for standard types */
/begin TYPEDEF_MEASUREMENT M_BOOL "" UBYTE BOOL 0 0 0 1 /end TYPEDEF_MEASUREMENT
/begin TYPEDEF_MEASUREMENT M_U8 "" UBYTE NO_COMPU_METHOD 0 0 0 255 /end TYPEDEF_MEASUREMENT
/begin TYPEDEF_MEASUREMENT M_U16 "" UWORD NO_COMPU_METHOD 0 0 0 65535 /end TYPEDEF_MEASUREMENT
/begin TYPEDEF_MEASUREMENT M_U32 "" ULONG NO_COMPU_METHOD 0 0 0 4294967295 /end TYPEDEF_MEASUREMENT
/begin TYPEDEF_MEASUREMENT M_U64 "" A_UINT64 NO_COMPU_METHOD 0 0 0 1e12 /end TYPEDEF_MEASUREMENT
/begin TYPEDEF_MEASUREMENT M_I8 "" SBYTE NO_COMPU_METHOD 0 0 -128 127 /end TYPEDEF_MEASUREMENT
/begin TYPEDEF_MEASUREMENT M_I16 "" SWORD NO_COMPU_METHOD 0 0 -32768 32767 /end TYPEDEF_MEASUREMENT
/begin TYPEDEF_MEASUREMENT M_I32 "" SLONG NO_COMPU_METHOD 0 0 -2147483648 2147483647 /end TYPEDEF_MEASUREMENT
/begin TYPEDEF_MEASUREMENT M_I64 "" A_INT64 NO_COMPU_METHOD 0 0 -1e12 1e12 /end TYPEDEF_MEASUREMENT
/begin TYPEDEF_MEASUREMENT M_F32 "" FLOAT32_IEEE NO_COMPU_METHOD 0 0 -1e12 1e12 /end TYPEDEF_MEASUREMENT
/begin TYPEDEF_MEASUREMENT M_F64 "" FLOAT64_IEEE NO_COMPU_METHOD 0 0 -1e12 1e12 /end TYPEDEF_MEASUREMENT
/begin TYPEDEF_CHARACTERISTIC C_BOOL "" VALUE U8 0 BOOL 0 1 /end TYPEDEF_CHARACTERISTIC
/begin TYPEDEF_CHARACTERISTIC C_U8 "" VALUE U8 0 NO_COMPU_METHOD 0 255 /end TYPEDEF_CHARACTERISTIC
/begin TYPEDEF_CHARACTERISTIC C_U16 "" VALUE U16 0 NO_COMPU_METHOD 0 65535 /end TYPEDEF_CHARACTERISTIC
/begin TYPEDEF_CHARACTERISTIC C_U32 "" VALUE U32 0 NO_COMPU_METHOD 0 4294967295 /end TYPEDEF_CHARACTERISTIC
/begin TYPEDEF_CHARACTERISTIC C_U64 "" VALUE U64 0 NO_COMPU_METHOD 0 1e12 /end TYPEDEF_CHARACTERISTIC
/begin TYPEDEF_CHARACTERISTIC C_I8 "" VALUE I8 0 NO_COMPU_METHOD -128 127 /end TYPEDEF_CHARACTERISTIC
/begin TYPEDEF_CHARACTERISTIC C_I16 "" VALUE I16 0 NO_COMPU_METHOD -32768 32767 /end TYPEDEF_CHARACTERISTIC
/begin TYPEDEF_CHARACTERISTIC C_I32 "" VALUE I32 0 NO_COMPU_METHOD -2147483648 2147483647 /end TYPEDEF_CHARACTERISTIC
/begin TYPEDEF_CHARACTERISTIC C_I64 "" VALUE I64 0 NO_COMPU_METHOD -1e12 1e12 /end TYPEDEF_CHARACTERISTIC
/begin TYPEDEF_CHARACTERISTIC C_F64 "" VALUE F64 0 NO_COMPU_METHOD -1e12 1e12 /end TYPEDEF_CHARACTERISTIC
/begin TYPEDEF_CHARACTERISTIC C_F32 "" VALUE F32 0 NO_COMPU_METHOD -1e12 1e12 /end TYPEDEF_CHARACTERISTIC
/begin MOD_PAR "" EPK "V100" ADDR_EPK 0x24000714
 /begin MEMORY_SEGMENT epk "" DATA FLASH INTERN 0x24000714 4 -1 -1 -1 -1 -1
  /begin IF_DATA XCP
   /begin SEGMENT 0 /*number*/ 2 /*pages*/ 0 /* addr_ext*/ 0 0 /begin CHECKSUM XCP_ADD_44 MAX_BLOCK_SIZE 0xFFFF EXTERNAL_FUNCTION "" /end CHECKSUM
    /begin PAGE 0x0 ECU_ACCESS_DONT_CARE XCP_READ_ACCESS_DONT_CARE XCP_WRITE_ACCESS_DONT_CARE /end PAGE
    /begin PAGE 0x1 ECU_ACCESS_DONT_CARE XCP_READ_ACCESS_DONT_CARE XCP_WRITE_ACCESS_NOT_ALLOWED /end PAGE
   /end SEGMENT
  /end IF_DATA
 /end MEMORY_SEGMENT
 /begin MEMORY_SEGMENT parameters "" DATA FLASH INTERN 0x803B114 16 -1 -1 -1 -1 -1
  /begin IF_DATA XCP
   /begin SEGMENT 1 /*number*/ 2 /*pages*/ 0 /* addr_ext*/ 0 0 /begin CHECKSUM XCP_ADD_44 MAX_BLOCK_SIZE 0xFFFF EXTERNAL_FUNCTION "" /end CHECKSUM
    /begin PAGE 0x0 ECU_ACCESS_DONT_CARE XCP_READ_ACCESS_DONT_CARE XCP_WRITE_ACCESS_DONT_CARE /end PAGE
    /begin PAGE 0x1 ECU_ACCESS_DONT_CARE XCP_READ_ACCESS_DONT_CARE XCP_WRITE_ACCESS_NOT_ALLOWED /end PAGE
   /end SEGMENT
  /end IF_DATA
 /end MEMORY_SEGMENT
/end MOD_PAR
/begin IF_DATA XCP
 /begin PROTOCOL_LAYER 0x0104 1000 2000 0 0 0 0 0 252 1468 BYTE_ORDER_MSB_LAST ADDRESS_GRANULARITY_BYTE OPTIONAL_CMD GET_COMM_MODE_INFO OPTIONAL_CMD GET_ID OPTIONAL_CMD SET_REQUEST OPTIONAL_CMD SET_MTA OPTIONAL_CMD UPLOAD OPTIONAL_CMD SHORT_UPLOAD OPTIONAL_CMD DOWNLOAD OPTIONAL_CMD SHORT_DOWNLOAD OPTIONAL_CMD GET_CAL_PAGE OPTIONAL_CMD SET_CAL_PAGE OPTIONAL_CMD COPY_CAL_PAGE OPTIONAL_CMD BUILD_CHECKSUM OPTIONAL_CMD GET_DAQ_RESOLUTION_INFO OPTIONAL_CMD GET_DAQ_PROCESSOR_INFO OPTIONAL_CMD FREE_DAQ OPTIONAL_CMD ALLOC_DAQ OPTIONAL_CMD ALLOC_ODT OPTIONAL_CMD ALLOC_ODT_ENTRY OPTIONAL_CMD SET_DAQ_PTR OPTIONAL_CMD WRITE_DAQ OPTIONAL_CMD GET_DAQ_LIST_MODE OPTIONAL_CMD SET_DAQ_LIST_MODE OPTIONAL_CMD START_STOP_SYNCH OPTIONAL_CMD START_STOP_DAQ_LIST OPTIONAL_CMD GET_DAQ_CLOCK OPTIONAL_CMD WRITE_DAQ_MULTIPLE OPTIONAL_CMD TIME_CORRELATION_PROPERTIES OPTIONAL_CMD USER_CMD OPTIONAL_LEVEL1_CMD GET_VERSION /end PROTOCOL_LAYER
 /begin DAQ DYNAMIC 0 2 0 OPTIMISATION_TYPE_DEFAULT ADDRESS_EXTENSION_FREE IDENTIFICATION_FIELD_TYPE_RELATIVE_BYTE GRANULARITY_ODT_ENTRY_SIZE_DAQ_BYTE 0xF8 OVERLOAD_INDICATION_PID /begin TIMESTAMP_SUPPORTED 0x1 SIZE_DWORD UNIT_1US TIMESTAMP_FIXED /end TIMESTAMP_SUPPORTED /* compilation unit = 80, function = fastTask, CFA = 0 */ /begin EVENT "fastTask" "fastTask" 0 DAQ 0xFF 0 0 0 CONSISTENCY DAQ /end EVENT /* compilation unit = 80, function = slowTask, CFA = 0 */ /begin EVENT "slowTask" "slowTask" 1 DAQ 0xFF 0 0 0 CONSISTENCY DAQ /end EVENT /end DAQ
 /begin XCP_ON_UDP_IP 0x0104 5555 ADDRESS "192.168.0.207" /end XCP_ON_UDP_IP
/end IF_DATA
/* TypeDefs */
/begin TYPEDEF_MEASUREMENT name "" A_UINT64 IDENTITY 0 0 0 18446744073709552000 /end TYPEDEF_MEASUREMENT
/begin TYPEDEF_MEASUREMENT attr_bits "" ULONG IDENTITY 0 0 0 4294967295 /end TYPEDEF_MEASUREMENT
/begin TYPEDEF_MEASUREMENT cb_mem "" A_UINT64 IDENTITY 0 0 0 18446744073709552000 /end TYPEDEF_MEASUREMENT
/begin TYPEDEF_MEASUREMENT cb_size "" ULONG IDENTITY 0 0 0 4294967295 /end TYPEDEF_MEASUREMENT
/begin TYPEDEF_MEASUREMENT stack_mem "" A_UINT64 IDENTITY 0 0 0 18446744073709552000 /end TYPEDEF_MEASUREMENT
/begin TYPEDEF_MEASUREMENT stack_size "" ULONG IDENTITY 0 0 0 4294967295 /end TYPEDEF_MEASUREMENT
/begin TYPEDEF_MEASUREMENT priority "" SLONG IDENTITY 0 0 -2147483648 2147483647 /end TYPEDEF_MEASUREMENT
/begin TYPEDEF_MEASUREMENT tz_module "" ULONG IDENTITY 0 0 0 4294967295 /end TYPEDEF_MEASUREMENT
/begin TYPEDEF_MEASUREMENT reserved "" ULONG IDENTITY 0 0 0 4294967295 /end TYPEDEF_MEASUREMENT
/begin TYPEDEF_STRUCTURE osThreadAttr_t "" 36 /begin STRUCTURE_COMPONENT name name 0 /end STRUCTURE_COMPONENT /begin STRUCTURE_COMPONENT attr_bits attr_bits 4 /end STRUCTURE_COMPONENT /begin STRUCTURE_COMPONENT cb_mem cb_mem 8 /end STRUCTURE_COMPONENT /begin STRUCTURE_COMPONENT cb_size cb_size 12 /end STRUCTURE_COMPONENT /begin STRUCTURE_COMPONENT stack_mem stack_mem 16 /end STRUCTURE_COMPONENT /begin STRUCTURE_COMPONENT stack_size stack_size 20 /end STRUCTURE_COMPONENT /begin STRUCTURE_COMPONENT priority priority 24 /end STRUCTURE_COMPONENT /begin STRUCTURE_COMPONENT tz_module tz_module 28 /end STRUCTURE_COMPONENT /begin STRUCTURE_COMPONENT reserved reserved 32 /end STRUCTURE_COMPONENT /end TYPEDEF_STRUCTURE
/begin TYPEDEF_CHARACTERISTIC fast_task_period_ms "" VALUE U32 0 IDENTITY 0 4294967295 /end TYPEDEF_CHARACTERISTIC
/begin TYPEDEF_CHARACTERISTIC slow_task_period_ms "" VALUE U32 0 IDENTITY 0 4294967295 /end TYPEDEF_CHARACTERISTIC
/begin TYPEDEF_CHARACTERISTIC counter_max "" VALUE U16 0 IDENTITY 0 65535 /end TYPEDEF_CHARACTERISTIC
/begin TYPEDEF_CHARACTERISTIC amplitude "" VALUE F32 0 NO_COMPU_METHOD -100000000000000000000000000000000 100000000000000000000000000000000 /end TYPEDEF_CHARACTERISTIC
/begin TYPEDEF_STRUCTURE parameters "" 16 /begin STRUCTURE_COMPONENT fast_task_period_ms fast_task_period_ms 0 /end STRUCTURE_COMPONENT /begin STRUCTURE_COMPONENT slow_task_period_ms slow_task_period_ms 4 /end STRUCTURE_COMPONENT /begin STRUCTURE_COMPONENT counter_max counter_max 8 /end STRUCTURE_COMPONENT /begin STRUCTURE_COMPONENT amplitude amplitude 12 /end STRUCTURE_COMPONENT /end TYPEDEF_STRUCTURE
/* Measurements */
/* Measurements for event 'fastTask' */
/begin MEASUREMENT fastTask.counter "" UWORD IDENTITY 0 0 0 65535 ECU_ADDRESS 0xFFFA ECU_ADDRESS_EXTENSION 2
 /begin IF_DATA XCP
  /begin DAQ_EVENT FIXED_EVENT_LIST EVENT 0 /end DAQ_EVENT
 /end IF_DATA
/end MEASUREMENT
/begin INSTANCE fastTaskHandle_attributes "" osThreadAttr_t 0x803B0CC ECU_ADDRESS_EXTENSION 0
 /begin IF_DATA XCP
  /begin DAQ_EVENT FIXED_EVENT_LIST EVENT 0 /end DAQ_EVENT
 /end IF_DATA
/end INSTANCE
/begin INSTANCE slowTaskHandle_attributes "" osThreadAttr_t 0x803B0F0 ECU_ADDRESS_EXTENSION 0
 /begin IF_DATA XCP
  /begin DAQ_EVENT FIXED_EVENT_LIST EVENT 0 /end DAQ_EVENT
 /end IF_DATA
/end INSTANCE
/begin MEASUREMENT global_counter "" UWORD IDENTITY 0 0 0 65535 ECU_ADDRESS 0x2401A33C
 /begin IF_DATA XCP
  /begin DAQ_EVENT FIXED_EVENT_LIST EVENT 0 /end DAQ_EVENT
 /end IF_DATA
/end MEASUREMENT
/begin MEASUREMENT channel1 "" FLOAT32_IEEE NO_COMPU_METHOD 0 0 -100000000000000000000000000000000 100000000000000000000000000000000 ECU_ADDRESS 0x2401A340
 /begin IF_DATA XCP
  /begin DAQ_EVENT FIXED_EVENT_LIST EVENT 0 /end DAQ_EVENT
 /end IF_DATA
/end MEASUREMENT
/begin MEASUREMENT calseg_id_parameters "" UWORD IDENTITY 0 0 0 65535 ECU_ADDRESS 0x24000034
 /begin IF_DATA XCP
  /begin DAQ_EVENT FIXED_EVENT_LIST EVENT 0 /end DAQ_EVENT
 /end IF_DATA
/end MEASUREMENT
/begin MEASUREMENT evt_id_fastTask "" UWORD IDENTITY 0 0 0 65535 ECU_ADDRESS 0x24000036
 /begin IF_DATA XCP
  /begin DAQ_EVENT FIXED_EVENT_LIST EVENT 0 /end DAQ_EVENT
 /end IF_DATA
/end MEASUREMENT
/begin MEASUREMENT fastTaskOverruns "" ULONG IDENTITY 0 0 0 4294967295 ECU_ADDRESS 0x2401A34C
 /begin IF_DATA XCP
  /begin DAQ_EVENT FIXED_EVENT_LIST EVENT 0 /end DAQ_EVENT
 /end IF_DATA
/end MEASUREMENT
/begin MEASUREMENT slowTaskOverruns "" ULONG IDENTITY 0 0 0 4294967295 ECU_ADDRESS 0x2401A350
 /begin IF_DATA XCP
  /begin DAQ_EVENT FIXED_EVENT_LIST EVENT 0 /end DAQ_EVENT
 /end IF_DATA
/end MEASUREMENT
/* Measurements for event 'slowTask' */
/begin MEASUREMENT slowTask.counter "" UWORD IDENTITY 0 0 0 65535 ECU_ADDRESS 0x40FFFA ECU_ADDRESS_EXTENSION 2
 /begin IF_DATA XCP
  /begin DAQ_EVENT FIXED_EVENT_LIST EVENT 1 /end DAQ_EVENT
 /end IF_DATA
/end MEASUREMENT
/begin MEASUREMENT evt_id_slowTask "" UWORD IDENTITY 0 0 0 65535 ECU_ADDRESS 0x2400003A
 /begin IF_DATA XCP
  /begin DAQ_EVENT FIXED_EVENT_LIST EVENT 1 /end DAQ_EVENT
 /end IF_DATA
/end MEASUREMENT
/* Measurements without fixed event */
/begin GROUP Measurements "" ROOT /begin SUB_GROUP fastTask slowTask /end SUB_GROUP /end GROUP
/begin GROUP fastTask ""
 /begin REF_MEASUREMENT fastTask.counter fastTaskHandle_attributes slowTaskHandle_attributes global_counter channel1 calseg_id_parameters evt_id_fastTask fastTaskOverruns slowTaskOverruns /end REF_MEASUREMENT
/end GROUP
/begin GROUP slowTask "" /begin REF_MEASUREMENT slowTask.counter evt_id_slowTask /end REF_MEASUREMENT /end GROUP
/* Axis */
/* Characteristics */
/begin INSTANCE parameters "" parameters 0x803B114 /end INSTANCE
/* Characteristic and Axis Groups */
/begin GROUP Characteristics "" ROOT /begin SUB_GROUP parameters /end SUB_GROUP /end GROUP
/begin GROUP parameters "" /begin REF_CHARACTERISTIC parameters /end REF_CHARACTERISTIC /end GROUP
/end MODULE
/end PROJECT
