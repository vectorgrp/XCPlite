/* xcp_client A2L creator in online+elf/dwarf mode */ ASAP2_VERSION 1 71
/begin PROJECT no_a2l_demo ""
/begin HEADER "" VERSION "1.0" PROJECT_NO _ /end HEADER
/begin MODULE no_a2l_demo ""
/include "XCP_104.aml"
/begin MOD_COMMON "" BYTE_ORDER MSB_LAST ALIGNMENT_BYTE 1 ALIGNMENT_WORD 1 ALIGNMENT_LONG 1 ALIGNMENT_FLOAT16_IEEE 1 ALIGNMENT_FLOAT32_IEEE 1 ALIGNMENT_FLOAT64_IEEE 1 ALIGNMENT_INT64 1 /end MOD_COMMON
/* Predefined conversion rule for bool */
/begin COMPU_METHOD BOOL "" TAB_VERB "%.0" "" COMPU_TAB_REF BOOL.table /end COMPU_METHOD
/begin COMPU_VTAB BOOL.table "" TAB_VERB 2 0 "false" 1 "true" /end COMPU_VTAB
/* Predefined conversion rule identity with no phys unit and zero decimal places */
/begin COMPU_METHOD IDENTITY "" IDENTICAL "%.0" "" /end COMPU_METHOD
/* Predefined characteristic record layouts for standard types */
/begin RECORD_LAYOUT BOOL FNC_VALUES 1 UBYTE ROW_DIR DIRECT /end RECORD_LAYOUT
/begin RECORD_LAYOUT U8 FNC_VALUES 1 UBYTE ROW_DIR DIRECT /end RECORD_LAYOUT
/begin RECORD_LAYOUT U16 FNC_VALUES 1 UWORD ROW_DIR DIRECT /end RECORD_LAYOUT
/begin RECORD_LAYOUT U32 FNC_VALUES 1 ULONG ROW_DIR DIRECT /end RECORD_LAYOUT
/begin RECORD_LAYOUT U64 FNC_VALUES 1 A_UINT64 ROW_DIR DIRECT /end RECORD_LAYOUT
/begin RECORD_LAYOUT I8 FNC_VALUES 1 SBYTE ROW_DIR DIRECT /end RECORD_LAYOUT
/begin RECORD_LAYOUT I16 FNC_VALUES 1 SWORD ROW_DIR DIRECT /end RECORD_LAYOUT
/begin RECORD_LAYOUT I32 FNC_VALUES 1 SLONG ROW_DIR DIRECT /end RECORD_LAYOUT
/begin RECORD_LAYOUT I64 FNC_VALUES 1 A_INT64 ROW_DIR DIRECT /end RECORD_LAYOUT
/begin RECORD_LAYOUT F32 FNC_VALUES 1 FLOAT32_IEEE ROW_DIR DIRECT /end RECORD_LAYOUT
/begin RECORD_LAYOUT F64 FNC_VALUES 1 FLOAT64_IEEE ROW_DIR DIRECT /end RECORD_LAYOUT
/* Predefined axis record layouts for standard types */
/begin RECORD_LAYOUT A_U8 AXIS_PTS_X 1 UBYTE INDEX_INCR DIRECT /end RECORD_LAYOUT
/begin RECORD_LAYOUT A_U16 AXIS_PTS_X 1 UWORD INDEX_INCR DIRECT /end RECORD_LAYOUT
/begin RECORD_LAYOUT A_U32 AXIS_PTS_X 1 ULONG INDEX_INCR DIRECT /end RECORD_LAYOUT
/begin RECORD_LAYOUT A_U64 AXIS_PTS_X 1 A_UINT64 INDEX_INCR DIRECT /end RECORD_LAYOUT
/begin RECORD_LAYOUT A_I8 AXIS_PTS_X 1 SBYTE INDEX_INCR DIRECT /end RECORD_LAYOUT
/begin RECORD_LAYOUT A_I16 AXIS_PTS_X 1 SWORD INDEX_INCR DIRECT /end RECORD_LAYOUT
/begin RECORD_LAYOUT A_I32 AXIS_PTS_X 1 SLONG INDEX_INCR DIRECT /end RECORD_LAYOUT
/begin RECORD_LAYOUT A_I64 AXIS_PTS_X 1 A_INT64 INDEX_INCR DIRECT /end RECORD_LAYOUT
/begin RECORD_LAYOUT A_F32 AXIS_PTS_X 1 FLOAT32_IEEE INDEX_INCR DIRECT /end RECORD_LAYOUT
/begin RECORD_LAYOUT A_F64 AXIS_PTS_X 1 FLOAT64_IEEE INDEX_INCR DIRECT /end RECORD_LAYOUT
/* Predefined measurement and characteristic typedefs for standard types */
/begin TYPEDEF_MEASUREMENT M_BOOL "" UBYTE BOOL 0 0 0 1 /end TYPEDEF_MEASUREMENT
/begin TYPEDEF_MEASUREMENT M_U8 "" UBYTE NO_COMPU_METHOD 0 0 0 255 /end TYPEDEF_MEASUREMENT
/begin TYPEDEF_MEASUREMENT M_U16 "" UWORD NO_COMPU_METHOD 0 0 0 65535 /end TYPEDEF_MEASUREMENT
/begin TYPEDEF_MEASUREMENT M_U32 "" ULONG NO_COMPU_METHOD 0 0 0 4294967295 /end TYPEDEF_MEASUREMENT
/begin TYPEDEF_MEASUREMENT M_U64 "" A_UINT64 NO_COMPU_METHOD 0 0 0 1e12 /end TYPEDEF_MEASUREMENT
/begin TYPEDEF_MEASUREMENT M_I8 "" SBYTE NO_COMPU_METHOD 0 0 -128 127 /end TYPEDEF_MEASUREMENT
/begin TYPEDEF_MEASUREMENT M_I16 "" SWORD NO_COMPU_METHOD 0 0 -32768 32767 /end TYPEDEF_MEASUREMENT
/begin TYPEDEF_MEASUREMENT M_I32 "" SLONG NO_COMPU_METHOD 0 0 -2147483648 2147483647 /end TYPEDEF_MEASUREMENT
/begin TYPEDEF_MEASUREMENT M_I64 "" A_INT64 NO_COMPU_METHOD 0 0 -1e12 1e12 /end TYPEDEF_MEASUREMENT
/begin TYPEDEF_MEASUREMENT M_F32 "" FLOAT32_IEEE NO_COMPU_METHOD 0 0 -1e12 1e12 /end TYPEDEF_MEASUREMENT
/begin TYPEDEF_MEASUREMENT M_F64 "" FLOAT64_IEEE NO_COMPU_METHOD 0 0 -1e12 1e12 /end TYPEDEF_MEASUREMENT
/begin TYPEDEF_CHARACTERISTIC C_BOOL "" VALUE U8 0 BOOL 0 1 /end TYPEDEF_CHARACTERISTIC
/begin TYPEDEF_CHARACTERISTIC C_U8 "" VALUE U8 0 NO_COMPU_METHOD 0 255 /end TYPEDEF_CHARACTERISTIC
/begin TYPEDEF_CHARACTERISTIC C_U16 "" VALUE U16 0 NO_COMPU_METHOD 0 65535 /end TYPEDEF_CHARACTERISTIC
/begin TYPEDEF_CHARACTERISTIC C_U32 "" VALUE U32 0 NO_COMPU_METHOD 0 4294967295 /end TYPEDEF_CHARACTERISTIC
/begin TYPEDEF_CHARACTERISTIC C_U64 "" VALUE U64 0 NO_COMPU_METHOD 0 1e12 /end TYPEDEF_CHARACTERISTIC
/begin TYPEDEF_CHARACTERISTIC C_I8 "" VALUE I8 0 NO_COMPU_METHOD -128 127 /end TYPEDEF_CHARACTERISTIC
/begin TYPEDEF_CHARACTERISTIC C_I16 "" VALUE I16 0 NO_COMPU_METHOD -32768 32767 /end TYPEDEF_CHARACTERISTIC
/begin TYPEDEF_CHARACTERISTIC C_I32 "" VALUE I32 0 NO_COMPU_METHOD -2147483648 2147483647 /end TYPEDEF_CHARACTERISTIC
/begin TYPEDEF_CHARACTERISTIC C_I64 "" VALUE I64 0 NO_COMPU_METHOD -1e12 1e12 /end TYPEDEF_CHARACTERISTIC
/begin TYPEDEF_CHARACTERISTIC C_F64 "" VALUE F64 0 NO_COMPU_METHOD -1e12 1e12 /end TYPEDEF_CHARACTERISTIC
/begin TYPEDEF_CHARACTERISTIC C_F32 "" VALUE F32 0 NO_COMPU_METHOD -1e12 1e12 /end TYPEDEF_CHARACTERISTIC
/begin MOD_PAR ""
 /begin MEMORY_SEGMENT params "" DATA FLASH INTERN 0x10DD0 48 -1 -1 -1 -1 -1
  /begin IF_DATA XCP
   /begin SEGMENT 0 2 0 0 0 /begin CHECKSUM XCP_ADD_44 MAX_BLOCK_SIZE 0xFFFF EXTERNAL_FUNCTION "" /end CHECKSUM
    /begin PAGE 0x0 ECU_ACCESS_DONT_CARE XCP_READ_ACCESS_DONT_CARE XCP_WRITE_ACCESS_DONT_CARE /end PAGE
    /begin PAGE 0x1 ECU_ACCESS_DONT_CARE XCP_READ_ACCESS_DONT_CARE XCP_WRITE_ACCESS_NOT_ALLOWED /end PAGE
   /end SEGMENT
  /end IF_DATA
 /end MEMORY_SEGMENT
/end MOD_PAR
/begin IF_DATA XCP
 /begin PROTOCOL_LAYER 0x104 1000 2000 0 0 0 0 0 252 1468 BYTE_ORDER_MSB_LAST ADDRESS_GRANULARITY_BYTE OPTIONAL_CMD GET_COMM_MODE_INFO OPTIONAL_CMD GET_ID OPTIONAL_CMD SET_REQUEST OPTIONAL_CMD SET_MTA OPTIONAL_CMD UPLOAD OPTIONAL_CMD SHORT_UPLOAD OPTIONAL_CMD DOWNLOAD OPTIONAL_CMD SHORT_DOWNLOAD OPTIONAL_CMD GET_CAL_PAGE OPTIONAL_CMD SET_CAL_PAGE OPTIONAL_CMD COPY_CAL_PAGE OPTIONAL_CMD BUILD_CHECKSUM OPTIONAL_CMD GET_DAQ_RESOLUTION_INFO OPTIONAL_CMD GET_DAQ_PROCESSOR_INFO OPTIONAL_CMD FREE_DAQ OPTIONAL_CMD ALLOC_DAQ OPTIONAL_CMD ALLOC_ODT OPTIONAL_CMD ALLOC_ODT_ENTRY OPTIONAL_CMD SET_DAQ_PTR OPTIONAL_CMD WRITE_DAQ OPTIONAL_CMD GET_DAQ_LIST_MODE OPTIONAL_CMD SET_DAQ_LIST_MODE OPTIONAL_CMD START_STOP_SYNCH OPTIONAL_CMD START_STOP_DAQ_LIST OPTIONAL_CMD GET_DAQ_CLOCK OPTIONAL_CMD WRITE_DAQ_MULTIPLE OPTIONAL_CMD TIME_CORRELATION_PROPERTIES OPTIONAL_CMD USER_CMD OPTIONAL_LEVEL1_CMD GET_VERSION /end PROTOCOL_LAYER
 /begin DAQ DYNAMIC 0 4 0 OPTIMISATION_TYPE_DEFAULT ADDRESS_EXTENSION_FREE IDENTIFICATION_FIELD_TYPE_RELATIVE_BYTE GRANULARITY_ODT_ENTRY_SIZE_DAQ_BYTE 0xF8 OVERLOAD_INDICATION_PID /begin TIMESTAMP_SUPPORTED 0x1 SIZE_DWORD UNIT_1US TIMESTAMP_FIXED /end TIMESTAMP_SUPPORTED /begin EVENT "async" "async" 0 DAQ 0xFF 0 0 0 CONSISTENCY DAQ /end EVENT /* compilation unit = 0, function = main, CFA = 80 */ /begin EVENT "mainloop" "mainloop" 1 DAQ 0xFF 0 0 0 CONSISTENCY DAQ /end EVENT /* compilation unit = 0, function = task, CFA = 96 */ /begin EVENT "task" "task" 2 DAQ 0xFF 0 0 0 CONSISTENCY DAQ /end EVENT /* compilation unit = 0, function = foo, CFA = 112 */ /begin EVENT "foo" "foo" 3 DAQ 0xFF 0 0 0 CONSISTENCY DAQ /end EVENT /end DAQ
 /begin XCP_ON_TCP_IP 0x104 5555 ADDRESS "192.168.0.206" /end XCP_ON_TCP_IP
/end IF_DATA
/* TypeDefs */
/begin TYPEDEF_CHARACTERISTIC counter_max "" VALUE U16 0 IDENTITY 0 65535 /end TYPEDEF_CHARACTERISTIC
/begin TYPEDEF_CHARACTERISTIC delay_us "" VALUE U32 0 IDENTITY 0 4294967295 /end TYPEDEF_CHARACTERISTIC
/begin TYPEDEF_CHARACTERISTIC test_par_uint8_array "" VAL_BLK U8 0 IDENTITY 0 255 MATRIX_DIM 10 /end TYPEDEF_CHARACTERISTIC
/begin TYPEDEF_CHARACTERISTIC test_par_double "" VALUE F64 0 NO_COMPU_METHOD -100000000000000000000000000000000 100000000000000000000000000000000 /end TYPEDEF_CHARACTERISTIC
/begin TYPEDEF_CHARACTERISTIC test_par_enum "" VALUE U32 0 IDENTITY 0 4294967295 /end TYPEDEF_CHARACTERISTIC
/begin TYPEDEF_CHARACTERISTIC test_field_uint16 "" VALUE U16 0 IDENTITY 0 65535 /end TYPEDEF_CHARACTERISTIC
/begin TYPEDEF_CHARACTERISTIC test_field_int16 "" VALUE I16 0 IDENTITY -32768 32767 /end TYPEDEF_CHARACTERISTIC
/begin TYPEDEF_CHARACTERISTIC test_field_float "" VALUE F32 0 NO_COMPU_METHOD -100000000000000000000000000000000 100000000000000000000000000000000 /end TYPEDEF_CHARACTERISTIC
/begin TYPEDEF_CHARACTERISTIC test_field_uint8_array "" VAL_BLK U8 0 IDENTITY 0 255 MATRIX_DIM 3 /end TYPEDEF_CHARACTERISTIC
/begin TYPEDEF_STRUCTURE test_par_struct "" 12 /begin STRUCTURE_COMPONENT test_field_uint16 test_field_uint16 0 /end STRUCTURE_COMPONENT /begin STRUCTURE_COMPONENT test_field_int16 test_field_int16 2 /end STRUCTURE_COMPONENT /begin STRUCTURE_COMPONENT test_field_float test_field_float 4 /end STRUCTURE_COMPONENT /begin STRUCTURE_COMPONENT test_field_uint8_array test_field_uint8_array 8 /end STRUCTURE_COMPONENT /end TYPEDEF_STRUCTURE
/begin TYPEDEF_STRUCTURE params "" 48 /begin STRUCTURE_COMPONENT counter_max counter_max 0 /end STRUCTURE_COMPONENT /begin STRUCTURE_COMPONENT delay_us delay_us 4 /end STRUCTURE_COMPONENT /begin STRUCTURE_COMPONENT test_par_uint8_array test_par_uint8_array 8 /end STRUCTURE_COMPONENT /begin STRUCTURE_COMPONENT test_par_double test_par_double 24 /end STRUCTURE_COMPONENT /begin STRUCTURE_COMPONENT test_par_enum test_par_enum 32 /end STRUCTURE_COMPONENT /begin STRUCTURE_COMPONENT test_par_struct test_par_struct 36 /end STRUCTURE_COMPONENT /end TYPEDEF_STRUCTURE
/begin TYPEDEF_MEASUREMENT a "" UWORD IDENTITY 0 0 0 65535 /end TYPEDEF_MEASUREMENT
/begin TYPEDEF_MEASUREMENT b "" SWORD IDENTITY 0 0 -32768 32767 /end TYPEDEF_MEASUREMENT
/begin TYPEDEF_MEASUREMENT f "" FLOAT32_IEEE NO_COMPU_METHOD 0 0 -100000000000000000000000000000000 100000000000000000000000000000000 /end TYPEDEF_MEASUREMENT
/begin TYPEDEF_MEASUREMENT d "" UBYTE IDENTITY 0 0 0 255 MATRIX_DIM 3 /end TYPEDEF_MEASUREMENT
/begin TYPEDEF_STRUCTURE test_struct "" 12 /begin STRUCTURE_COMPONENT a a 0 /end STRUCTURE_COMPONENT /begin STRUCTURE_COMPONENT b b 2 /end STRUCTURE_COMPONENT /begin STRUCTURE_COMPONENT f f 4 /end STRUCTURE_COMPONENT /begin STRUCTURE_COMPONENT d d 8 /end STRUCTURE_COMPONENT /end TYPEDEF_STRUCTURE
/* Measurements */
/* Measurements for event 'async' */
/begin MEASUREMENT global_running "" UBYTE IDENTITY 0 0 0 255 ECU_ADDRESS 0x30218
 /begin IF_DATA XCP
  /begin DAQ_EVENT FIXED_EVENT_LIST EVENT 0 /end DAQ_EVENT
 /end IF_DATA
/end MEASUREMENT
/begin MEASUREMENT global_counter "" UWORD IDENTITY 0 0 0 65535 ECU_ADDRESS 0x3026A
 /begin IF_DATA XCP
  /begin DAQ_EVENT FIXED_EVENT_LIST EVENT 0 /end DAQ_EVENT
 /end IF_DATA
/end MEASUREMENT
/begin MEASUREMENT global_test_uint8 "" UBYTE IDENTITY 0 0 0 255 ECU_ADDRESS 0x30219
 /begin IF_DATA XCP
  /begin DAQ_EVENT FIXED_EVENT_LIST EVENT 0 /end DAQ_EVENT
 /end IF_DATA
/end MEASUREMENT
/begin MEASUREMENT global_test_uint16 "" UWORD IDENTITY 0 0 0 65535 ECU_ADDRESS 0x3021A
 /begin IF_DATA XCP
  /begin DAQ_EVENT FIXED_EVENT_LIST EVENT 0 /end DAQ_EVENT
 /end IF_DATA
/end MEASUREMENT
/begin MEASUREMENT global_test_uint32 "" ULONG IDENTITY 0 0 0 4294967295 ECU_ADDRESS 0x3021C
 /begin IF_DATA XCP
  /begin DAQ_EVENT FIXED_EVENT_LIST EVENT 0 /end DAQ_EVENT
 /end IF_DATA
/end MEASUREMENT
/begin MEASUREMENT global_test_uint64 "" A_UINT64 IDENTITY 0 0 0 18446744073709552000 ECU_ADDRESS 0x30220
 /begin IF_DATA XCP
  /begin DAQ_EVENT FIXED_EVENT_LIST EVENT 0 /end DAQ_EVENT
 /end IF_DATA
/end MEASUREMENT
/begin MEASUREMENT global_test_int8 "" SBYTE IDENTITY 0 0 -128 127 ECU_ADDRESS 0x30228
 /begin IF_DATA XCP
  /begin DAQ_EVENT FIXED_EVENT_LIST EVENT 0 /end DAQ_EVENT
 /end IF_DATA
/end MEASUREMENT
/begin MEASUREMENT global_test_int16 "" SWORD IDENTITY 0 0 -32768 32767 ECU_ADDRESS 0x3022A
 /begin IF_DATA XCP
  /begin DAQ_EVENT FIXED_EVENT_LIST EVENT 0 /end DAQ_EVENT
 /end IF_DATA
/end MEASUREMENT
/begin MEASUREMENT global_test_int32 "" SLONG IDENTITY 0 0 -2147483648 2147483647 ECU_ADDRESS 0x3022C
 /begin IF_DATA XCP
  /begin DAQ_EVENT FIXED_EVENT_LIST EVENT 0 /end DAQ_EVENT
 /end IF_DATA
/end MEASUREMENT
/begin MEASUREMENT global_test_int64 "" A_INT64 IDENTITY 0 0 -9223372036854776000 9223372036854776000 ECU_ADDRESS 0x30230
 /begin IF_DATA XCP
  /begin DAQ_EVENT FIXED_EVENT_LIST EVENT 0 /end DAQ_EVENT
 /end IF_DATA
/end MEASUREMENT
/begin MEASUREMENT global_test_float "" FLOAT32_IEEE NO_COMPU_METHOD 0 0 -100000000000000000000000000000000 100000000000000000000000000000000 ECU_ADDRESS 0x30238
 /begin IF_DATA XCP
  /begin DAQ_EVENT FIXED_EVENT_LIST EVENT 0 /end DAQ_EVENT
 /end IF_DATA
/end MEASUREMENT
/begin MEASUREMENT global_test_double "" FLOAT64_IEEE NO_COMPU_METHOD 0 0 -100000000000000000000000000000000 100000000000000000000000000000000 ECU_ADDRESS 0x30240
 /begin IF_DATA XCP
  /begin DAQ_EVENT FIXED_EVENT_LIST EVENT 0 /end DAQ_EVENT
 /end IF_DATA
/end MEASUREMENT
/begin MEASUREMENT global_test_array "" UBYTE IDENTITY 0 0 0 255 ECU_ADDRESS 0x30248 MATRIX_DIM 3
 /begin IF_DATA XCP
  /begin DAQ_EVENT FIXED_EVENT_LIST EVENT 0 /end DAQ_EVENT
 /end IF_DATA
/end MEASUREMENT
/begin INSTANCE global_test_struct "" test_struct 0x30250 ECU_ADDRESS_EXTENSION 0
 /begin IF_DATA XCP
  /begin DAQ_EVENT FIXED_EVENT_LIST EVENT 0 /end DAQ_EVENT
 /end IF_DATA
/end INSTANCE
/* Measurements for event 'mainloop' */
/begin MEASUREMENT main.counter "" ULONG IDENTITY 0 0 0 4294967295 ECU_ADDRESS 0x1004C ECU_ADDRESS_EXTENSION 2 READ_WRITE
 /begin IF_DATA XCP
  /begin DAQ_EVENT FIXED_EVENT_LIST EVENT 1 /end DAQ_EVENT
 /end IF_DATA
/end MEASUREMENT
/begin MEASUREMENT main.static_counter "" UWORD IDENTITY 0 0 0 65535 ECU_ADDRESS 0x30272
 /begin IF_DATA XCP
  /begin DAQ_EVENT FIXED_EVENT_LIST EVENT 1 /end DAQ_EVENT
 /end IF_DATA
/end MEASUREMENT
/begin MEASUREMENT main.delay_us "" ULONG IDENTITY 0 0 0 4294967295 ECU_ADDRESS 0x1003C ECU_ADDRESS_EXTENSION 2 READ_WRITE
 /begin IF_DATA XCP
  /begin DAQ_EVENT FIXED_EVENT_LIST EVENT 1 /end DAQ_EVENT
 /end IF_DATA
/end MEASUREMENT
/* Measurements for event 'task' */
/begin MEASUREMENT task.counter "" ULONG IDENTITY 0 0 0 4294967295 ECU_ADDRESS 0x2005C ECU_ADDRESS_EXTENSION 2 READ_WRITE
 /begin IF_DATA XCP
  /begin DAQ_EVENT FIXED_EVENT_LIST EVENT 2 /end DAQ_EVENT
 /end IF_DATA
/end MEASUREMENT
/begin MEASUREMENT task.static_counter "" UWORD IDENTITY 0 0 0 65535 ECU_ADDRESS 0x3026C
 /begin IF_DATA XCP
  /begin DAQ_EVENT FIXED_EVENT_LIST EVENT 2 /end DAQ_EVENT
 /end IF_DATA
/end MEASUREMENT
/begin MEASUREMENT task.spilled_counter "" ULONG IDENTITY 0 0 0 4294967295 ECU_ADDRESS 0x2004C ECU_ADDRESS_EXTENSION 2 READ_WRITE
 /begin IF_DATA XCP
  /begin DAQ_EVENT FIXED_EVENT_LIST EVENT 2 /end DAQ_EVENT
 /end IF_DATA
/end MEASUREMENT
/begin MEASUREMENT task.thread_local_counter "" UWORD IDENTITY 0 0 0 65535 ECU_ADDRESS 0x3026E
 /begin IF_DATA XCP
  /begin DAQ_EVENT FIXED_EVENT_LIST EVENT 2 /end DAQ_EVENT
 /end IF_DATA
/end MEASUREMENT
/* Measurements for event 'foo' */
/begin MEASUREMENT foo.counter "" ULONG IDENTITY 0 0 0 4294967295 ECU_ADDRESS 0x3006C ECU_ADDRESS_EXTENSION 2 READ_WRITE
 /begin IF_DATA XCP
  /begin DAQ_EVENT FIXED_EVENT_LIST EVENT 3 /end DAQ_EVENT
 /end IF_DATA
/end MEASUREMENT
/begin MEASUREMENT foo.static_counter "" UWORD IDENTITY 0 0 0 65535 ECU_ADDRESS 0x30270
 /begin IF_DATA XCP
  /begin DAQ_EVENT FIXED_EVENT_LIST EVENT 3 /end DAQ_EVENT
 /end IF_DATA
/end MEASUREMENT
/begin MEASUREMENT foo.test_float "" FLOAT32_IEEE NO_COMPU_METHOD 0 0 -100000000000000000000000000000000 100000000000000000000000000000000 ECU_ADDRESS 0x30068 ECU_ADDRESS_EXTENSION 2 READ_WRITE
 /begin IF_DATA XCP
  /begin DAQ_EVENT FIXED_EVENT_LIST EVENT 3 /end DAQ_EVENT
 /end IF_DATA
/end MEASUREMENT
/begin MEASUREMENT foo.test_double "" FLOAT64_IEEE NO_COMPU_METHOD 0 0 -100000000000000000000000000000000 100000000000000000000000000000000 ECU_ADDRESS 0x30060 ECU_ADDRESS_EXTENSION 2 READ_WRITE
 /begin IF_DATA XCP
  /begin DAQ_EVENT FIXED_EVENT_LIST EVENT 3 /end DAQ_EVENT
 /end IF_DATA
/end MEASUREMENT
/begin MEASUREMENT foo.test_uint8 "" UBYTE IDENTITY 0 0 0 255 ECU_ADDRESS 0x3005F ECU_ADDRESS_EXTENSION 2 READ_WRITE
 /begin IF_DATA XCP
  /begin DAQ_EVENT FIXED_EVENT_LIST EVENT 3 /end DAQ_EVENT
 /end IF_DATA
/end MEASUREMENT
/begin MEASUREMENT foo.test_uint16 "" UWORD IDENTITY 0 0 0 65535 ECU_ADDRESS 0x3005C ECU_ADDRESS_EXTENSION 2 READ_WRITE
 /begin IF_DATA XCP
  /begin DAQ_EVENT FIXED_EVENT_LIST EVENT 3 /end DAQ_EVENT
 /end IF_DATA
/end MEASUREMENT
/begin MEASUREMENT foo.test_uint32 "" ULONG IDENTITY 0 0 0 4294967295 ECU_ADDRESS 0x30058 ECU_ADDRESS_EXTENSION 2 READ_WRITE
 /begin IF_DATA XCP
  /begin DAQ_EVENT FIXED_EVENT_LIST EVENT 3 /end DAQ_EVENT
 /end IF_DATA
/end MEASUREMENT
/begin MEASUREMENT foo.test_uint64 "" A_UINT64 IDENTITY 0 0 0 18446744073709552000 ECU_ADDRESS 0x30050 ECU_ADDRESS_EXTENSION 2 READ_WRITE
 /begin IF_DATA XCP
  /begin DAQ_EVENT FIXED_EVENT_LIST EVENT 3 /end DAQ_EVENT
 /end IF_DATA
/end MEASUREMENT
/begin MEASUREMENT foo.test_int8 "" SBYTE IDENTITY 0 0 -128 127 ECU_ADDRESS 0x3004F ECU_ADDRESS_EXTENSION 2 READ_WRITE
 /begin IF_DATA XCP
  /begin DAQ_EVENT FIXED_EVENT_LIST EVENT 3 /end DAQ_EVENT
 /end IF_DATA
/end MEASUREMENT
/begin MEASUREMENT foo.test_int16 "" SWORD IDENTITY 0 0 -32768 32767 ECU_ADDRESS 0x3004C ECU_ADDRESS_EXTENSION 2 READ_WRITE
 /begin IF_DATA XCP
  /begin DAQ_EVENT FIXED_EVENT_LIST EVENT 3 /end DAQ_EVENT
 /end IF_DATA
/end MEASUREMENT
/begin MEASUREMENT foo.test_int32 "" SLONG IDENTITY 0 0 -2147483648 2147483647 ECU_ADDRESS 0x30048 ECU_ADDRESS_EXTENSION 2 READ_WRITE
 /begin IF_DATA XCP
  /begin DAQ_EVENT FIXED_EVENT_LIST EVENT 3 /end DAQ_EVENT
 /end IF_DATA
/end MEASUREMENT
/begin MEASUREMENT foo.test_int64 "" A_UINT64 IDENTITY 0 0 0 18446744073709552000 ECU_ADDRESS 0x30040 ECU_ADDRESS_EXTENSION 2 READ_WRITE
 /begin IF_DATA XCP
  /begin DAQ_EVENT FIXED_EVENT_LIST EVENT 3 /end DAQ_EVENT
 /end IF_DATA
/end MEASUREMENT
/begin INSTANCE foo.test_struct "" test_struct 0x30030 ECU_ADDRESS_EXTENSION 2
 /begin IF_DATA XCP
  /begin DAQ_EVENT FIXED_EVENT_LIST EVENT 3 /end DAQ_EVENT
 /end IF_DATA
/end INSTANCE
/* Measurements without fixed event */
/begin GROUP Measurements "" ROOT /begin SUB_GROUP async mainloop task foo /end SUB_GROUP /end GROUP
/begin GROUP async ""
 /begin REF_MEASUREMENT global_running global_counter global_test_uint8 global_test_uint16 global_test_uint32 global_test_uint64 global_test_int8 global_test_int16 global_test_int32 global_test_int64 global_test_float global_test_double global_test_array global_test_struct /end REF_MEASUREMENT
/end GROUP
/begin GROUP mainloop "" /begin REF_MEASUREMENT main.counter main.static_counter main.delay_us /end REF_MEASUREMENT /end GROUP
/begin GROUP task ""
 /begin REF_MEASUREMENT task.counter task.static_counter task.spilled_counter task.thread_local_counter /end REF_MEASUREMENT
/end GROUP
/begin GROUP foo ""
 /begin REF_MEASUREMENT foo.counter foo.static_counter foo.test_float foo.test_double foo.test_uint8 foo.test_uint16 foo.test_uint32 foo.test_uint64 foo.test_int8 foo.test_int16 foo.test_int32 foo.test_int64 foo.test_struct /end REF_MEASUREMENT
/end GROUP
/* Axis */
/* Characteristics */
/begin INSTANCE params "" params 0x10DD0 /end INSTANCE
/* Characteristic and Axis Groups */
/begin GROUP Characteristics "" ROOT /begin SUB_GROUP params /end SUB_GROUP /end GROUP
/end MODULE
/end PROJECT
