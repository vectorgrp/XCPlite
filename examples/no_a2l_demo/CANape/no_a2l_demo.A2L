/* generated by ASAP2 Studio 19.0.30.87 */
/* a2ltool 3.0.0 */ ASAP2_VERSION 1 71
/begin PROJECT new_project "description of project"
/begin MODULE new_module ""
/begin MOD_PAR "" /end MOD_PAR
/begin MOD_COMMON "" ALIGNMENT_BYTE 1 ALIGNMENT_WORD 1 ALIGNMENT_LONG 1 ALIGNMENT_FLOAT16_IEEE 1 ALIGNMENT_FLOAT32_IEEE 1 ALIGNMENT_FLOAT64_IEEE 1 ALIGNMENT_INT64 1 /end MOD_COMMON
/begin IF_DATA XCP
 /begin PROTOCOL_LAYER 0x0104 0x07D0 0x2710 0x00 0x00 0x00 0x00 0x00 0xF8 0x0400 BYTE_ORDER_MSB_LAST ADDRESS_GRANULARITY_BYTE OPTIONAL_CMD TIME_CORRELATION_PROPERTIES OPTIONAL_CMD ALLOC_ODT_ENTRY OPTIONAL_CMD ALLOC_ODT OPTIONAL_CMD ALLOC_DAQ OPTIONAL_CMD FREE_DAQ OPTIONAL_CMD GET_DAQ_EVENT_INFO OPTIONAL_CMD GET_DAQ_RESOLUTION_INFO OPTIONAL_CMD GET_DAQ_PROCESSOR_INFO OPTIONAL_CMD GET_DAQ_CLOCK OPTIONAL_CMD START_STOP_SYNCH OPTIONAL_CMD START_STOP_DAQ_LIST OPTIONAL_CMD GET_DAQ_LIST_MODE OPTIONAL_CMD SET_DAQ_LIST_MODE OPTIONAL_CMD WRITE_DAQ OPTIONAL_CMD SET_DAQ_PTR OPTIONAL_CMD CLEAR_DAQ_LIST OPTIONAL_CMD DOWNLOAD OPTIONAL_CMD SHORT_UPLOAD OPTIONAL_CMD UPLOAD OPTIONAL_CMD SET_MTA OPTIONAL_CMD GET_ID OPTIONAL_CMD GET_COMM_MODE_INFO OPTIONAL_LEVEL1_CMD GET_VERSION /end PROTOCOL_LAYER
 /begin DAQ DYNAMIC 0x00 0x02 0x00 OPTIMISATION_TYPE_DEFAULT ADDRESS_EXTENSION_FREE IDENTIFICATION_FIELD_TYPE_RELATIVE_WORD_ALIGNED GRANULARITY_ODT_ENTRY_SIZE_DAQ_BYTE 0xF8 NO_OVERLOAD_INDICATION PRESCALER_SUPPORTED /begin TIMESTAMP_SUPPORTED 0x01 SIZE_DWORD UNIT_1NS TIMESTAMP_FIXED /end TIMESTAMP_SUPPORTED /begin EVENT "async" "async" 0x00 DAQ 0xFF 0x64 0x04 0x00 /end EVENT /begin EVENT "mainloop" "mainloop" 0x01 DAQ 0xFF 0x00 0x00 0x00 /end EVENT /end DAQ
 /begin PAG 0x00 /end PAG
 /begin PGM PGM_MODE_ABSOLUTE 0x00 0x00 /end PGM
 /begin XCP_ON_TCP_IP 0x0104 0x15B3 ADDRESS "192.168.0.206" /end XCP_ON_TCP_IP
/end IF_DATA
/begin TYPEDEF_CHARACTERISTIC Parameter_ULong "" VALUE __ULong_Value 0 NO_COMPU_METHOD 0 4294967295 /end TYPEDEF_CHARACTERISTIC
/begin TYPEDEF_CHARACTERISTIC Parameter_UWord "" VALUE __UWord_Value 0 NO_COMPU_METHOD 0 65535 /end TYPEDEF_CHARACTERISTIC
/begin TYPEDEF_STRUCTURE params "" 0x8 SYMBOL_TYPE_LINK "params"
 /begin STRUCTURE_COMPONENT counter_max Parameter_UWord 0 SYMBOL_TYPE_LINK "counter_max" /end STRUCTURE_COMPONENT
 /begin STRUCTURE_COMPONENT delay_us Parameter_ULong 4 SYMBOL_TYPE_LINK "delay_us" /end STRUCTURE_COMPONENT
/end TYPEDEF_STRUCTURE
/begin MEASUREMENT counter "" UWORD NO_COMPU_METHOD 0 0 0 65535 ECU_ADDRESS 0x30212 /end MEASUREMENT
/begin INSTANCE params "" params 0x10890 SYMBOL_LINK "params" 0 /end INSTANCE
/begin RECORD_LAYOUT __ULong_Value FNC_VALUES 1 ULONG ROW_DIR DIRECT /end RECORD_LAYOUT
/begin RECORD_LAYOUT __UWord_Value FNC_VALUES 1 UWORD ROW_DIR DIRECT /end RECORD_LAYOUT
/end MODULE
/end PROJECT
