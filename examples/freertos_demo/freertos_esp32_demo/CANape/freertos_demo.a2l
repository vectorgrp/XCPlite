/* Created by xcp_client with ELF/DWARF information only, offline mode - 2026-09-09 21:31:05 */ ASAP2_VERSION 1 71
/begin PROJECT project_name ""
/begin HEADER "" VERSION "1.0" PROJECT_NO XCPLITE__ACSDD /end HEADER
/begin MODULE project_name ""
/include "XCP_104.aml"
/begin MOD_COMMON "" BYTE_ORDER MSB_LAST ALIGNMENT_BYTE 1 ALIGNMENT_WORD 1 ALIGNMENT_LONG 1 ALIGNMENT_FLOAT16_IEEE 1 ALIGNMENT_FLOAT32_IEEE 1 ALIGNMENT_FLOAT64_IEEE 1 ALIGNMENT_INT64 1 /end MOD_COMMON
/* Predefined conversion rule for bool */
/begin COMPU_METHOD BOOL "" TAB_VERB "%.0" "" COMPU_TAB_REF BOOL.table /end COMPU_METHOD
/begin COMPU_VTAB BOOL.table "" TAB_VERB 2 0 "false" 1 "true" /end COMPU_VTAB
/* Predefined conversion rule identity with no phys unit and zero decimal places */
/begin COMPU_METHOD IDENTITY "" IDENTICAL "%.0" "" /end COMPU_METHOD
/* Predefined characteristic record layouts for standard types */
/begin RECORD_LAYOUT BOOL FNC_VALUES 1 UBYTE ROW_DIR DIRECT /end RECORD_LAYOUT
/begin RECORD_LAYOUT U8 FNC_VALUES 1 UBYTE ROW_DIR DIRECT /end RECORD_LAYOUT
/begin RECORD_LAYOUT U16 FNC_VALUES 1 UWORD ROW_DIR DIRECT /end RECORD_LAYOUT
/begin RECORD_LAYOUT U32 FNC_VALUES 1 ULONG ROW_DIR DIRECT /end RECORD_LAYOUT
/begin RECORD_LAYOUT U64 FNC_VALUES 1 A_UINT64 ROW_DIR DIRECT /end RECORD_LAYOUT
/begin RECORD_LAYOUT I8 FNC_VALUES 1 SBYTE ROW_DIR DIRECT /end RECORD_LAYOUT
/begin RECORD_LAYOUT I16 FNC_VALUES 1 SWORD ROW_DIR DIRECT /end RECORD_LAYOUT
/begin RECORD_LAYOUT I32 FNC_VALUES 1 SLONG ROW_DIR DIRECT /end RECORD_LAYOUT
/begin RECORD_LAYOUT I64 FNC_VALUES 1 A_INT64 ROW_DIR DIRECT /end RECORD_LAYOUT
/begin RECORD_LAYOUT F32 FNC_VALUES 1 FLOAT32_IEEE ROW_DIR DIRECT /end RECORD_LAYOUT
/begin RECORD_LAYOUT F64 FNC_VALUES 1 FLOAT64_IEEE ROW_DIR DIRECT /end RECORD_LAYOUT
/* Predefined axis record layouts for standard types */
/begin RECORD_LAYOUT A_U8 AXIS_PTS_X 1 UBYTE INDEX_INCR DIRECT /end RECORD_LAYOUT
/begin RECORD_LAYOUT A_U16 AXIS_PTS_X 1 UWORD INDEX_INCR DIRECT /end RECORD_LAYOUT
/begin RECORD_LAYOUT A_U32 AXIS_PTS_X 1 ULONG INDEX_INCR DIRECT /end RECORD_LAYOUT
/begin RECORD_LAYOUT A_U64 AXIS_PTS_X 1 A_UINT64 INDEX_INCR DIRECT /end RECORD_LAYOUT
/begin RECORD_LAYOUT A_I8 AXIS_PTS_X 1 SBYTE INDEX_INCR DIRECT /end RECORD_LAYOUT
/begin RECORD_LAYOUT A_I16 AXIS_PTS_X 1 SWORD INDEX_INCR DIRECT /end RECORD_LAYOUT
/begin RECORD_LAYOUT A_I32 AXIS_PTS_X 1 SLONG INDEX_INCR DIRECT /end RECORD_LAYOUT
/begin RECORD_LAYOUT A_I64 AXIS_PTS_X 1 A_INT64 INDEX_INCR DIRECT /end RECORD_LAYOUT
/begin RECORD_LAYOUT A_F32 AXIS_PTS_X 1 FLOAT32_IEEE INDEX_INCR DIRECT /end RECORD_LAYOUT
/begin RECORD_LAYOUT A_F64 AXIS_PTS_X 1 FLOAT64_IEEE INDEX_INCR DIRECT /end RECORD_LAYOUT
/* Predefined measurement and characteristic typedefs for standard types */
/begin TYPEDEF_MEASUREMENT M_BOOL "" UBYTE BOOL 0 0 0 1 /end TYPEDEF_MEASUREMENT
/begin TYPEDEF_MEASUREMENT M_U8 "" UBYTE NO_COMPU_METHOD 0 0 0 255 /end TYPEDEF_MEASUREMENT
/begin TYPEDEF_MEASUREMENT M_U16 "" UWORD NO_COMPU_METHOD 0 0 0 65535 /end TYPEDEF_MEASUREMENT
/begin TYPEDEF_MEASUREMENT M_U32 "" ULONG NO_COMPU_METHOD 0 0 0 4294967295 /end TYPEDEF_MEASUREMENT
/begin TYPEDEF_MEASUREMENT M_U64 "" A_UINT64 NO_COMPU_METHOD 0 0 0 1e12 /end TYPEDEF_MEASUREMENT
/begin TYPEDEF_MEASUREMENT M_I8 "" SBYTE NO_COMPU_METHOD 0 0 -128 127 /end TYPEDEF_MEASUREMENT
/begin TYPEDEF_MEASUREMENT M_I16 "" SWORD NO_COMPU_METHOD 0 0 -32768 32767 /end TYPEDEF_MEASUREMENT
/begin TYPEDEF_MEASUREMENT M_I32 "" SLONG NO_COMPU_METHOD 0 0 -2147483648 2147483647 /end TYPEDEF_MEASUREMENT
/begin TYPEDEF_MEASUREMENT M_I64 "" A_INT64 NO_COMPU_METHOD 0 0 -1e12 1e12 /end TYPEDEF_MEASUREMENT
/begin TYPEDEF_MEASUREMENT M_F32 "" FLOAT32_IEEE NO_COMPU_METHOD 0 0 -1e12 1e12 /end TYPEDEF_MEASUREMENT
/begin TYPEDEF_MEASUREMENT M_F64 "" FLOAT64_IEEE NO_COMPU_METHOD 0 0 -1e12 1e12 /end TYPEDEF_MEASUREMENT
/begin TYPEDEF_CHARACTERISTIC C_BOOL "" VALUE U8 0 BOOL 0 1 /end TYPEDEF_CHARACTERISTIC
/begin TYPEDEF_CHARACTERISTIC C_U8 "" VALUE U8 0 NO_COMPU_METHOD 0 255 /end TYPEDEF_CHARACTERISTIC
/begin TYPEDEF_CHARACTERISTIC C_U16 "" VALUE U16 0 NO_COMPU_METHOD 0 65535 /end TYPEDEF_CHARACTERISTIC
/begin TYPEDEF_CHARACTERISTIC C_U32 "" VALUE U32 0 NO_COMPU_METHOD 0 4294967295 /end TYPEDEF_CHARACTERISTIC
/begin TYPEDEF_CHARACTERISTIC C_U64 "" VALUE U64 0 NO_COMPU_METHOD 0 1e12 /end TYPEDEF_CHARACTERISTIC
/begin TYPEDEF_CHARACTERISTIC C_I8 "" VALUE I8 0 NO_COMPU_METHOD -128 127 /end TYPEDEF_CHARACTERISTIC
/begin TYPEDEF_CHARACTERISTIC C_I16 "" VALUE I16 0 NO_COMPU_METHOD -32768 32767 /end TYPEDEF_CHARACTERISTIC
/begin TYPEDEF_CHARACTERISTIC C_I32 "" VALUE I32 0 NO_COMPU_METHOD -2147483648 2147483647 /end TYPEDEF_CHARACTERISTIC
/begin TYPEDEF_CHARACTERISTIC C_I64 "" VALUE I64 0 NO_COMPU_METHOD -1e12 1e12 /end TYPEDEF_CHARACTERISTIC
/begin TYPEDEF_CHARACTERISTIC C_F64 "" VALUE F64 0 NO_COMPU_METHOD -1e12 1e12 /end TYPEDEF_CHARACTERISTIC
/begin TYPEDEF_CHARACTERISTIC C_F32 "" VALUE F32 0 NO_COMPU_METHOD -1e12 1e12 /end TYPEDEF_CHARACTERISTIC
/begin MOD_PAR "" EPK "V102" ADDR_EPK 0x3C0E28D0
 /begin MEMORY_SEGMENT epk "" DATA FLASH INTERN 0x3C0E28D0 4 -1 -1 -1 -1 -1
  /begin IF_DATA XCP
   /begin SEGMENT 0 /*number*/ 2 /*pages*/ 0 /* addr_ext*/ 0 0 /begin CHECKSUM XCP_ADD_44 MAX_BLOCK_SIZE 0xFFFF EXTERNAL_FUNCTION "" /end CHECKSUM
    /begin PAGE 0x0 ECU_ACCESS_DONT_CARE XCP_READ_ACCESS_DONT_CARE XCP_WRITE_ACCESS_DONT_CARE /end PAGE
    /begin PAGE 0x1 ECU_ACCESS_DONT_CARE XCP_READ_ACCESS_DONT_CARE XCP_WRITE_ACCESS_NOT_ALLOWED /end PAGE
   /end SEGMENT
  /end IF_DATA
 /end MEMORY_SEGMENT
 /begin MEMORY_SEGMENT parameters "" DATA FLASH INTERN 0x3C0C8E04 32 -1 -1 -1 -1 -1
  /begin IF_DATA XCP
   /begin SEGMENT 1 /*number*/ 2 /*pages*/ 0 /* addr_ext*/ 0 0 /begin CHECKSUM XCP_ADD_44 MAX_BLOCK_SIZE 0xFFFF EXTERNAL_FUNCTION "" /end CHECKSUM
    /begin PAGE 0x0 ECU_ACCESS_DONT_CARE XCP_READ_ACCESS_DONT_CARE XCP_WRITE_ACCESS_DONT_CARE /end PAGE
    /begin PAGE 0x1 ECU_ACCESS_DONT_CARE XCP_READ_ACCESS_DONT_CARE XCP_WRITE_ACCESS_NOT_ALLOWED /end PAGE
   /end SEGMENT
  /end IF_DATA
 /end MEMORY_SEGMENT
/end MOD_PAR
/begin IF_DATA XCP
 /begin PROTOCOL_LAYER 0x0104 1000 2000 0 0 0 0 0 248 1024 BYTE_ORDER_MSB_LAST ADDRESS_GRANULARITY_BYTE OPTIONAL_CMD GET_COMM_MODE_INFO OPTIONAL_CMD GET_ID OPTIONAL_CMD SET_REQUEST OPTIONAL_CMD SET_MTA OPTIONAL_CMD UPLOAD OPTIONAL_CMD SHORT_UPLOAD OPTIONAL_CMD DOWNLOAD OPTIONAL_CMD SHORT_DOWNLOAD OPTIONAL_CMD GET_CAL_PAGE OPTIONAL_CMD SET_CAL_PAGE OPTIONAL_CMD COPY_CAL_PAGE OPTIONAL_CMD BUILD_CHECKSUM OPTIONAL_CMD GET_DAQ_RESOLUTION_INFO OPTIONAL_CMD GET_DAQ_PROCESSOR_INFO OPTIONAL_CMD FREE_DAQ OPTIONAL_CMD ALLOC_DAQ OPTIONAL_CMD ALLOC_ODT OPTIONAL_CMD ALLOC_ODT_ENTRY OPTIONAL_CMD SET_DAQ_PTR OPTIONAL_CMD WRITE_DAQ OPTIONAL_CMD GET_DAQ_LIST_MODE OPTIONAL_CMD SET_DAQ_LIST_MODE OPTIONAL_CMD START_STOP_SYNCH OPTIONAL_CMD START_STOP_DAQ_LIST OPTIONAL_CMD GET_DAQ_CLOCK OPTIONAL_CMD WRITE_DAQ_MULTIPLE OPTIONAL_CMD TIME_CORRELATION_PROPERTIES OPTIONAL_CMD USER_CMD OPTIONAL_LEVEL1_CMD GET_VERSION /end PROTOCOL_LAYER
 /begin DAQ DYNAMIC 0 3 0 OPTIMISATION_TYPE_DEFAULT ADDRESS_EXTENSION_FREE IDENTIFICATION_FIELD_TYPE_RELATIVE_BYTE GRANULARITY_ODT_ENTRY_SIZE_DAQ_BYTE 0xF8 OVERLOAD_INDICATION_PID /begin TIMESTAMP_SUPPORTED 0x1 SIZE_DWORD UNIT_1US TIMESTAMP_FIXED /end TIMESTAMP_SUPPORTED /* compilation unit = 86, function = slowTask, CFA = 0 */ /begin EVENT "slowTask" "slowTask" 0 DAQ 0xFF 0 0 0 CONSISTENCY DAQ /end EVENT /* compilation unit = 86, function = fastTask, CFA = 0 */ /begin EVENT "fastTask" "fastTask" 1 DAQ 0xFF 0 0 0 CONSISTENCY DAQ /end EVENT /* compilation unit = 86, function = foo, CFA = 0 */ /begin EVENT "foo" "foo" 2 DAQ 0xFF 0 0 0 CONSISTENCY DAQ /end EVENT /end DAQ
 /begin XCP_ON_UDP_IP 0x0104 5555 ADDRESS "192.168.0.146" /end XCP_ON_UDP_IP
/end IF_DATA
/* TypeDefs */
/begin TYPEDEF_CHARACTERISTIC fast_task_period_ms "" VALUE U32 0 IDENTITY 0 4294967295 PHYS_UNIT "ms" /end TYPEDEF_CHARACTERISTIC
/begin TYPEDEF_CHARACTERISTIC slow_task_period_ms "" VALUE U32 0 IDENTITY 0 4294967295 PHYS_UNIT "ms" /end TYPEDEF_CHARACTERISTIC
/begin TYPEDEF_CHARACTERISTIC counter_max "" VALUE U16 0 IDENTITY 0 65535 /end TYPEDEF_CHARACTERISTIC
/begin TYPEDEF_CHARACTERISTIC amplitude "" VALUE F32 0 NO_COMPU_METHOD -100000000000000000000000000000000 100000000000000000000000000000000 PHYS_UNIT "bar" /end TYPEDEF_CHARACTERISTIC
/begin TYPEDEF_CHARACTERISTIC sensor_voltage_point1 "Pressure sensor voltage at two-point calibration point 1" VALUE F32 0 NO_COMPU_METHOD -100000000000000000000000000000000 100000000000000000000000000000000 PHYS_UNIT "V" /end TYPEDEF_CHARACTERISTIC
/begin TYPEDEF_CHARACTERISTIC pressure_point1 "Pressure at two-point calibration point 1" VALUE F32 0 NO_COMPU_METHOD -100000000000000000000000000000000 100000000000000000000000000000000 PHYS_UNIT "bar" /end TYPEDEF_CHARACTERISTIC
/begin TYPEDEF_CHARACTERISTIC sensor_voltage_point2 "Pressure sensor voltage at two-point calibration point 2" VALUE F32 0 NO_COMPU_METHOD -100000000000000000000000000000000 100000000000000000000000000000000 PHYS_UNIT "V" /end TYPEDEF_CHARACTERISTIC
/begin TYPEDEF_CHARACTERISTIC pressure_point2 "Pressure at two-point calibration point 2" VALUE F32 0 NO_COMPU_METHOD -100000000000000000000000000000000 100000000000000000000000000000000 PHYS_UNIT "bar" /end TYPEDEF_CHARACTERISTIC
/begin TYPEDEF_STRUCTURE parameters "" 32 /begin STRUCTURE_COMPONENT fast_task_period_ms fast_task_period_ms 0 /end STRUCTURE_COMPONENT /begin STRUCTURE_COMPONENT slow_task_period_ms slow_task_period_ms 4 /end STRUCTURE_COMPONENT /begin STRUCTURE_COMPONENT counter_max counter_max 8 /end STRUCTURE_COMPONENT /begin STRUCTURE_COMPONENT amplitude amplitude 12 /end STRUCTURE_COMPONENT /begin STRUCTURE_COMPONENT sensor_voltage_point1 sensor_voltage_point1 16 /end STRUCTURE_COMPONENT /begin STRUCTURE_COMPONENT pressure_point1 pressure_point1 20 /end STRUCTURE_COMPONENT /begin STRUCTURE_COMPONENT sensor_voltage_point2 sensor_voltage_point2 24 /end STRUCTURE_COMPONENT /begin STRUCTURE_COMPONENT pressure_point2 pressure_point2 28 /end STRUCTURE_COMPONENT /end TYPEDEF_STRUCTURE
/begin TYPEDEF_MEASUREMENT index_ "" UWORD IDENTITY 0 0 0 65535 /end TYPEDEF_MEASUREMENT
/begin TYPEDEF_MEASUREMENT params_ptr_ "" ULONG IDENTITY 0 0 0 4294967295 /end TYPEDEF_MEASUREMENT
/begin TYPEDEF_STRUCTURE CalSegGuard "" 8 /begin STRUCTURE_COMPONENT index_ index_ 0 /end STRUCTURE_COMPONENT /begin STRUCTURE_COMPONENT params_ptr_ params_ptr_ 4 /end STRUCTURE_COMPONENT /end TYPEDEF_STRUCTURE
/begin TYPEDEF_MEASUREMENT a "" UWORD IDENTITY 0 0 0 65535 /end TYPEDEF_MEASUREMENT
/begin TYPEDEF_MEASUREMENT b "" SWORD IDENTITY 0 0 -32768 32767 /end TYPEDEF_MEASUREMENT
/begin TYPEDEF_MEASUREMENT f "" FLOAT32_IEEE NO_COMPU_METHOD 0 0 -100000000000000000000000000000000 100000000000000000000000000000000 /end TYPEDEF_MEASUREMENT
/begin TYPEDEF_MEASUREMENT d "" UBYTE IDENTITY 0 0 0 255 MATRIX_DIM 3 /end TYPEDEF_MEASUREMENT
/begin TYPEDEF_STRUCTURE test_struct "" 12 /begin STRUCTURE_COMPONENT a a 0 /end STRUCTURE_COMPONENT /begin STRUCTURE_COMPONENT b b 2 /end STRUCTURE_COMPONENT /begin STRUCTURE_COMPONENT f f 4 /end STRUCTURE_COMPONENT /begin STRUCTURE_COMPONENT d d 8 /end STRUCTURE_COMPONENT /end TYPEDEF_STRUCTURE
/* Measurements */
/* Measurements for event 'slowTask' */
/begin MEASUREMENT slowTask.counter "Local measurement variable in `slowTask`" UWORD IDENTITY 0 0 0 65535 ECU_ADDRESS 0xFFD2 ECU_ADDRESS_EXTENSION 2
 /begin IF_DATA XCP
  /begin DAQ_EVENT VARIABLE /begin DEFAULT_EVENT_LIST EVENT 0 /end DEFAULT_EVENT_LIST /end DAQ_EVENT
 /end IF_DATA
/end MEASUREMENT
/begin INSTANCE slowTask.params "" CalSegGuard 0xFFD8 ECU_ADDRESS_EXTENSION 2
 /begin IF_DATA XCP
  /begin DAQ_EVENT VARIABLE /begin DEFAULT_EVENT_LIST EVENT 0 /end DEFAULT_EVENT_LIST /end DAQ_EVENT
 /end IF_DATA
/end INSTANCE
/begin MEASUREMENT slowTask.lastWakeTime "" ULONG IDENTITY 0 0 0 4294967295 ECU_ADDRESS 0xFFD4 ECU_ADDRESS_EXTENSION 2
 /begin IF_DATA XCP
  /begin DAQ_EVENT VARIABLE /begin DEFAULT_EVENT_LIST EVENT 0 /end DEFAULT_EVENT_LIST /end DAQ_EVENT
 /end IF_DATA
/end MEASUREMENT
/* Measurements for event 'fastTask' */
/begin MEASUREMENT MOSI "" UBYTE IDENTITY 0 0 0 255 ECU_ADDRESS 0x420149C4
 /begin IF_DATA XCP
  /begin DAQ_EVENT VARIABLE /begin DEFAULT_EVENT_LIST EVENT 1 /end DEFAULT_EVENT_LIST /end DAQ_EVENT
 /end IF_DATA
/end MEASUREMENT
/begin MEASUREMENT MISO "" UBYTE IDENTITY 0 0 0 255 ECU_ADDRESS 0x4201497C
 /begin IF_DATA XCP
  /begin DAQ_EVENT VARIABLE /begin DEFAULT_EVENT_LIST EVENT 1 /end DEFAULT_EVENT_LIST /end DAQ_EVENT
 /end IF_DATA
/end MEASUREMENT
/begin MEASUREMENT fastTask.counter "Local measurement variable in `fastTask`" UWORD IDENTITY 0 0 0 65535 ECU_ADDRESS 0x40FFD2 ECU_ADDRESS_EXTENSION 2
 /begin IF_DATA XCP
  /begin DAQ_EVENT VARIABLE /begin DEFAULT_EVENT_LIST EVENT 1 /end DEFAULT_EVENT_LIST /end DAQ_EVENT
 /end IF_DATA
/end MEASUREMENT
/begin INSTANCE fastTask.params "" CalSegGuard 0x40FFD8 ECU_ADDRESS_EXTENSION 2
 /begin IF_DATA XCP
  /begin DAQ_EVENT VARIABLE /begin DEFAULT_EVENT_LIST EVENT 1 /end DEFAULT_EVENT_LIST /end DAQ_EVENT
 /end IF_DATA
/end INSTANCE
/begin MEASUREMENT global_counter "Global measurement variable, incremented in fastTask" UWORD IDENTITY 0 0 0 65535 ECU_ADDRESS 0x3FCA7054 READ_WRITE
 /begin IF_DATA XCP
  /begin DAQ_EVENT VARIABLE /begin DEFAULT_EVENT_LIST EVENT 1 /end DEFAULT_EVENT_LIST /end DAQ_EVENT
 /end IF_DATA
/end MEASUREMENT
/begin MEASUREMENT channel1 "Pressure measured on analog channel 1 or generated sine wave, updated in slowTask" FLOAT32_IEEE NO_COMPU_METHOD 0 0 -100000000000000000000000000000000 100000000000000000000000000000000 ECU_ADDRESS 0x3FCA7050 PHYS_UNIT "bar"
 /begin IF_DATA XCP
  /begin DAQ_EVENT VARIABLE /begin DEFAULT_EVENT_LIST EVENT 1 /end DEFAULT_EVENT_LIST /end DAQ_EVENT
 /end IF_DATA
/end MEASUREMENT
/begin MEASUREMENT fastTaskOverruns "" ULONG IDENTITY 0 0 0 4294967295 ECU_ADDRESS 0x3FCA704C
 /begin IF_DATA XCP
  /begin DAQ_EVENT VARIABLE /begin DEFAULT_EVENT_LIST EVENT 1 /end DEFAULT_EVENT_LIST /end DAQ_EVENT
 /end IF_DATA
/end MEASUREMENT
/begin MEASUREMENT slowTaskOverruns "" ULONG IDENTITY 0 0 0 4294967295 ECU_ADDRESS 0x3FCA7048
 /begin IF_DATA XCP
  /begin DAQ_EVENT VARIABLE /begin DEFAULT_EVENT_LIST EVENT 1 /end DEFAULT_EVENT_LIST /end DAQ_EVENT
 /end IF_DATA
/end MEASUREMENT
/begin MEASUREMENT calseg_id_parameters "" UWORD IDENTITY 0 0 0 65535 ECU_ADDRESS 0x3FC96F24
 /begin IF_DATA XCP
  /begin DAQ_EVENT VARIABLE /begin DEFAULT_EVENT_LIST EVENT 1 /end DEFAULT_EVENT_LIST /end DAQ_EVENT
 /end IF_DATA
/end MEASUREMENT
/begin MEASUREMENT fastTask.lastWakeTime "" ULONG IDENTITY 0 0 0 4294967295 ECU_ADDRESS 0x40FFD4 ECU_ADDRESS_EXTENSION 2
 /begin IF_DATA XCP
  /begin DAQ_EVENT VARIABLE /begin DEFAULT_EVENT_LIST EVENT 1 /end DEFAULT_EVENT_LIST /end DAQ_EVENT
 /end IF_DATA
/end MEASUREMENT
/begin MEASUREMENT fastTask.static_counter "Local static measurement variable in `fastTask`" UWORD IDENTITY 0 0 0 65535 ECU_ADDRESS 0x3FCA7044
 /begin IF_DATA XCP
  /begin DAQ_EVENT VARIABLE /begin DEFAULT_EVENT_LIST EVENT 1 /end DEFAULT_EVENT_LIST /end DAQ_EVENT
 /end IF_DATA
/end MEASUREMENT
/* Measurements for event 'foo' */
/begin MEASUREMENT foo.static_counter "Local static measurement variable in function `foo`" UWORD IDENTITY 0 0 0 65535 ECU_ADDRESS 0x3FCA7046
 /begin IF_DATA XCP
  /begin DAQ_EVENT VARIABLE /begin DEFAULT_EVENT_LIST EVENT 2 /end DEFAULT_EVENT_LIST /end DAQ_EVENT
 /end IF_DATA
/end MEASUREMENT
/begin MEASUREMENT foo.test_int8 "" SBYTE IDENTITY 0 0 -128 127 ECU_ADDRESS 0x80FF8D ECU_ADDRESS_EXTENSION 2
 /begin IF_DATA XCP
  /begin DAQ_EVENT VARIABLE /begin DEFAULT_EVENT_LIST EVENT 2 /end DEFAULT_EVENT_LIST /end DAQ_EVENT
 /end IF_DATA
/end MEASUREMENT
/begin MEASUREMENT foo.test_int16 "" SWORD IDENTITY 0 0 -32768 32767 ECU_ADDRESS 0x80FF8E ECU_ADDRESS_EXTENSION 2
 /begin IF_DATA XCP
  /begin DAQ_EVENT VARIABLE /begin DEFAULT_EVENT_LIST EVENT 2 /end DEFAULT_EVENT_LIST /end DAQ_EVENT
 /end IF_DATA
/end MEASUREMENT
/begin MEASUREMENT foo.test_int32 "" SLONG IDENTITY 0 0 -2147483648 2147483647 ECU_ADDRESS 0x80FF94 ECU_ADDRESS_EXTENSION 2
 /begin IF_DATA XCP
  /begin DAQ_EVENT VARIABLE /begin DEFAULT_EVENT_LIST EVENT 2 /end DEFAULT_EVENT_LIST /end DAQ_EVENT
 /end IF_DATA
/end MEASUREMENT
/begin MEASUREMENT foo.test_int64 "" A_UINT64 IDENTITY 0 0 0 18446744073709552000 ECU_ADDRESS 0x80FF98 ECU_ADDRESS_EXTENSION 2
 /begin IF_DATA XCP
  /begin DAQ_EVENT VARIABLE /begin DEFAULT_EVENT_LIST EVENT 2 /end DEFAULT_EVENT_LIST /end DAQ_EVENT
 /end IF_DATA
/end MEASUREMENT
/begin MEASUREMENT foo.counter "Local captured measurement variable in function `foo`" ULONG IDENTITY 0 0 0 4294967295 ECU_ADDRESS 0x800000 ECU_ADDRESS_EXTENSION 3
 /begin IF_DATA XCP
  /begin DAQ_EVENT VARIABLE /begin DEFAULT_EVENT_LIST EVENT 2 /end DEFAULT_EVENT_LIST /end DAQ_EVENT
 /end IF_DATA
/end MEASUREMENT
/begin MEASUREMENT foo.test_float "" FLOAT32_IEEE NO_COMPU_METHOD 0 0 -100000000000000000000000000000000 100000000000000000000000000000000 ECU_ADDRESS 0x800004 ECU_ADDRESS_EXTENSION 3
 /begin IF_DATA XCP
  /begin DAQ_EVENT VARIABLE /begin DEFAULT_EVENT_LIST EVENT 2 /end DEFAULT_EVENT_LIST /end DAQ_EVENT
 /end IF_DATA
/end MEASUREMENT
/begin MEASUREMENT foo.test_double "" FLOAT64_IEEE NO_COMPU_METHOD 0 0 -100000000000000000000000000000000 100000000000000000000000000000000 ECU_ADDRESS 0x800008 ECU_ADDRESS_EXTENSION 3
 /begin IF_DATA XCP
  /begin DAQ_EVENT VARIABLE /begin DEFAULT_EVENT_LIST EVENT 2 /end DEFAULT_EVENT_LIST /end DAQ_EVENT
 /end IF_DATA
/end MEASUREMENT
/begin MEASUREMENT foo.test_uint8 "" UBYTE IDENTITY 0 0 0 255 ECU_ADDRESS 0x800010 ECU_ADDRESS_EXTENSION 3
 /begin IF_DATA XCP
  /begin DAQ_EVENT VARIABLE /begin DEFAULT_EVENT_LIST EVENT 2 /end DEFAULT_EVENT_LIST /end DAQ_EVENT
 /end IF_DATA
/end MEASUREMENT
/begin MEASUREMENT foo.test_uint16 "" UWORD IDENTITY 0 0 0 65535 ECU_ADDRESS 0x800012 ECU_ADDRESS_EXTENSION 3
 /begin IF_DATA XCP
  /begin DAQ_EVENT VARIABLE /begin DEFAULT_EVENT_LIST EVENT 2 /end DEFAULT_EVENT_LIST /end DAQ_EVENT
 /end IF_DATA
/end MEASUREMENT
/begin MEASUREMENT foo.test_uint32 "" ULONG IDENTITY 0 0 0 4294967295 ECU_ADDRESS 0x800014 ECU_ADDRESS_EXTENSION 3
 /begin IF_DATA XCP
  /begin DAQ_EVENT VARIABLE /begin DEFAULT_EVENT_LIST EVENT 2 /end DEFAULT_EVENT_LIST /end DAQ_EVENT
 /end IF_DATA
/end MEASUREMENT
/begin MEASUREMENT foo.test_uint64 "" A_UINT64 IDENTITY 0 0 0 18446744073709552000 ECU_ADDRESS 0x800018 ECU_ADDRESS_EXTENSION 3
 /begin IF_DATA XCP
  /begin DAQ_EVENT VARIABLE /begin DEFAULT_EVENT_LIST EVENT 2 /end DEFAULT_EVENT_LIST /end DAQ_EVENT
 /end IF_DATA
/end MEASUREMENT
/begin INSTANCE foo.test_struct "" test_struct 0x800020 ECU_ADDRESS_EXTENSION 3
 /begin IF_DATA XCP
  /begin DAQ_EVENT VARIABLE /begin DEFAULT_EVENT_LIST EVENT 2 /end DEFAULT_EVENT_LIST /end DAQ_EVENT
 /end IF_DATA
/end INSTANCE
/begin MEASUREMENT foo.test_array "" UBYTE IDENTITY 0 0 0 255 ECU_ADDRESS 0x80002C ECU_ADDRESS_EXTENSION 3 MATRIX_DIM 3
 /begin IF_DATA XCP
  /begin DAQ_EVENT VARIABLE /begin DEFAULT_EVENT_LIST EVENT 2 /end DEFAULT_EVENT_LIST /end DAQ_EVENT
 /end IF_DATA
/end MEASUREMENT
/* Measurements without fixed event */
/begin GROUP Measurements "" ROOT /begin SUB_GROUP slowTask fastTask foo /end SUB_GROUP /end GROUP
/begin GROUP slowTask "" /begin REF_MEASUREMENT slowTask.counter slowTask.params slowTask.lastWakeTime /end REF_MEASUREMENT /end GROUP
/begin GROUP fastTask ""
 /begin REF_MEASUREMENT MOSI MISO fastTask.counter fastTask.params global_counter channel1 fastTaskOverruns slowTaskOverruns calseg_id_parameters fastTask.lastWakeTime fastTask.static_counter /end REF_MEASUREMENT
/end GROUP
/begin GROUP foo ""
 /begin REF_MEASUREMENT foo.static_counter foo.test_int8 foo.test_int16 foo.test_int32 foo.test_int64 foo.counter foo.test_float foo.test_double foo.test_uint8 foo.test_uint16 foo.test_uint32 foo.test_uint64 foo.test_struct foo.test_array /end REF_MEASUREMENT
/end GROUP
/* Axis */
/* Characteristics */
/begin INSTANCE parameters "" parameters 0x3C0C8E04 /end INSTANCE
/* Characteristic and Axis Groups */
/begin GROUP Characteristics "" ROOT /begin SUB_GROUP parameters /end SUB_GROUP /end GROUP
/begin GROUP parameters "" /begin REF_CHARACTERISTIC parameters /end REF_CHARACTERISTIC /end GROUP
/end MODULE
/end PROJECT
